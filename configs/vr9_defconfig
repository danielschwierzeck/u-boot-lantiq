## configs/vr9_defconfig
```kconfig
CONFIG_HAVE_GENERIC_BOARD=y
CONFIG_SYS_GENERIC_BOARD=y
CONFIG_MIPS=y
CONFIG_SYS_ARCH="mips"
CONFIG_SYS_CPU="mips32"
CONFIG_SYS_SOC="vr9"
CONFIG_SYS_VENDOR="lantiq"
CONFIG_SYS_BOARD="vr9"
CONFIG_SYS_CONFIG_NAME="vr9"
CONFIG_SPL_SYS_MALLOC_SIMPLE=y
CONFIG_LANTIQ=y
CONFIG_LANTIQ_UBOOT_vr9=y
CONFIG_SYS_TEXT_BASE=0xA0400000
CONFIG_LTQ_BOOT_FROM_SPI=y
CONFIG_ENV_IS_IN_SPI_FLASH=y
CONFIG_RAM_TEXT_BASE=0xA0400000
CONFIG_OS_LZMA=y
CONFIG_IFX_MEMORY_SIZE=64
CONFIG_BAUDRATE=115200
CONFIG_LANTIQ_SPI=y
CONFIG_SPI_FLASH_4M=y
CONFIG_SPI_FLASH_WINBOND=y
CONFIG_SF_DEFAULT_SPEED=2222222
CONFIG_SF_DEFAULT_MODE=0
CONFIG_VRX200=y
CONFIG_VR9_CRYSTAL_36M=y
CONFIG_VR9_DDR2=y
CONFIG_VR9_CPU_500M_RAM_250M=y
CONFIG_VR9_SW_PORT_2=y
CONFIG_VR9_SW_PORT2_GMII=y
CONFIG_VR9_INTERNAL_PHY_TYPE=1
CONFIG_GPHY_LED_SHIFT_REG=y
CONFIG_VR9_SW_PORT2_MIIRATE=4
CONFIG_VR9_SW_PORT2_MIIMODE=1
CONFIG_VR9_SW_PORT_4=y
CONFIG_VR9_SW_PORT4_GMII=y
CONFIG_VR9_SW_PORT4_MIIRATE=4
CONFIG_VR9_SW_PORT4_MIIMODE=1
CONFIG_VR9_SW_PORT_5a=y
CONFIG_VR9_SW_PORT5a_RGMII=y
CONFIG_VR9_SW_PORT5a_MIIMODE=4
CONFIG_VR9_SW_PORT5a_MIIRATE=4
CONFIG_VR9_GPHY_FW_EMBEDDED=y
CONFIG_TUNE_DDR=y
CONFIG_DDR_TUNING_TEXT_BASE=0x9e220000
CONFIG_ENABLE_DCDC=y
CONFIG_POWER_DOWN_REGULATOR=y
CONFIG_ENV_OVERWRITE=y
CONFIG_SPI_BOOT=y
CONFIG_SUPPORT_SPL=y
CONFIG_SPL=y
CONFIG_EXT_SPL_PATH="arch/mips/mach-lantiq/vr9/spi_spl"
CONFIG_CMD_SAVEENV=y
CONFIG_CMD_BOOTM=y
CONFIG_CMD_GO=y
CONFIG_CMD_RUN=y
CONFIG_CMD_SF=y
# CONFIG_CMD_BOOTD is not set
# CONFIG_CMD_BOOTZ is not set
# CONFIG_CMD_ELF is not set
# CONFIG_CMD_IMI is not set
# CONFIG_CMD_IMLS is not set
# CONFIG_CMD_XIMG is not set
# CONFIG_CMD_NFS is not set
# CONFIG_CMD_FPGA is not set
# CONFIG_CMD_FLASH is not set
CONFIG_CMD_BOOT_TOS=y
# CONFIG_CMD_LOADS is not set
# CONFIG_CMD_ITEST is not set
# CONFIG_CMD_SOURCE is not set
# CONFIG_CMD_SETEXPR is not set
```

## drivers/mtd/nand/Kconfig
```kconfig
menu "NAND Device Support"

config SYS_NAND_SELF_INIT
	bool
	help
	  This option, if enabled, provides more flexible and linux-like
	  NAND initialization process.

config NAND_DENALI
	bool "Support Denali NAND controller"
	select SYS_NAND_SELF_INIT
	help
	  Enable support for the Denali NAND controller.

config SYS_NAND_DENALI_64BIT
	bool "Use 64-bit variant of Denali NAND controller"
	depends on NAND_DENALI
	help
	  The Denali NAND controller IP has some variations in terms of
	  the bus interface.  The DMA setup sequence is completely differenct
	  between 32bit / 64bit AXI bus variants.

	  If your Denali NAND controller is the 64-bit variant, say Y.
	  Otherwise (32 bit), say N.

config NAND_DENALI_SPARE_AREA_SKIP_BYTES
	int "Number of bytes skipped in OOB area"
	depends on NAND_DENALI
	range 0 63
	help
	  This option specifies the number of bytes to skip from the beginning
	  of OOB area before last ECC sector data starts.  This is potentially
	  used to preserve the bad block marker in the OOB area.

config NAND_VF610_NFC
	bool "Support for Freescale NFC for VF610/MPC5125"
	select SYS_NAND_SELF_INIT
	help
	  Enables support for NAND Flash Controller on some Freescale
	  processors like the VF610, MPC5125, MCF54418 or Kinetis K70.
	  The driver supports a maximum 2k page size. The driver
	  currently does not support hardware ECC.

choice
	prompt "Hardware ECC strength"
	depends on NAND_VF610_NFC
	default SYS_NAND_VF610_NFC_45_ECC_BYTES
	help
	  Select the ECC strength used in the hardware BCH ECC block.

config SYS_NAND_VF610_NFC_45_ECC_BYTES
	bool "24-error correction (45 ECC bytes)"

config SYS_NAND_VF610_NFC_60_ECC_BYTES
	bool "32-error correction (60 ECC bytes)"

endchoice

config NAND_PXA3XX
	bool "Support for NAND on PXA3xx and Armada 370/XP/38x"
	select SYS_NAND_SELF_INIT
	help
	  This enables the driver for the NAND flash device found on
	  PXA3xx processors (NFCv1) and also on Armada 370/XP (NFCv2).

config NAND_SUNXI
	bool "Support for NAND on Allwinner SoCs in SPL"
	depends on MACH_SUN4I || MACH_SUN5I || MACH_SUN7I
	select SYS_NAND_SELF_INIT
	---help---
	Enable support for NAND. This option allows SPL to read from
	sunxi NAND using DMA transfers.

config NAND_ARASAN
	bool "Configure Arasan Nand"
	help
	  This enables Nand driver support for Arasan nand flash
	  controller. This uses the hardware ECC for read and
	  write operations.

config NAND_LANTIQ
	bool "Support for Lantiq HSNAND controller"
	depends on ARCH_LANTIQ
	default n
	select SYS_NAND_SELF_INIT
	select DMA_LANTIQ
	help
	  This enables support for the Lantiq HSNAND controller.

config NAND_LANTIQ_CS0
	bool "Lantiq HSNAND chip-select 0"
	depends on NAND_LANTIQ
	default n

config NAND_LANTIQ_CS0_GPIO
	bool "Lantiq HSNAND chip-select 0 driven by GPIO"
	depends on NAND_LANTIQ_CS0
	default n

config NAND_LANTIQ_CS0_GPIO_NUM
	int "Lantiq HSNAND GPIO number for chip-select 0"
	depends on NAND_LANTIQ_CS0_GPIO
	default 0

config NAND_LANTIQ_CS1
	bool "Lantiq HSNAND chip select 1"
	depends on NAND_LANTIQ
	default y

config NAND_LANTIQ_CS1_GPIO
	bool "Lantiq HSNAND chip-select 1 driven by GPIO"
	depends on NAND_LANTIQ_CS1
	default n

config NAND_LANTIQ_CS1_GPIO_NUM
	int "Lantiq HSNAND GPIO number for chip-select 1"
	depends on NAND_LANTIQ_CS1_GPIO
	default 0

choice
	prompt "Lantiq HSNAND ECC mode for chip select 0"
	depends on NAND_LANTIQ_CS0
	default NAND_LANTIQ_CS0_ECC_BCH

config NAND_LANTIQ_CS0_ECC_RS_3
	bool "HW Reed Solomon with 3 bytes"

config NAND_LANTIQ_CS0_ECC_RS_4
	bool "HW Reed Solomon with 4 bytes"

config NAND_LANTIQ_CS0_ECC_BCH
	bool "SW BCH"

config NAND_LANTIQ_CS0_ECC_SOFT
	bool "SW Hamming"

config NAND_LANTIQ_CS0_ECC_NONE
	bool "None"

endchoice

choice
	prompt "Lantiq HSNAND ECC mode for chip select 1"
	depends on NAND_LANTIQ_CS1
	default NAND_LANTIQ_CS1_ECC_BCH

config NAND_LANTIQ_CS1_ECC_RS_3
	bool "HW Reed Solomon with 3 bytes"

config NAND_LANTIQ_CS1_ECC_RS_4
	bool "HW Reed Solomon with 4 bytes"

config NAND_LANTIQ_CS1_ECC_BCH
	bool "SW BCH"

config NAND_LANTIQ_CS1_ECC_SOFT
	bool "SW Hamming"

config NAND_LANTIQ_CS1_ECC_NONE
	bool "None"

endchoice

comment "Generic NAND options"

# Enhance depends when converting drivers to Kconfig which use this config
# option (mxc_nand, ndfc, omap_gpmc).
config SYS_NAND_BUSWIDTH_16BIT
	bool "Use 16-bit NAND interface"
	depends on NAND_VF610_NFC
	help
	  Indicates that NAND device has 16-bit wide data-bus. In absence of this
	  config, bus-width of NAND device is assumed to be either 8-bit and later
	  determined by reading ONFI params.
	  Above config is useful when NAND device's bus-width information cannot
	  be determined from on-chip ONFI params, like in following scenarios:
	  - SPL boot does not support reading of ONFI parameters. This is done to
	    keep SPL code foot-print small.
	  - In current U-Boot flow using nand_init(), driver initialization
	    happens in board_nand_init() which is called before any device probe
	    (nand_scan_ident + nand_scan_tail), thus device's ONFI parameters are
	    not available while configuring controller. So a static CONFIG_NAND_xx
	    is needed to know the device's bus-width in advance.

if SPL

config SYS_NAND_U_BOOT_LOCATIONS
	bool "Define U-boot binaries locations in NAND"
	help
	Enable CONFIG_SYS_NAND_U_BOOT_OFFS though Kconfig.
	This option should not be enabled when compiling U-boot for boards
	defining CONFIG_SYS_NAND_U_BOOT_OFFS in their include/configs/<board>.h
	file.

config SYS_NAND_U_BOOT_OFFS
	hex "Location in NAND to read U-Boot from"
	default 0x8000 if NAND_SUNXI
	depends on SYS_NAND_U_BOOT_LOCATIONS
	help
	Set the offset from the start of the nand where u-boot should be
	loaded from.

config SYS_NAND_U_BOOT_OFFS_REDUND
	hex "Location in NAND to read U-Boot from"
	default SYS_NAND_U_BOOT_OFFS
	depends on SYS_NAND_U_BOOT_LOCATIONS
	help
	Set the offset from the start of the nand where the redundant u-boot
	should be loaded from.

config SPL_NAND_DENALI
	bool "Support Denali NAND controller for SPL"
	help
	  This is a small implementation of the Denali NAND controller
	  for use on SPL.

endif

endmenu
```

## lib/Kconfig
```kconfig
menu "libs"

config ADDR_MAP
   bool "addr map"

config BZIP2
   bool "bzip2"

config BCH
   bool "BCH"

config USB_TTY
   bool "usb tty"

config GZIP
   bool "gzip"

config LMB
   bool "lmb"

config MD5
   bool "md5"

config SHA1
   bool "SHA1"

config SHA256
   bool "SHA256"

config ZLIB
   bool "ZLIB"

config RBTREE
   bool "RBTREE"

config LZO
   bool "LZO"

config LZMA
   bool "LZMA"
   default y

endmenu
```

## lib/sphairon/Kconfig
```kconfig
config LIB_SPHAIRON
	bool "Enable the Sphairon library"
	default n

if LIB_SPHAIRON

config SPHAIRON_FLASHLAYOUT
	string "Default Sphairon flash layout"
	default "psmd"

config SPHAIRON_SCAN_STEP_SIZE
	hex "Sphairon flash layout image scan step"
	default 0x2000

config SPHAIRON_ETL_NAND
	bool "Enable Sphairon library support for ETL in NAND flash"
	default n

config SPHAIRON_UBI_SUPPORT
	bool "Enable Sphairon library support for UBI"
	default n

config SPHAIRON_ETL_WRITE_DISABLE
	bool "Disable write support for Sphairon ETL"
	default n

config SPHAIRON_ZYCLIP
	bool "Enable Sphairon library support for Zyclip"
	default n

config SPHAIRON_UGW_CALIBRATION
	bool "Enable Sphairon library support for UGW calibration MTD partition"
	default n

config SPHAIRON_DEBUG
	bool "Enable Sphairon library debugging"
	default n

endif
```
