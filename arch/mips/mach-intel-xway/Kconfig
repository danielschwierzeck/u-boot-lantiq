## board/hn1/Kconfig
```kconfig
config DRIVER_HN1
    bool
    default y

menu "CPU/DDR FREQUENCY"

choice 
    prompt "PLATFORM"
    default HNX100

config HNX100
    bool "HNX100"

config HNX200
    bool "HNX200(FUTURE USE)"

endchoice


choice 
    prompt "DDR TYPE SELECTION"
    default HN1_DDR2

config HN1_DDR1
    bool "DDR1"

config HN1_DDR2
    bool "DDR2"

endchoice

choice
    prompt "CPU AND RAM CONFIGURATION"
    default HN1_CPU_400M_RAM_200M

config HN1_CPU_200M_RAM_100M
    bool "200M/100M"
    depends on !HN1_DDR2    

config HN1_CPU_200M_RAM_200M
    bool "200M/200M"

config HN1_CPU_400M_RAM_200M
    bool "400M/200M"

endchoice

config ENABLE_POWER_MANAGEMENT
    bool "Enable power management(EXPERIMENTAL)"
	default n

config USE_DEFAULT_LOWPOWER_SETTING
    bool "USE DEFAULT LOWPOWER SETTING"
    default y
    depends on ENABLE_POWER_MANAGEMENT


config LOWPOWER_CONTROL
    hex 'LOWPOWER_CONTROL'
    default "0x14"
    depends on !USE_DEFAULT_LOWPOWER_SETTING
    depends on ENABLE_POWER_MANAGEMENT

config LOWPOWER_AUTO_ENABLE
    hex 'LOWERPOWER_AUTO_ENABLE'
    default "0x14"
    depends on !USE_DEFAULT_LOWPOWER_SETTING
    depends on ENABLE_POWER_MANAGEMENT

config LOWPOWER_POWER_DOWN_CNT
    hex 'LOWPOWER_POWER_DOWN_CNT'
    default "0x40"
    depends on !USE_DEFAULT_LOWPOWER_SETTING
    depends on ENABLE_POWER_MANAGEMENT

config LOWPOWER_SELF_REFRESH_CNT
    hex 'LOWPOWER_SELF_REFRESH_CNT'
    default "0x80"
    depends on !USE_DEFAULT_LOWPOWER_SETTING
    depends on ENABLE_POWER_MANAGEMENT

endmenu


menu "SWITCH OPTIONS"


config HN1_SW_PORT_1
    bool "USE PORT 1"
	default y

config HN1_SW_PORT1_GMII
    bool  
    depends on HN1_SW_PORT_1 && !HN1_SW_PORT_0b
    default y

config HN1_SW_PORT1_MIIRATE
   int
   depends on HN1_SW_PORT_1
   default 4
					 
config HN1_SW_PORT1_MIIMODE
    int
    depends on HN1_SW_PORT_1
    default 5 

config HN1_SW_PORT_0a
    bool "USE PORT 0a"
    default y
    depends on !HN1_SW_PORT_0b

choice
    prompt "INTERFACE"
    depends on HN1_SW_PORT_0a
    default HN1_SW_PORT0a_RGMII

config HN1_SW_PORT0a_RGMII
    bool "RGMII"
endchoice

config HN1_SW_PORT0a_MIIMODE
    int
    depends on HN1_SW_PORT_0a
    default 4

config HN1_SW_PORT0a_MIIRATE
    int
    depends on HN1_SW_PORT_0a
    default 4
			
config HN1_SW_PORT_0b
    bool "USE PORT 0b"
    default n
    
choice
    prompt "INTERFACE"
    depends on HN1_SW_PORT_0b
    default HN1_SW_PORT0b_MII

config HN1_SW_PORT0b_MII
    bool "MII"

endchoice       

config HN1_SW_PORT0b_MIIMODE
    int
    depends on HN1_SW_PORT_0b
    default 5

config HN1_SW_PORT0b_MIIRATE
    int
    depends on HN1_SW_PORT_0b
    default 4

config HN1_GPHY_FW_EMBEDDED
    bool "gphy firmware embedded"
    default y

config HN1_GPHY_FW_ADDR
    hex 'gphy firmware address'
    default "0xa0110000" if ( BOOT_FROM_SPI )
    default "0xa0120000" if ( BOOT_FROM_NAND )
    depends on HN1_SW_PORT_0b || HN1_SW_PORT_1
    depends on HN1_GPHY_FW_EMBEDDED

config HN1_EXTERN_GPHY_FW_ADDR
    hex "gphy firmware address"
    default "0xa0110000"
    depends on !HN1_GPHY_FW_EMBEDDED

config HN1_GPHY_DEBUG
    bool "DEBUG GPHY"
    default y
    depends on !NAND_FLASH
	
endmenu

config TUNE_DDR
    bool "DDR tuning support"
    default y

config DDR_TUNING_TEXT_BASE
    hex 
    default "0x9f280000"
    depends on TUNE_DDR

config ENABLE_CORE_DCDC
    bool "ENABLE CORE DCDC"
    default n

config ENABLE_DDR_DCDC
    bool "ENABLE DDR DCDC"
    default n

config POWER_DOWN_REGULATOR
    bool "POWER DOWN 2.5V REGULATOR"
    default n

config DEBUG
    bool "VERBOSE"
    default n

config FASTER_UART
    bool "USE 25x FASTER UART"
    default n
	
config USE_TANTOS_SWITCH
    bool "Use TANTOS chip as external switch connected to HNX over RGMII"
    default y
	
```

## board/intel/easy330/Kconfig
```kconfig
if TARGET_EASY330

config SYS_BOARD
	default "easy330"

config SYS_VENDOR
	default "intel"

config SYS_CONFIG_NAME
	default "easy330"

endif
```

## board/intel/easy50712/Kconfig
```kconfig
if TARGET_EASY50712

config SYS_BOARD
	default "easy50712"

config SYS_VENDOR
	default "intel"

config SYS_CONFIG_NAME
	default "easy50712"

endif
```

## board/intel/easy80920/Kconfig
```kconfig
if TARGET_EASY80920

config SYS_BOARD
	default "easy80920"

config SYS_VENDOR
	default "intel"

config SYS_CONFIG_NAME
	default "easy80920"

endif
```
