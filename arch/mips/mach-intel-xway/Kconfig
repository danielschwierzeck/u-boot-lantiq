## board/lantiq/prx300/Kconfig
```kconfig
config SYS_BOARD
    default "prx300"

config SYS_VENDOR
    default "lantiq"

config SYS_CONFIG_NAME
    default "prx300"

config DRIVER_PRX300
      bool
      default y

config SPI_SPL_SIZE
	hex
	default "0xA000" if ( MANUBOOT )
	default "0x9000" if ( !MANUBOOT && LTQ_BOOT_FROM_QSPI )
	default "0x6000" if	( !MANUBOOT && LTQ_BOOT_FROM_SPI )
	depends on ( LTQ_BOOT_FROM_SPI || LTQ_BOOT_FROM_QSPI )

config PRX300_ROM_HEADER_BCH_CAP
       int
       default 8  if ( PRX300_A21 )

config PRX300_BOOT_4KEC_ONLY
	bool "boot 4kec only"
	default n

config PRX300_WDT
	bool "Enable WDT before Linux boot"
	select HW_WATCHDOG
	default n

config WDT_TIMEOUT_VALUE
	hex "WDT Timeout Value"
	depends on PRX300_WDT
	default "0xffffffff"

config XO_SETTINGS
	bool "Enable XO settings configuration in bootloader"
	default n
	help
	  XO settings configuration is needed in the EVM board
	  to be able to use the 10G interface. Enabling this
	  may actually cause the U-boot to be unstable after a
	  boot. If not needed in SFU boards, do not enable this.

menu "Memory configuration for Trusted OS"
choice
    prompt "Memory reserved for TOS"
    default PRX300_TOS_128M

config PRX300_TOS_16M
	bool "16M for tos"

config PRX300_TOS_32M
	bool "32M for tos"

config PRX300_TOS_64M
	bool "64M for tos"

config PRX300_TOS_128M
	bool "128M for tos"
endchoice

choice
    prompt "DDR present in system"
    default PRX300_DDR_512M

config PRX300_DDR_256M
    bool "256M DDR"

config PRX300_DDR_512M
	bool "512M DDR"

config PRX300_DDR_1G
    bool "1G DDR"
endchoice

config PRX300_FMT1_REG
	hex
	default "0xFF002F00" if ( PRX300_DDR_256M  &&  PRX300_TOS_16M )
	default "0xFE002E00" if ( PRX300_DDR_256M  &&  PRX300_TOS_32M )
	default "0xFC002C00" if ( PRX300_DDR_256M  &&  PRX300_TOS_64M )
	default "0xF8002800" if ( PRX300_DDR_256M  &&  PRX300_TOS_128M )
	default "0xFF003F00" if ( PRX300_DDR_512M  &&  PRX300_TOS_16M )
	default "0xFE003E00" if ( PRX300_DDR_512M  &&  PRX300_TOS_32M )
	default "0xFC003C00" if ( PRX300_DDR_512M  &&  PRX300_TOS_64M )
	default "0xF8003800" if ( PRX300_DDR_512M  &&  PRX300_TOS_128M )
	default "0xFF005F00" if ( PRX300_DDR_1G  &&  PRX300_TOS_16M )
	default "0xFE005E00" if ( PRX300_DDR_1G  &&  PRX300_TOS_32M )
	default "0xFC005C00" if ( PRX300_DDR_1G  &&  PRX300_TOS_64M )
	default "0xF8005800" if ( PRX300_DDR_1G  &&  PRX300_TOS_128M )
endmenu

menu "CPU and DDR Settings"

config A1_PRX300
	bool "A1 PRX300"
	default y
	help
	  Choose this option for A1 PRX300 builds. This
	  builds the U-boot with the software fixes in A1 chips.

config PRE_CONFIG_DDR
	bool "Use Pre-defined DDR configuration file"
	help
	  Use self-generated DDR/CPU settings.

if ( PRE_CONFIG_DDR )
config PRX300_DDR_CONFIG_FILE
	string "ddr config file path"
	default "board/lantiq/prx300/ddr.conf"
endif

if ( !PRE_CONFIG_DDR )
choice
	prompt "Choose CPU/DDR Modes --> "

config NORMAL_MODE
	bool "Normal power mode"
	depends on LTQ_BOOT_FROM_NAND || !A1_PRX300 
	select A1_FIX if ( A1_PRX300 )
	help
	  Choose this for SFP+ module configuration. CPU will be running at
	  800Mhz and DDR running at 533 Mhz (DDR4), 400Mhz (LPDDR3)

config SFP_MODE
	bool "Low power SFP mode"
	depends on LTQ_BOOT_FROM_NAND || !A1_PRX300
	select A1_FIX if ( A1_PRX300 )
	help
	  Choose this for SFP+ module configuration. VCO is reduced to support
	  CPU running at 480Mhz and DDR running at 466Mhz (DDR4) or 400Mhz (LPDDR3).

endchoice

if ( SFP_MODE || NORMAL_MODE )
choice
	prompt "DDR Type"

config DDR4
	bool "DDR4"

config DDR3
	bool "DDR3"

config LPDDR3
	bool "LPDDR3"

endchoice
endif

config DDR_DIR
	string
	default "ddr4" if DDR4
	default "ddr3" if DDR3
	default "lpddr3" if LPDDR3
endif

config A1_FIX
	bool "A1 boot work-around"
	depends on ( LTQ_BOOT_FROM_NAND ) 
	default y
	help
	  Set this for A1 chip builds on NAND flash

config FIX_OFFSET_IN_FLASH
	hex "Woarkaround binary location in flash"
	depends on A1_FIX
	default 0x2800
	help 
	  Where in flash the location of the work-around binary for A1 chips
	  is located

endmenu

menu "PRX300 Switch Configurations"

choice
	prompt "Connected PHY"

config PRX300_EXTERNAL_PHY
	bool "PRX300 connected to EXTERNAL PHY"

config PRX300_GSWIP_CORE
	bool "PRX300 connected to Internal GSWIP"

endchoice

if PRX300_GSWIP_CORE
config PRX300_GPHY_FW_EMBEDDED
    bool "gphy firmware embedded"
    default y

config PRX300_GPHY_FW_ADDR
    hex "GPHY FW pad size + BOOTSTRAP_TEXT_BASE"
    default "0xa0220000" if ( LTQ_BOOT_FROM_SPI || LTQ_BOOT_FROM_QSPI )
    default "0xa022A000" if ( LTQ_BOOT_FROM_NAND )
    depends on PRX300_GPHY_FW_EMBEDDED

config PRX300_EXTERN_GPHY_FW_ADDR
    hex "gphy firmware address"
    default "0x180000"
    depends on !PRX300_GPHY_FW_EMBEDDED

endif

if PRX300_EXTERNAL_PHY
	config SERDES_PRE0
	hex "serdes0 tx pre value"
	default "0x14"

	config SERDES_POST0
	hex "serdes0 tx post value"
	default "0x14"

	config SERDES_MAIN0
	hex "serdes0 tx main value"
	default "0x1E"

	config SERDES_PRE1
	hex "serdes1 tx pre value"
	default "0x0"

	config SERDES_POST1
	hex "serdes1 tx post value"
	default "0x0"

	config SERDES_MAIN1
	hex "serdes1 tx main value"
	default "0x28"

	config SERDES_PRE2
	hex "serdes2 tx pre value"
	default "0x0"

	config SERDES_POST2
	hex "serdes2 tx post value"
	default "0x0"

	config SERDES_MAIN2
	hex "serdes2 tx main value"
	default "0x28"
endif

endmenu
```

## board/vbg400/Kconfig
```kconfig
#
# For a description of the syntax of this configuration file,
# see Linux Documentation
#
#

config DRIVER_VBG400
	bool "VBG400"
	default y

config VBG400_DDR_8BIT
	bool "8Bit DDR RAM"
	default n

config VBG400_MAC_GMAC_INDEX
	int "GMAC Index 0/1"
	default 0

config VBG400_MAC_INTERFACE_MODE
	int "Interface mode: 0=mii_gmii, 1=rgmii, 2=rmii"
	default 1

config MAC_MODE_REVERSED
	int "compile for REVERSED MODE"
	default 0

config VBG400_CHIPIT
	bool "compile for CHIPIT"
	default n

config VBG400_EVB
	bool "compile for evaluation board"
	default n

config MAC_DIV_CLOCK
	int "select div clock for MAC, 1 for PLL2, 0 for other"
	default 0

config VBG400_PHY_ADDR_GMAC_0
	int "select PHY address for GMAC0"
	default 0

config VBG400_PHY_ADDR_GMAC_1
	int "select PHY address for GMAC1"
	default 5
```

## board/zyxel/gx5502/Kconfig
```kconfig
if TARGET_ZYXEL_GX5502

config SYS_BOARD
	default "gx5502"

config SYS_VENDOR
	default "zyxel"

config SYS_CONFIG_NAME
	default "gx5502"

endif

if TARGET_ZYXEL_GX3502

config SYS_BOARD
	default "gx5502"

config SYS_VENDOR
	default "zyxel"

config SYS_CONFIG_NAME
	default "gx3502"

endif
```

## common/Kconfig
```kconfig
menu "Supported commands"

config CMD_AUTH
     bool "auth & auth_img & auth_initrd"
     default n
     depends on DRIVER_GRX500

config CMD_BDI
     bool "bdinfo"
	 
config CMD_BEDBUG
     bool "bedbug"

config CMD_BMP
     bool "bmp"

config CMD_BOOT_TOS
	bool "boot tos"
	default n
	depends on DRIVER_GRX500

config CMD_CACHE
     bool "cache"

config CMD_CHKSET
	 bool "chkset"

config CMD_CONSOLE
     bool "console"
	 
config CMD_DATE
     bool "date"

config CMD_SETGETDCR
     bool "dcr"

config CMD_DIAG
     bool "diag"

config CMD_DOC
     bool "doc"

config CMD_DTT
     bool "dtt"

config CMD_DISPLAY
     bool "display"

config CMD_ECHO
     bool "echo"
	 default y

config CMD_EEPROM
     bool "eeprom"
	 depends on SPI_EEPROM

config CMD_ELF
     bool "elf"

config CMD_EXT2
     bool "ext2"

config CMD_FAT
     bool "fat"

config CMD_FDC
     bool "fdc"

config OF_LIBFDT
     bool "libfdt"

config SYS_BOOTMAPSZ
     hex "SYS_BOOTMAPSZ"
     depends on OF_LIBFDT

config CMD_LOADB
     bool "loadb"

config CMD_LOADS
	 bool "loads"

config CMD_FDOS
     bool "fdos"

config CMD_FLASH
     bool "flash"
     depends on NOR_FLASH
config CMD_FPGA
     bool "fpga"

config CMD_HTTPD
     bool "httpd"

config CMD_I2C
     bool "i2c"

config CMD_IDE
     bool "ide"

config CMD_IMMAP
     bool "immap"

config CMD_ITEST
     bool "itest"

config CMD_JFFS2
     bool "jffs2"

config CMD_LOGBUFFER
     bool "log"

config CMD_MEMORY
     bool "mem"
     default y

config MII
     bool "miibase"
     default y

config CMD_MII
     bool "mii"
     depends on MII

config CMD_MTDPARTS
     bool "mtdparts"

config MTD_DEVICE
     bool
	 default y
	 depends on CMD_MTDPARTS
	 
config MTD_PARTITIONS
     bool
	 default y
	 depends on CMD_MTDPARTS
			   

config PHY_GIGE
     bool "MII gphy detection"
	 depends on MII

config CMD_MISC
     bool "misc"

config CMD_MMC
     bool "mmc"

config CMD_NAND
     bool "nand"
	 depends on NAND_FLASH
	 
config CMD_NET
     bool "net"
     default y

config CMD_PCI
     bool "pci"

config CMD_PCMCIA
     bool "pcmcia"

config CMD_PING
     bool "ping"

config CMD_PORTIO
     bool "portio"

config CMD_REGINFO
     bool "reginfo"

config CMD_RUN
	 bool "run"
     default y

config CMD_ROT
     bool "rot"
	 depends on DRIVER_GRX500 && MANUBOOT_OTP_SUPPORT

config CMD_SAVEENV
     bool "saveenv"
	 default y
	 
config CMD_SAVES
     bool "saves"
	 depends on CMD_LOADS

config CMD_SF
     bool "sf"
     depends on SPI_FLASH 

config CMD_SCSI
     bool "scsi"

config CMD_SOURCE
     bool "source"

config CMD_SPI
     bool "spi"

config CMD_UBI
	 bool "ubi"

config UBI_WL_THRESHOLD
     int "UBI wear-leveling threshold"
	 default 4096
     depends on CMD_UBI

config CMD_UBIFS
     bool "ubifs"

config CMD_UNIVERSE
     bool "universe"

config CMD_UPGRADE
     bool "upgrade"
	 default y
     depends on !ENV_IS_NOWHERE

config CMD_USB
     bool "usb"

config USB_STORAGE
     bool "usb storage"
     depends on CMD_USB
	 
config CMD_VFD
     bool "vfd"

config CMD_KGDB
     bool "kgdb"

config CMD_LCD
     bool "lcd"

config CMD_WDT
     bool "wdt"

config LANTIQ_WATCHDOG
     bool
	 depends on CMD_WDT
	 default y

config YAFFS2
     bool "YAFFS2"
	 
endmenu

config SYS_HUSH_PARSER
    bool "Hush Parser"
       default n

config SYS_PROMPT_HUSH_PS2
    string "Hush PS2 Prompt"
       default "> "
       depends on SYS_HUSH_PARSER
```

## configs/ar10_defconfig
```kconfig
CONFIG_HAVE_GENERIC_BOARD=y
CONFIG_SYS_GENERIC_BOARD=y
CONFIG_MIPS=y
CONFIG_SYS_ARCH="mips"
CONFIG_SYS_CPU="mips32"
CONFIG_SYS_SOC="ar10"
CONFIG_SYS_VENDOR="lantiq"
CONFIG_SYS_BOARD="ar10"
CONFIG_SYS_CONFIG_NAME="ar10"
CONFIG_SPL_SYS_MALLOC_SIMPLE=y
CONFIG_SYS_TEXT_BASE=0xA0400000
CONFIG_LANTIQ=y
CONFIG_LANTIQ_UBOOT_ar10=y
CONFIG_LANTIQ_UART=y
CONFIG_LTQ_BOOT_FROM_NAND=y
CONFIG_NAND_U_BOOT=y
CONFIG_ENV_IS_IN_NAND=y
CONFIG_RAM_TEXT_BASE=0xA0400000
CONFIG_BOOTSTRAP_TEXT_BASE=0x80100000
CONFIG_OS_LZMA=y
CONFIG_IFX_MEMORY_SIZE=64
CONFIG_BAUDRATE=115200
CONFIG_NAND_FLASH=y
CONFIG_NAND_LANTIQ=y
CONFIG_NAND_ECC_HW_REED_SOLOMON=y
CONFIG_NAND_HW_ECC_SPARE_AREA=y
CONFIG_NAND_ECC_HW_4BYTES=y
CONFIG_MLC_NAND_HEADER_NUMBER=1
CONFIG_NAND_ECC_HW=y
CONFIG_NAND_FLASH_512M=y
CONFIG_NAND_FLASH_SIZE=512
CONFIG_NAND_PAGE_SIZE=0x2000
CONFIG_NAND_BLOCK_SIZE=0x200000
CONFIG_TUNE_DDR=y
CONFIG_DDR_TUNING_TEXT_BASE=0xbe1a0000
CONFIG_AR10_DDR2=y
CONFIG_AR10_CRYSTAL_36M=y
# CONFIG_AR10_CPU_300M_RAM_300M is not set
CONFIG_AR10_CPU_600M_RAM_300M=y
CONFIG_AR10_SYS_CLOCK_600M=y
CONFIG_AR10_PPE_FREQ_400M=y
CONFIG_AR10_SW_PORT_0=y
CONFIG_AR10_SW_PORT0_RGMII_MAC=y
CONFIG_AR10_SW_PORT0_MIIMODE=4
CONFIG_AR10_SW_PORT0_MIIRATE_AUTO=y
CONFIG_AR10_SW_PORT0_MIIRATE=4
CONFIG_AR10_SW_PORT_1=y
CONFIG_AR10_SW_PORT1_RGMII_MAC=y
CONFIG_AR10_SW_PORT1_MIIMODE=4
CONFIG_AR10_SW_PORT1_MIIRATE_AUTO=y
CONFIG_AR10_SW_PORT1_MIIRATE=4
CONFIG_AR10_SW_PORT_2=y
CONFIG_AR10_SW_PORT2_GMII=y
# CONFIG_AR10_SW_PORT2_MII is not set
CONFIG_AR10_SW_PORT2_MIIRATE=4
CONFIG_AR10_SW_PORT2_MIIMODE=1
CONFIG_AR10_SW_PORT_4=y
CONFIG_AR10_SW_PORT4_GMII=y
CONFIG_AR10_SW_PORT4_MIIRATE=4
CONFIG_AR10_SW_PORT4_MIIMODE=1
CONFIG_AR10_SW_PORT_5a=y
CONFIG_AR10_SW_PORT5a_RGMII=y
CONFIG_AR10_SW_PORT5a_MIIMODE=4
CONFIG_AR10_SW_PORT5a_MIIRATE=4
# CONFIG_AR10_GPHY_CLK_36M is not set
CONFIG_AR10_GPHY_CLK_25M=y
CONFIG_AR10_EXTERNAL_GPHY_INTERNAL=y
CONFIG_AR10_PROGRAM_AFE_FUSE=y
CONFIG_ENV_SIZE=0x4000
CONFIG_ENV_REDUND=y
CONFIG_SUPPORT_SPL=y
CONFIG_SPL=y
CONFIG_EXT_SPL_PATH="arch/mips/mach-lantiq/ar10/nand_spl"
CONFIG_NAND_BOOT=y
CONFIG_CMD_NET=y
CONFIG_CMD_UBI=y
CONFIG_BCH=y
CONFIG_CMD_SAVEENV=y
CONFIG_CMD_BOOTM=y
CONFIG_CMD_GO=y
CONFIG_CMD_RUN=y
# CONFIG_CMD_BOOTD is not set
# CONFIG_CMD_BOOTZ is not set
# CONFIG_CMD_ELF is not set
# CONFIG_CMD_IMI is not set
# CONFIG_CMD_IMLS is not set
# CONFIG_CMD_XIMG is not set
CONFIG_CMD_BOOT_TOS=y
# CONFIG_CMD_NFS is not set
# CONFIG_CMD_FPGA is not set
# CONFIG_CMD_FLASH is not set
# CONFIG_CMD_LOADS is not set
# CONFIG_CMD_ITEST is not set
# CONFIG_CMD_SOURCE is not set
# CONFIG_CMD_SETEXPR is not set
```

## configs/easy50712_ram_defconfig
```kconfig
CONFIG_MIPS=y
CONFIG_SYS_TEXT_BASE=0x80100000
CONFIG_ENV_SIZE=0x2000
CONFIG_DM_GPIO=y
CONFIG_NR_DRAM_BANKS=1
CONFIG_DEBUG_UART_BASE=0xbe100c00
CONFIG_DEBUG_UART_CLOCK=166666666
CONFIG_ARCH_INTEL_XWAY=y
# CONFIG_MIPS_BOOT_CMDLINE_LEGACY is not set
# CONFIG_MIPS_BOOT_ENV_LEGACY is not set
CONFIG_MIPS_BOOT_FDT=y
CONFIG_DEBUG_UART=y
CONFIG_DEFAULT_DEVICE_TREE="intel,easy50712"
# CONFIG_SYS_MALLOC_CLEAR_ON_INIT is not set
CONFIG_FIT=y
CONFIG_FIT_VERBOSE=y
CONFIG_OF_STDOUT_VIA_ALIAS=y
CONFIG_HUSH_PARSER=y
CONFIG_SYS_PROMPT="EASY50712 # "
CONFIG_CMD_LICENSE=y
# CONFIG_CMD_BOOTD is not set
# CONFIG_CMD_BOOTM is not set
# CONFIG_CMD_ELF is not set
# CONFIG_CMD_XIMG is not set
# CONFIG_CMD_EXPORTENV is not set
# CONFIG_CMD_IMPORTENV is not set
# CONFIG_CMD_EDITENV is not set
# CONFIG_CMD_SAVEENV is not set
# CONFIG_CMD_ENV_EXISTS is not set
# CONFIG_CMD_CRC32 is not set
CONFIG_CMD_MEMINFO=y
CONFIG_CMD_GPIO=y
# CONFIG_CMD_LOADB is not set
# CONFIG_CMD_LOADS is not set
# CONFIG_CMD_NET is not set
# CONFIG_CMD_MISC is not set
CONFIG_OF_LIVE=y
# CONFIG_DM_DEVICE_REMOVE is not set
# CONFIG_OF_TRANSLATE is not set
CONFIG_CLK_XWAY=y
CONFIG_XWAY_GPIO=y
CONFIG_INTEL_XWAY_STP=y
CONFIG_PINCTRL=y
# CONFIG_PINCTRL_GENERIC is not set
CONFIG_DM_SERIAL=y
CONFIG_DEBUG_UART_ANNOUNCE=y
CONFIG_DEBUG_UART_SKIP_INIT=y
CONFIG_INTEL_XWAY_SERIAL=y
```

## configs/easy5502_nand_defconfig
```kconfig
CONFIG_MIPS=y
CONFIG_SPL_SYS_MALLOC_SIMPLE=y
CONFIG_ARCH_LANTIQ=y
CONFIG_LANTIQ_DDR_GRADE_800_11=y
CONFIG_LANTIQ_DDR_DENSITY_256_16=y
CONFIG_LANTIQ_DDR_AL_CL1=y
CONFIG_LANTIQ_DDR_CTRL_CLK_400=y
CONFIG_LANTIQ_CPS_CLK_1000=y
CONFIG_LANTIQ_CBM_CLK_600=y
CONFIG_LANTIQ_BOOTROM_BCH_STRENGTH_8=y
CONFIG_MIPS_BOOT_FDT=y
# CONFIG_SYS_MALLOC_CLEAR_ON_INIT is not set
CONFIG_SPL=y
CONFIG_FIT=y
CONFIG_FIT_VERBOSE=y
CONFIG_NAND_BOOT=y
CONFIG_HUSH_PARSER=y
CONFIG_SYS_PROMPT="U-Boot # "
# CONFIG_CMD_CONSOLE is not set
# CONFIG_CMD_BOOTD is not set
# CONFIG_CMD_ELF is not set
# CONFIG_CMD_IMLS is not set
# CONFIG_CMD_XIMG is not set
# CONFIG_CMD_EXPORTENV is not set
# CONFIG_CMD_IMPORTENV is not set
CONFIG_CMD_GREPENV=y
# CONFIG_CMD_CRC32 is not set
# CONFIG_CMD_LOADB is not set
# CONFIG_CMD_LOADS is not set
# CONFIG_CMD_FLASH is not set
CONFIG_CMD_NAND=y
# CONFIG_CMD_FPGA is not set
CONFIG_CMD_GPIO=y
# CONFIG_CMD_SOURCE is not set
# CONFIG_CMD_SETEXPR is not set
CONFIG_CMD_DHCP=y
# CONFIG_CMD_NFS is not set
CONFIG_CMD_MII=y
CONFIG_CMD_PING=y
CONFIG_CMD_DNS=y
CONFIG_CMD_LINK_LOCAL=y
# CONFIG_CMD_MISC is not set
CONFIG_NET_RANDOM_ETHADDR=y
CONFIG_NAND_LANTIQ=y
CONFIG_NAND_LANTIQ_CS0=y
CONFIG_NAND_LANTIQ_CS0_GPIO=y
CONFIG_NAND_LANTIQ_CS0_GPIO_NUM=8
CONFIG_NAND_LANTIQ_CS1_ECC_NONE=y
CONFIG_NETDEVICES=y
CONFIG_XRX500_ETH=y
CONFIG_FW_INTEL_XRX500_PHY11G=y
# CONFIG_REGEX is not set
CONFIG_OF_LIBFDT=y
CONFIG_LIB_SPHAIRON=y
CONFIG_SPHAIRON_ETL_NAND=y
CONFIG_SPHAIRON_UBI_SUPPORT=y
CONFIG_SPHAIRON_UGW_CALIBRATION=y
```
