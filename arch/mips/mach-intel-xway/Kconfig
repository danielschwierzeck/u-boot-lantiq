## configs/grx390_defconfig
```kconfig
CONFIG_HAVE_GENERIC_BOARD=y
CONFIG_SYS_GENERIC_BOARD=y
CONFIG_MIPS=y
CONFIG_SYS_ARCH="mips"
CONFIG_SYS_CPU="mips32"
CONFIG_SYS_SOC="ar10"
CONFIG_SYS_VENDOR="lantiq"
CONFIG_SYS_BOARD="ar10"
CONFIG_SYS_CONFIG_NAME="ar10"
CONFIG_SPL_SYS_MALLOC_SIMPLE=y
CONFIG_LANTIQ=y
CONFIG_LANTIQ_UBOOT_grx390=y
CONFIG_DRIVER_AR10=y
CONFIG_DRIVER_GRX390=y
CONFIG_SYS_TEXT_BASE=0xA0400000
CONFIG_LANTIQ_UART=y
CONFIG_LTQ_BOOT_FROM_NAND=y
CONFIG_ENV_IS_IN_NAND=y
CONFIG_NAND_U_BOOT=y
CONFIG_OS_LZMA=y
CONFIG_IFX_MEMORY_SIZE=256
CONFIG_BAUDRATE=115200
CONFIG_NAND_FLASH=y
CONFIG_NAND_LANTIQ=y
CONFIG_NAND_ECC_SOFT=y
CONFIG_NAND_FLASH_64M=y
CONFIG_NAND_FLASH_SIZE=64
CONFIG_NAND_PAGE_SIZE=0x200
CONFIG_NAND_BLOCK_SIZE=0x4000
CONFIG_NAND_SPL_BLOCK_SIZE=0x4000
CONFIG_TUNE_DDR=y
CONFIG_DDR_TUNING_TEXT_BASE=0xbe1a0000
CONFIG_AR10_DDR2=y
CONFIG_AR10_CRYSTAL_36M=y
CONFIG_GRX390_CPU_720M_RAM_360M=y
CONFIG_GRX390_SYS_CLOCK_720M=y
CONFIG_AR10_PPE_FREQ_400M=y
CONFIG_AR10_SW_PORT_0=y
CONFIG_AR10_SW_PORT0_RGMII_MAC=y
CONFIG_AR10_SW_PORT0_MIIMODE=4
CONFIG_AR10_SW_PORT0_MIIRATE_AUTO=y
CONFIG_AR10_SW_PORT0_MIIRATE=4
CONFIG_AR10_SW_PORT_1=y
CONFIG_AR10_SW_PORT1_RGMII_MAC=y
CONFIG_AR10_SW_PORT1_MIIMODE=4
CONFIG_AR10_SW_PORT1_MIIRATE_AUTO=y
CONFIG_AR10_SW_PORT1_MIIRATE=4
CONFIG_AR10_SW_PORT_2=y
CONFIG_AR10_SW_PORT2_GMII=y
# CONFIG_AR10_SW_PORT2_MII is not set
CONFIG_AR10_SW_PORT2_MIIRATE=4
CONFIG_AR10_SW_PORT2_MIIMODE=1
CONFIG_GRX390_SW_PORT_3b=y
CONFIG_GRX390_SW_PORT3b_GMII=y
CONFIG_GRX390_SW_PORT3b_MIIRATE=4
CONFIG_GRX390_SW_PORT3b_MIIMODE=1
CONFIG_AR10_SW_PORT_4=y
CONFIG_AR10_SW_PORT4_GMII=y
CONFIG_AR10_SW_PORT4_MIIRATE=4
CONFIG_AR10_SW_PORT4_MIIMODE=1
CONFIG_AR10_SW_PORT_5a=y
CONFIG_AR10_SW_PORT5a_RGMII=y
CONFIG_AR10_SW_PORT5a_MIIMODE=4
CONFIG_AR10_SW_PORT5a_MIIRATE=4
CONFIG_AR10_GPHY_CLK_25M=y
CONFIG_AR10_EXTERNAL_GPHY_INTERNAL=y
CONFIG_DISABLE_SINGLE_ENDED_CLK_GPHY2=y
CONFIG_SUPPORT_SPL=y
CONFIG_SPL=y
CONFIG_EXT_SPL_PATH="arch/mips/mach-lantiq/ar10/nand_spl"
CONFIG_NAND_BOOT=y
CONFIG_CMD_NET=y
CONFIG_CMD_UBI=y
CONFIG_BCH=y
CONFIG_CMD_SAVEENV=y
CONFIG_CMD_BOOTM=y
CONFIG_CMD_GO=y
CONFIG_CMD_RUN=y
# CONFIG_CMD_BOOTD is not set
# CONFIG_CMD_BOOTZ is not set
# CONFIG_CMD_ELF is not set
# CONFIG_CMD_IMI is not set
# CONFIG_CMD_IMLS is not set
# CONFIG_CMD_XIMG is not set
CONFIG_CMD_BOOT_TOS=y
# CONFIG_CMD_NFS is not set
# CONFIG_CMD_FPGA is not set
# CONFIG_CMD_FLASH is not set
# CONFIG_CMD_LOADS is not set
# CONFIG_CMD_ITEST is not set
# CONFIG_CMD_SOURCE is not set
# CONFIG_CMD_SETEXPR is not set
```

## configs/grx500_defconfig
```kconfig
CONFIG_HAVE_GENERIC_BOARD=y
CONFIG_SYS_GENERIC_BOARD=y
CONFIG_MIPS=y
CONFIG_SYS_ARCH="mips"
CONFIG_SYS_SOC="grx500"
CONFIG_SYS_VENDOR="lantiq"
CONFIG_SYS_BOARD="grx500"
CONFIG_SYS_CONFIG_NAME="grx500"
CONFIG_SYS_TEXT_BASE=0xA0400000
CONFIG_SPL_SYS_MALLOC_SIMPLE=y
CONFIG_LANTIQ=y
CONFIG_LANTIQ_UBOOT_grx500=y
CONFIG_LANTIQ_UART=y
CONFIG_NAND_U_BOOT=y
CONFIG_OS_LZMA=y
CONFIG_NAND_BOOT=y
CONFIG_IFX_MEMORY_SIZE=224
CONFIG_BAUDRATE=115200
CONFIG_NAND_FLASH=y
CONFIG_NAND_LANTIQ=y
CONFIG_NAND_ECC_BCH=y
CONFIG_BCH_4BITS=y
CONFIG_BCH_CONT_T=7
CONFIG_SPL_OOBSIZE=64
CONFIG_NAND_FLASH_128M=y
CONFIG_NAND_FLASH_SIZE=128
CONFIG_NAND_PAGE_SIZE=0x800
CONFIG_NAND_BLOCK_SIZE=0x20000
CONFIG_NAND_SPL_BLOCK_SIZE=0xA000
CONFIG_DRIVER_GRX500=y
CONFIG_GRX500_A21=y
CONFIG_BOARD_EASY350=y
CONFIG_GRX500_ROM_HEADER_BCH_CAP=8
CONFIG_TOS_32M=y
CONFIG_DDR_512M=y
CONFIG_NETWORK_VIA_LAN=y
CONFIG_GRX500_GPHY_FW_EMBEDDED=y
CONFIG_ENV_REDUND=y
CONFIG_ENV_OVERWRITE=y
CONFIG_SUPPORT_SPL=y
CONFIG_SPL=y
CONFIG_EXT_SPL_PATH="arch/mips/mach-lantiq/grx500/nand_spl"
CONFIG_CMD_NET=y
CONFIG_CMD_UBI=y
CONFIG_BCH=y
CONFIG_CMD_SAVEENV=y
CONFIG_CMD_BOOTM=y
CONFIG_CMD_GO=y
CONFIG_CMD_RUN=y
# CONFIG_CMD_BOOTD is not set
# CONFIG_CMD_BOOTZ is not set
# CONFIG_CMD_ELF is not set
# CONFIG_CMD_IMI is not set
# CONFIG_CMD_IMLS is not set
# CONFIG_CMD_XIMG is not set
CONFIG_CMD_BOOT_TOS=y
# CONFIG_CMD_NFS is not set
# CONFIG_CMD_FPGA is not set
# CONFIG_CMD_FLASH is not set
# CONFIG_CMD_LOADS is not set
# CONFIG_CMD_ITEST is not set
# CONFIG_CMD_SOURCE is not set
# CONFIG_CMD_SETEXPR is not set
```

## configs/gx5502_uart_defconfig
```kconfig
CONFIG_MIPS=y
CONFIG_ARCH_LANTIQ=y
CONFIG_TARGET_ZYXEL_GX5502=y
CONFIG_LANTIQ_DDR_GRADE_800_11=y
CONFIG_LANTIQ_DDR_DENSITY_512_16=y
CONFIG_LANTIQ_DDR_AL_CL1=y
CONFIG_LANTIQ_DDR_CTRL_CLK_400=y
CONFIG_LANTIQ_CPS_CLK_1000=y
CONFIG_LANTIQ_CBM_CLK_2400=y
# CONFIG_MIPS_BOOT_CMDLINE_LEGACY is not set
# CONFIG_MIPS_BOOT_ENV_LEGACY is not set
# CONFIG_SYS_MALLOC_CLEAR_ON_INIT is not set
CONFIG_UART_BOOT=y
CONFIG_HUSH_PARSER=y
CONFIG_SYS_PROMPT="U-Boot # "
# CONFIG_AUTOBOOT is not set
# CONFIG_CMD_BDI is not set
# CONFIG_CMD_CONSOLE is not set
# CONFIG_CMD_BOOTD is not set
# CONFIG_CMD_BOOTM is not set
# CONFIG_CMD_ELF is not set
# CONFIG_CMD_IMI is not set
# CONFIG_CMD_IMLS is not set
# CONFIG_CMD_XIMG is not set
# CONFIG_CMD_EXPORTENV is not set
# CONFIG_CMD_IMPORTENV is not set
# CONFIG_CMD_EDITENV is not set
# CONFIG_CMD_SAVEENV is not set
# CONFIG_CMD_ENV_EXISTS is not set
# CONFIG_CMD_CRC32 is not set
# CONFIG_CMD_LOADB is not set
# CONFIG_CMD_LOADS is not set
# CONFIG_CMD_FLASH is not set
CONFIG_CMD_NAND=y
# CONFIG_CMD_FPGA is not set
CONFIG_CMD_GPIO=y
# CONFIG_CMD_SOURCE is not set
# CONFIG_CMD_SETEXPR is not set
# CONFIG_CMD_NFS is not set
CONFIG_CMD_MII=y
CONFIG_CMD_PING=y
# CONFIG_CMD_MISC is not set
CONFIG_LANTIQ_SSO_SHR_COUNT=2
CONFIG_NAND_LANTIQ=y
CONFIG_NAND_LANTIQ_CS0=y
CONFIG_NAND_LANTIQ_CS0_GPIO=y
CONFIG_NAND_LANTIQ_CS0_GPIO_NUM=8
CONFIG_NAND_LANTIQ_CS1_ECC_NONE=y
CONFIG_NETDEVICES=y
CONFIG_XRX500_ETH=y
CONFIG_FW_INTEL_XRX500_PHY11G=y
# CONFIG_REGEX is not set
CONFIG_LIB_SPHAIRON=y
CONFIG_SPHAIRON_ETL_NAND=y
CONFIG_SPHAIRON_ETL_WRITE_DISABLE=y
```

## configs/prx300-spi-nor_defconfig
```kconfig
CONFIG_HAVE_GENERIC_BOARD=y
CONFIG_SYS_GENERIC_BOARD=y
CONFIG_MIPS=y
CONFIG_SYS_ARCH="mips"
CONFIG_SYS_SOC="prx300"
CONFIG_SYS_VENDOR="lantiq"
CONFIG_SYS_BOARD="prx300"
CONFIG_SYS_CONFIG_NAME="prx300"
CONFIG_SPL_SYS_MALLOC_SIMPLE=y
CONFIG_LANTIQ=y
CONFIG_LANTIQ_UBOOT_prx300=y
CONFIG_SYS_TEXT_BASE=0xA0400000
CONFIG_SYS_DCACHE_SIZE=0
CONFIG_SYS_DCACHE_LINE_SIZE=0
CONFIG_SYS_ICACHE_SIZE=0
CONFIG_SYS_ICACHE_LINE_SIZE=0
CONFIG_SPI_BOOT=y
CONFIG_SPL=y
CONFIG_SPI_SPL_SIZE=0x6000
CONFIG_EXT_SPL_PATH="arch/mips/mach-lantiq/prx300/spi_spl"
CONFIG_IFX_MEMORY_SIZE=64
CONFIG_BAUDRATE=115200
CONFIG_LTQ_BOOT_FROM_SPI=y
CONFIG_SPI_FLASH_MACRONIX=y
CONFIG_SPI_FLASH_4M=y
CONFIG_LANTIQ_SPI=y
CONFIG_SF_DEFAULT_SPEED=22222222
CONFIG_SF_DEFAULT_MODE=0
CONFIG_DRIVER_PRX300=y
CONFIG_PRX300_USE_DDR_PRECONFIG=y
CONFIG_NON_STANDARD_MODE=y
CONFIG_PRX300_DDR_CONFIG_FILE="board/lantiq/prx300/ddr4/ddr4_2GB_2133mhz.conf"
CONFIG_PRX300_EXTERNAL_PHY=y
CONFIG_SPI_FLASH=y
CONFIG_SPI_FLASH_USE_4K_SECTORS=y
CONFIG_SUPPORT_OF_CONTROL=y
CONFIG_CMD_SAVEENV=y
CONFIG_CMD_BOOTM=y
CONFIG_CMD_GO=y
CONFIG_CMD_RUN=y
CONFIG_CMD_SF=y
# CONFIG_CMD_BOOTD is not set
# CONFIG_CMD_BOOTZ is not set
# CONFIG_CMD_ELF is not set
# CONFIG_CMD_IMI is not set
# CONFIG_CMD_IMLS is not set
# CONFIG_CMD_XIMG is not set
# CONFIG_CMD_NFS is not set
# CONFIG_CMD_FPGA is not set
# CONFIG_CMD_FLASH is not set
CONFIG_CMD_BOOT_TOS=y
# CONFIG_CMD_LOADS is not set
# CONFIG_CMD_ITEST is not set
# CONFIG_CMD_SOURCE is not set
# CONFIG_CMD_SETEXPR is not set
```
