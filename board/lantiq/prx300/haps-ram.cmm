SYStem.CPU MIPS4KEC 
SYStem.JTAGCLOCK 4MHz

SYSTEM.CPUACCESS Enable
SYSTEM.MEMACCESS CPU
SYStem.Option TURBO OFF
SYStem.Down

SYStem.CONFIG.IRPOST  25.
SYStem.CONFIG.DRPOST  5.
SYStem.CONFIG.IRPRE   0.
SYStem.CONFIG.DRPRE   0.
Core.Number 1.
SYStem.MODE NODEBUG
SYStem

SYStem.MODE ATTACH
break

D.S	0xb618005C	 %BE %Long 	0xFFFFFFFF
D.S	0xb49001d0	 %BE %Long 	0xf8002000
D.S	0xb49001d4	 %BE %Long 	0xf8002800
D.S	0xb49001d8	 %BE %Long 	0xfe00a000
D.S	0xb6100048	 %BE %Long 	0x20000000
D.S	0xb2100304	 %BE %Long 	0x1
D.S	0xb2100030	 %BE %Long 	0x1
wait 	10ms		
D.I	0xb2100004	 /Long 	
D.S	0xb2100000	 %BE %Long 	0xa1040010
D.S	0xb2100010	 %BE %Long 	0x5030
D.S	0xb2100014	 %BE %Long 	0x00027aa7
D.S	0xb210001c	 %BE %Long 	0x8a14d77a
D.S	0xb2100020	 %BE %Long 	0x6
D.S	0xb2100024	 %BE %Long 	0x81b2e5bf
D.S	0xb2100028	 %BE %Long 	0x1
D.S	0xb2100030	 %BE %Long 	0x0000000e
D.S	0xb2100034	 %BE %Long 	0x0000f100
D.S	0xb2100038	 %BE %Long 	0x0d4b0003
D.S	0xb2100050	 %BE %Long 	0x602010
D.S	0xb2100054	 %BE %Long 	0x0060002e
D.S	0xb2100060	 %BE %Long 	0x0
D.S	0xb2100064	 %BE %Long 	0x00a2806b
D.S	0xb21000c0	 %BE %Long 	0x0
D.S	0xb21000c4	 %BE %Long 	0x0
D.S	0xb21000d0	 %BE %Long 	0x20002
D.S	0xb21000d4	 %BE %Long 	0x30000
D.S	0xb21000d8	 %BE %Long 	0x0000d007
D.S	0xb21000dc	 %BE %Long 	0x0a400001
D.S	0xb21000e0	 %BE %Long 	0x200400
D.S	0xb21000e4	 %BE %Long 	0x100000
D.S	0xb21000e8	 %BE %Long 	0x400
D.S	0xb21000ec	 %BE %Long 	0x00000c00
D.S	0xb21000f0	 %BE %Long 	0x30
D.S	0xb21000f4	 %BE %Long 	0x000001a9
D.S	0xb2100100	 %BE %Long 	0x13140015
D.S	0xb2100104	 %BE %Long 	0x0004051f
D.S	0xb2100108	 %BE %Long 	0x0709050e
D.S	0xb210010c	 %BE %Long 	0x0000400c
D.S	0xb2100110	 %BE %Long 	0x9040509
D.S	0xb2100114	 %BE %Long 	0x7070404
D.S	0xb2100118	 %BE %Long 	0x0
D.S	0xb210011c	 %BE %Long 	0x707
D.S	0xb2100120	 %BE %Long 	0x30300000
D.S	0xb2100124	 %BE %Long 	0x0002040b
D.S	0xb210012c	 %BE %Long 	0x1109010e
D.S	0xb2100130	 %BE %Long 	0x8
D.S	0xb2100138	 %BE %Long 	0x0
D.S	0xb210013c	 %BE %Long 	0x0
D.S	0xb2100180	 %BE %Long 	0x41000040
D.S	0xb2100184	 %BE %Long 	0x70
D.S	0xb2100188	 %BE %Long 	0x0
D.S	0xb2100190	 %BE %Long 	0x0291820c
D.S	0xb2100194	 %BE %Long 	0x3020202
D.S	0xb2100198	 %BE %Long 	0x07d1a110
D.S	0xb210019c	 %BE %Long 	0x000000b1
D.S	0xb21001a0	 %BE %Long 	0x20400005
D.S	0xb21001a4	 %BE %Long 	0x810084
D.S	0xb21001a8	 %BE %Long 	0x0
D.S	0xb21001b0	 %BE %Long 	0x11
D.S	0xb21001c0	 %BE %Long 	0x1
D.S	0xb21001c4	 %BE %Long 	0x0
D.S	0xb2100200	 %BE %Long 	0x00001f13
D.S	0xb2100204	 %BE %Long 	0x003f0909
D.S	0xb2100208	 %BE %Long 	0x1010100
D.S	0xb210020c	 %BE %Long 	0x1010101
D.S	0xb2100210	 %BE %Long 	0x00000f0f
D.S	0xb2100214	 %BE %Long 	0x7070707
D.S	0xb2100218	 %BE %Long 	0x0f0f0f0f
D.S	0xb210021c	 %BE %Long 	0x00000f0f
D.S	0xb2100220	 %BE %Long 	0x00003f01
D.S	0xb2100224	 %BE %Long 	0x7070707
D.S	0xb2100228	 %BE %Long 	0x7070707
D.S	0xb210022c	 %BE %Long 	0x7
D.S	0xb2100240	 %BE %Long 	0x3130638
D.S	0xb2100244	 %BE %Long 	0x1120
D.S	0xb2100250	 %BE %Long 	0x1f401f04
D.S	0xb2100254	 %BE %Long 	0x0000003d
D.S	0xb2100264	 %BE %Long 	0x11002100
D.S	0xb210026c	 %BE %Long 	0xc400e5a7
D.S	0xb2100300	 %BE %Long 	0x10
D.S	0xb2100304	 %BE %Long 	0x0
D.S	0xb210030c	 %BE %Long 	0x0
D.S	0xb2100320	 %BE %Long 	0x1
D.S	0xb210036c	 %BE %Long 	0x100001
D.S	0xb2100400	 %BE %Long 	0x111
D.S	0xb2100404	 %BE %Long 	0x000062b2
D.S	0xb2100408	 %BE %Long 	0x0000022c
D.S	0xb210040c	 %BE %Long 	0x0
D.S	0xb2100490	 %BE %Long 	0x1
D.S	0xb2102020	 %BE %Long 	0x6
D.S	0xb2102024	 %BE %Long 	0x81b2e5bf
D.S	0xb2102050	 %BE %Long 	0x602010
D.S	0xb2102064	 %BE %Long 	0x00a2806b
D.S	0xb21020dc	 %BE %Long 	0x0a400001
D.S	0xb21020e0	 %BE %Long 	0x200400
D.S	0xb21020e8	 %BE %Long 	0x400
D.S	0xb21020ec	 %BE %Long 	0x00000c00
D.S	0xb2102100	 %BE %Long 	0x13140015
D.S	0xb2102104	 %BE %Long 	0x0004051f
D.S	0xb2102108	 %BE %Long 	0x0709050e
D.S	0xb210210c	 %BE %Long 	0x0000400c
D.S	0xb2102110	 %BE %Long 	0x9040509
D.S	0xb2102114	 %BE %Long 	0x7070404
D.S	0xb2102118	 %BE %Long 	0x0
D.S	0xb210211c	 %BE %Long 	0x707
D.S	0xb2102120	 %BE %Long 	0x30300000
D.S	0xb2102124	 %BE %Long 	0x0002040b
D.S	0xb210212c	 %BE %Long 	0x1109010e
D.S	0xb2102130	 %BE %Long 	0x8
D.S	0xb2102138	 %BE %Long 	0x0
D.S	0xb210213c	 %BE %Long 	0x0
D.S	0xb2102180	 %BE %Long 	0x41000040
D.S	0xb2102190	 %BE %Long 	0x0291820c
D.S	0xb2102194	 %BE %Long 	0x3020202
D.S	0xb2102240	 %BE %Long 	0x3130638
D.S	0xb2103020	 %BE %Long 	0x6
D.S	0xb2103024	 %BE %Long 	0x81b2e5bf
D.S	0xb2103050	 %BE %Long 	0x602010
D.S	0xb2103064	 %BE %Long 	0x00a2806b
D.S	0xb21030dc	 %BE %Long 	0x0a400001
D.S	0xb21030e0	 %BE %Long 	0x200400
D.S	0xb21030e8	 %BE %Long 	0x400
D.S	0xb21030ec	 %BE %Long 	0x00000c00
D.S	0xb2103100	 %BE %Long 	0x13140015
D.S	0xb2103104	 %BE %Long 	0x0004051f
D.S	0xb2103108	 %BE %Long 	0x0709050e
D.S	0xb210310c	 %BE %Long 	0x0000400c
D.S	0xb2103110	 %BE %Long 	0x9040509
D.S	0xb2103114	 %BE %Long 	0x7070404
D.S	0xb2103118	 %BE %Long 	0x0
D.S	0xb210311c	 %BE %Long 	0x707
D.S	0xb2103120	 %BE %Long 	0x30300000
D.S	0xb2103124	 %BE %Long 	0x0002040b
D.S	0xb210312c	 %BE %Long 	0x1109010e
D.S	0xb2103130	 %BE %Long 	0x8
D.S	0xb2103138	 %BE %Long 	0x0
D.S	0xb210313c	 %BE %Long 	0x0
D.S	0xb2103180	 %BE %Long 	0x41000040
D.S	0xb2103190	 %BE %Long 	0x0291820c
D.S	0xb2103194	 %BE %Long 	0x3020202
D.S	0xb2103240	 %BE %Long 	0x3130638
D.S	0xb2104020	 %BE %Long 	0x6
D.S	0xb2104024	 %BE %Long 	0x81b2e5bf
D.S	0xb2104050	 %BE %Long 	0x602010
D.S	0xb2104064	 %BE %Long 	0x00a2806b
D.S	0xb21040dc	 %BE %Long 	0x0a400001
D.S	0xb21040e0	 %BE %Long 	0x200400
D.S	0xb21040e8	 %BE %Long 	0x400
D.S	0xb21040ec	 %BE %Long 	0x00000c00
D.S	0xb2104100	 %BE %Long 	0x13140015
D.S	0xb2104104	 %BE %Long 	0x0004051f
D.S	0xb2104108	 %BE %Long 	0x0709050e
D.S	0xb210410c	 %BE %Long 	0x0000400c
D.S	0xb2104110	 %BE %Long 	0x9040509
D.S	0xb2104114	 %BE %Long 	0x7070404
D.S	0xb2104118	 %BE %Long 	0x0
D.S	0xb210411c	 %BE %Long 	0x707
D.S	0xb2104120	 %BE %Long 	0x30300000
D.S	0xb2104124	 %BE %Long 	0x0002040b
D.S	0xb210412c	 %BE %Long 	0x1109010e
D.S	0xb2104130	 %BE %Long 	0x8
D.S	0xb2104138	 %BE %Long 	0x0
D.S	0xb210413c	 %BE %Long 	0x0
D.S	0xb2104180	 %BE %Long 	0x41000040
D.S	0xb2104190	 %BE %Long 	0x0291820c
D.S	0xb2104194	 %BE %Long 	0x3020202
D.S	0xb2104240	 %BE %Long 	0x3130638
wait 	10ms		
D.I	0xb2100060	 /Long 	
D.S	0xb6100048	 %BE %Long 	0x0
D.S	0xb2100304	 %BE %Long 	0x0
wait 	10ms		
D.I	0xb2100030	 /Long 	
D.S	0xb2100030	 %BE %Long 	0x0000000c
D.S	0xb2100320	 %BE %Long 	0x0
D.S	0xb21001b0	 %BE %Long 	0x10
D.S	0xb2000090	 %BE %Long 	0x0020403b
D.S	0xb2000520	 %BE %Long 	0x0f000009
D.S	0xb2000524	 %BE %Long 	0x309
D.S	0xb2000710	 %BE %Long 	0x0e00003c
D.S	0xb2000810	 %BE %Long 	0x0e00003c
D.S	0xb2000910	 %BE %Long 	0x0e00003c
D.S	0xb2000a10	 %BE %Long 	0x0e00003c
D.S	0xb200052c	 %BE %Long 	0x0fc00172
D.S	0xb2000100	 %BE %Long 	0x0000040c
D.S	0xb2000088	 %BE %Long 	0x20c01884
D.S	0xb2000040	 %BE %Long 	0x53529a90
D.S	0xb2000044	 %BE %Long 	0x4116976e
D.S	0xb2000180	 %BE %Long 	0x00000a40
D.S	0xb2000184	 %BE %Long 	0x1
D.S	0xb2000188	 %BE %Long 	0x20
D.S	0xb200018c	 %BE %Long 	0x400
D.S	0xb2000190	 %BE %Long 	0x0
D.S	0xb2000194	 %BE %Long 	0x400
D.S	0xb2000198	 %BE %Long 	0x00000c00
D.S	0xb2000110	 %BE %Long 	0x092b120a
D.S	0xb2000114	 %BE %Long 	0x28280008
D.S	0xb2000118	 %BE %Long 	0x000703ff
D.S	0xb200011c	 %BE %Long 	0x02d60101
D.S	0xb2000120	 %BE %Long 	0x00d60808
D.S	0xb2000124	 %BE %Long 	0x003d120a
D.S	0xb2000014	 %BE %Long 	0x2004620
D.S	0xb2000018	 %BE %Long 	0x2000289d
D.S	0xb200001c	 %BE %Long 	0xc8aa0060
wait 	10ms		
D.I	0xb2000004	 /Long 	
D.S	0xb2000004	 %BE %Long 	0x40000011
wait 	10ms		
D.I	0xb2000034	 /Long 	
D.S	0xb2000004	 %BE %Long 	0x40001
wait 	10ms		
D.I	0xb2000034	 /Long 	
wait 	10ms		
D.I	0xb2000680	 /Long 	
D.S	0xb2000680	 %BE %Long 	0x04058f00
D.S	0xb20004dc	 %BE %Long 	0x0
D.S	0xb2000788	 %BE %Long 	0x000000a6
D.S	0xb2000888	 %BE %Long 	0x000000a6
D.S	0xb2000988	 %BE %Long 	0x000000a6
D.S	0xb2000a08	 %BE %Long 	0x000000a6
D.S	0xb20004dc	 %BE %Long 	0x10001
D.S	0xb2000788	 %BE %Long 	0x000000a6
D.S	0xb2000888	 %BE %Long 	0x000000a6
D.S	0xb2000988	 %BE %Long 	0x000000a6
D.S	0xb2000a08	 %BE %Long 	0x000000a6
D.S	0xb21001b0	 %BE %Long 	0x11
D.S	0xb2100320	 %BE %Long 	0x1
wait 	10ms		
D.I	0xb2100324	 /Long 	
wait 	10ms		
D.I	0xb2100004	 /Long 	
D.S	0xb2100030	 %BE %Long 	0x0000000c
D.S	0xb2100030	 %BE %Long 	0x0000000e
D.S	0xb2100490	 %BE %Long 	0x1
D.S	0xb2100030	 %BE %Long 	0x0000000e
D.S	0xb2100030	 %BE %Long 	0x0000000c
D.S	0xb2100020	 %BE %Long 	0x6
D.S	0xb2102020	 %BE %Long 	0x6
D.S	0xb2100060	 %BE %Long 	0x1


data.load /tmp2/leeya/u-boot
go 


