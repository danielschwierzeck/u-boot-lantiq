;********************************************************************
;Trace 32 script to load U-Boot software for HNX100	
;	
;********************************************************************
;Target DDR1, Clock Frequency 200Mhz
;********************************************************************
; Similar as "vrx200_ddr1_197.cmm" and NOT verified yet for HN1
; with same values as in hnx100_ddr1_200M_settings.h
;********************************************************************
; Target :
;********************************************************************

; Setup Lauterbach debugger for HNX100

;+++++++++++++++++++++++++++++++++++++++++++++++++++++++++++++++++++++		
; Initializing Debugger 
;+++++++++++++++++++++++++++++++++++++++++++++++++++++++++++++++++++++		

 print "Initialize Debugger..."
 wait 1s

 SYStem.down 
 SYStem.CPU MIPS34K 
 SYStem.Option Endianess Big
 SYStem.JtagClock 20.0MHz

 SYStem.Mode Down
 wait 1s
 SYStem.Mode NoDebug
 wait 1s
 SYStem.Mode Attach
 
 break
 print "Initialize Debugger...Done"
 wait 1s

;+++++++++++++++++++++++++++++++++++++++++++++++++++++++++++++++++++++		
;Initialize memory controller register		
;Pls refer to the documentation to change the necessary parameter to		
;Suit the DDR device you are using		
;+++++++++++++++++++++++++++++++++++++++++++++++++++++++++++++++++++++		

print "Initialize DDR controller..."		
data.set 0xBF401070 %long	0x0	; Put DDR controller inactive
;		
;DDR Register programming		
data.set 0xBF401000 %long	0x101	
data.set 0xBF401010 %long	0x1000101	
data.set 0xBF401020 %long	0x1010000	
data.set 0xBF401030 %long	0x100	
data.set 0xBF401040 %long	0x1000000	
data.set 0xBF401050 %long	0x1000101	
data.set 0xBF401060 %long	0x1000100
data.set 0xBF401070 %long	0x1010000
data.set 0xBF401080 %long	0x1000001	
data.set 0xBF401090 %long	0x0
data.set 0xBF4010A0 %long	0x2000100	
data.set 0xBF4010B0 %long	0x3000301
data.set 0xBF4010C0 %long	0x30000	
data.set 0xBF4010D0 %long	0x2020202	
data.set 0xBF4010E0 %long	0x5060A0F	
data.set 0xBF4010F0 %long	0x2000F
data.set 0xBF401100 %long	0x30000	
data.set 0xBF401110 %long	0x60102
data.set 0xBF401120 %long	0x3020002	
data.set 0xBF401130 %long	0x10102
data.set 0xBF401140 %long	0x6000000
data.set 0xBF401150 %long	0x30b0200
data.set 0xBF401160 %long	0x0
data.set 0xBF401170 %long	0x8030000
data.set 0xBF401180 %long	0xe03
data.set 0xBF401190 %long	0x0	
data.set 0xBF4011A0 %long	0x0	
data.set 0xBF4011B0 %long	0x320000	
data.set 0xBF4011C0 %long	0x0
data.set 0xBF4011D0 %long	0x0
data.set 0xBF4011E0 %long	0x36ec
data.set 0xBF4011F0 %long	0x0
data.set 0xBF401200 %long	0x0	
data.set 0xBF401210 %long	0x510000	
data.set 0xBF401220 %long	0x200C8	
data.set 0xBF401230 %long	0xE36B1	
data.set 0xBF401240 %long	0xC8
data.set 0xBF401250 %long	0x9C41
data.set 0xBF401260 %long	0x0
data.set 0xBF401270 %long	0x212004
data.set 0xBF401280 %long	0x212304
;data.set 0xBF401290 %long	0x210004
;data.set 0xBF4012A0 %long	0x210004
data.set 0xBF4012B0 %long	0x666304
data.set 0xBF4012C0 %long	0x666304
;data.set 0xBF4012D0 %long	0x660004
;data.set 0xBF4012E0 %long	0x660004
;data.set 0xBF4012F0 %long	0x0
;data.set 0xBF401300 %long	0x0
;data.set 0xBF401310 %long	0x0
;data.set 0xBF401320 %long	0x0
data.set 0xBF401330 %long	0x0
data.set 0xBF401340 %long	0x33	
data.set 0xBF401350 %long	0xF3014B26	
data.set 0xBF401360 %long	0xF3014B26	
;data.set 0xBF401370 %long	0xF3014B26	
;data.set 0xBF401380 %long	0xF3014B26	
data.set 0xBF401390 %long	0x7800301	
data.set 0xBF4013A0 %long	0x7800301
;data.set 0xBF4013B0 %long	0x7800301	
;data.set 0xBF4013C0 %long	0x7800301	
data.set 0xBF4013D0 %long	0x4	

;Enable memory controller and DDR		
data.set 0xBF401070 %long	0x1010100	; put DDR controller into active

wait 1s		

print "Initialize DDR controller...Done"
wait 1s		


print "Upload GPHY firmware"
wait 1s
data.set 0xA0110000 %long   0x27051956
data.set 0xA0110004 %long   0x1172B473
data.set 0xA0110008 %long   0x4E6702FE
data.set 0xA011000C %long   0x0000DC0C
data.set 0xA0110010 %long   0x00000000
data.set 0xA0110014 %long   0x00000000
data.set 0xA0110018 %long   0x943FCF00
data.set 0xA011001C %long   0x05050403
data.set 0xA0110020 %long   0x47504859
data.set 0xA0110024 %long   0x20466972
data.set 0xA0110028 %long   0x6D776172
data.set 0xA011002C %long   0x65000000
data.set 0xA0110030 %long   0x00000000
data.set 0xA0110034 %long   0x00000000
data.set 0xA0110038 %long   0x00000000
data.set 0xA011003C %long   0x00000000
data.set 0xA0110040 %long   0x0000DC04
data.set 0xA0110044 %long   0x00000000
data.set 0xA0110048 %long   0x5D000080
data.set 0xA011004C %long   0x00000104
data.set 0xA0110050 %long   0x00000000
data.set 0xA0110054 %long   0x00001381
data.set 0xA0110058 %long   0x3F3E4359
data.set 0xA011005C %long   0x0A8D4627
data.set 0xA0110060 %long   0xE9BB98CE
data.set 0xA0110064 %long   0x8935A279
data.set 0xA0110068 %long   0x6E2481C4
data.set 0xA011006C %long   0x554E177D
data.set 0xA0110070 %long   0x17DE205E
data.set 0xA0110074 %long   0xDF0F4DB2
data.set 0xA0110078 %long   0xC1C72B40
data.set 0xA011007C %long   0x09C3E61D
data.set 0xA0110080 %long   0x4DBAE2A7
data.set 0xA0110084 %long   0x6F474D39
data.set 0xA0110088 %long   0x2D4824C7
data.set 0xA011008C %long   0xDF696E60
data.set 0xA0110090 %long   0xEA4CC512
data.set 0xA0110094 %long   0xD0EB1887
data.set 0xA0110098 %long   0x80DB8FEA
data.set 0xA011009C %long   0x9E79BCE4
data.set 0xA01100A0 %long   0x42E12CEA
data.set 0xA01100A4 %long   0x69F392B8
data.set 0xA01100A8 %long   0x2F3CAE25
data.set 0xA01100AC %long   0xEE747F81
data.set 0xA01100B0 %long   0x17987991
data.set 0xA01100B4 %long   0xA8CB40AC
data.set 0xA01100B8 %long   0x071B4920
data.set 0xA01100BC %long   0xCF77B671
data.set 0xA01100C0 %long   0x69FE0F10
data.set 0xA01100C4 %long   0xC212927C
data.set 0xA01100C8 %long   0x4A12CF00
data.set 0xA01100CC %long   0xE28DC28D
data.set 0xA01100D0 %long   0x961735A7
data.set 0xA01100D4 %long   0xD14C609D
data.set 0xA01100D8 %long   0xE3A00110
data.set 0xA01100DC %long   0xF84352D6
data.set 0xA01100E0 %long   0x10475EA3
data.set 0xA01100E4 %long   0xD2FCBB7A
data.set 0xA01100E8 %long   0xC376300A
data.set 0xA01100EC %long   0xD10C3F1A
data.set 0xA01100F0 %long   0xF6616BE7
data.set 0xA01100F4 %long   0x3D247741
data.set 0xA01100F8 %long   0x86865975
data.set 0xA01100FC %long   0x1CA6412F
data.set 0xA0110100 %long   0x26682331
data.set 0xA0110104 %long   0xD6E0EDE8
data.set 0xA0110108 %long   0x07765D55
data.set 0xA011010C %long   0x98373E4B
data.set 0xA0110110 %long   0x4C799BF3
data.set 0xA0110114 %long   0xA09E008D
data.set 0xA0110118 %long   0x1E955FE6
data.set 0xA011011C %long   0xBC841F1C
data.set 0xA0110120 %long   0xCAF95EA7
data.set 0xA0110124 %long   0xA72CE417
data.set 0xA0110128 %long   0x48DCB376
data.set 0xA011012C %long   0x86FD077F
data.set 0xA0110130 %long   0x05654EEB
data.set 0xA0110134 %long   0x3EDB7D9C
data.set 0xA0110138 %long   0x5D17142D
data.set 0xA011013C %long   0x8164B699
data.set 0xA0110140 %long   0xE36503E7
data.set 0xA0110144 %long   0x00BE9556
data.set 0xA0110148 %long   0x871FE826
data.set 0xA011014C %long   0xD7503D64
data.set 0xA0110150 %long   0xD360E9A8
data.set 0xA0110154 %long   0xCC0C9F48
data.set 0xA0110158 %long   0x3BB8CD18
data.set 0xA011015C %long   0xCF28A350
data.set 0xA0110160 %long   0x3880F043
data.set 0xA0110164 %long   0x97B8060B
data.set 0xA0110168 %long   0x1CF75685
data.set 0xA011016C %long   0xD3CBD017
data.set 0xA0110170 %long   0x0043B9DD
data.set 0xA0110174 %long   0x04062B40
data.set 0xA0110178 %long   0x330349AE
data.set 0xA011017C %long   0x2CCF768D
data.set 0xA0110180 %long   0x4F146087
data.set 0xA0110184 %long   0x610530A5
data.set 0xA0110188 %long   0xB0D65A66
data.set 0xA011018C %long   0x4B76566C
data.set 0xA0110190 %long   0x3E10CE4E
data.set 0xA0110194 %long   0x6809DE19
data.set 0xA0110198 %long   0x2601C1B1
data.set 0xA011019C %long   0xBCCE2540
data.set 0xA01101A0 %long   0x7F2DE186
data.set 0xA01101A4 %long   0x1AC45B3E
data.set 0xA01101A8 %long   0x8B0E3331
data.set 0xA01101AC %long   0x44902ABE
data.set 0xA01101B0 %long   0x8691DE81
data.set 0xA01101B4 %long   0xC0542715
data.set 0xA01101B8 %long   0xEDCC505A
data.set 0xA01101BC %long   0x9B1B35C6
data.set 0xA01101C0 %long   0xB5AEC312
data.set 0xA01101C4 %long   0x57E00225
data.set 0xA01101C8 %long   0x5CD0094B
data.set 0xA01101CC %long   0x5767E207
data.set 0xA01101D0 %long   0x84806212
data.set 0xA01101D4 %long   0xED111363
data.set 0xA01101D8 %long   0x4975F97C
data.set 0xA01101DC %long   0xD7823C37
data.set 0xA01101E0 %long   0x19CCADB3
data.set 0xA01101E4 %long   0xC1E423A9
data.set 0xA01101E8 %long   0xF1B3DB62
data.set 0xA01101EC %long   0x52F5BC3F
data.set 0xA01101F0 %long   0xB2800CC6
data.set 0xA01101F4 %long   0xB81A214B
data.set 0xA01101F8 %long   0x9B996440
data.set 0xA01101FC %long   0xB3D34A59
data.set 0xA0110200 %long   0xF6E4F899
data.set 0xA0110204 %long   0x7DF656D8
data.set 0xA0110208 %long   0x504FD31F
data.set 0xA011020C %long   0x2A6D0E71
data.set 0xA0110210 %long   0xEBBA2E12
data.set 0xA0110214 %long   0xC99B711A
data.set 0xA0110218 %long   0x839EF96F
data.set 0xA011021C %long   0xED93D8B3
data.set 0xA0110220 %long   0x1CCEC87A
data.set 0xA0110224 %long   0xE57607ED
data.set 0xA0110228 %long   0x74D895E2
data.set 0xA011022C %long   0x3F9E4C81
data.set 0xA0110230 %long   0xA2F2EEB1
data.set 0xA0110234 %long   0x4F9D10EF
data.set 0xA0110238 %long   0x8727A8DA
data.set 0xA011023C %long   0x8F46FCD2
data.set 0xA0110240 %long   0x3FF4E138
data.set 0xA0110244 %long   0xBD8CC5E1
data.set 0xA0110248 %long   0x5BC04EDF
data.set 0xA011024C %long   0xC9B98108
data.set 0xA0110250 %long   0x8E225881
data.set 0xA0110254 %long   0x17B3597F
data.set 0xA0110258 %long   0x12EFE46E
data.set 0xA011025C %long   0x9B091A4F
data.set 0xA0110260 %long   0xDC7949F8
data.set 0xA0110264 %long   0x782FF56B
data.set 0xA0110268 %long   0xB12740CF
data.set 0xA011026C %long   0x77066E9C
data.set 0xA0110270 %long   0x4217F846
data.set 0xA0110274 %long   0x506668EF
data.set 0xA0110278 %long   0x3B41F0CA
data.set 0xA011027C %long   0x711BFFEC
data.set 0xA0110280 %long   0x33A2DD02
data.set 0xA0110284 %long   0x6BFFAD86
data.set 0xA0110288 %long   0x96D51327
data.set 0xA011028C %long   0xA4AA84C5
data.set 0xA0110290 %long   0xDC7AC030
data.set 0xA0110294 %long   0x2629AB65
data.set 0xA0110298 %long   0xA69000DB
data.set 0xA011029C %long   0x035B2DBD
data.set 0xA01102A0 %long   0x13609469
data.set 0xA01102A4 %long   0xB6F141B2
data.set 0xA01102A8 %long   0xAA705AFC
data.set 0xA01102AC %long   0x2CBE1B09
data.set 0xA01102B0 %long   0xF8090228
data.set 0xA01102B4 %long   0x5A8FE1CE
data.set 0xA01102B8 %long   0x4C241971
data.set 0xA01102BC %long   0xD451ECE0
data.set 0xA01102C0 %long   0xB08AE17C
data.set 0xA01102C4 %long   0x92F1F5B9
data.set 0xA01102C8 %long   0x4F3699E2
data.set 0xA01102CC %long   0x3B279541
data.set 0xA01102D0 %long   0xF71A9905
data.set 0xA01102D4 %long   0x52CDB2DA
data.set 0xA01102D8 %long   0x831C2135
data.set 0xA01102DC %long   0xD04987B6
data.set 0xA01102E0 %long   0xC0F2A1FA
data.set 0xA01102E4 %long   0xECABD38D
data.set 0xA01102E8 %long   0x95330825
data.set 0xA01102EC %long   0xFB1308CD
data.set 0xA01102F0 %long   0x9EFD71DA
data.set 0xA01102F4 %long   0xC5E8B866
data.set 0xA01102F8 %long   0x571BBA3F
data.set 0xA01102FC %long   0x48E8D4CA
data.set 0xA0110300 %long   0x16ECFC58
data.set 0xA0110304 %long   0xA607F727
data.set 0xA0110308 %long   0xDD93DA64
data.set 0xA011030C %long   0x05856D57
data.set 0xA0110310 %long   0x5EB1DA05
data.set 0xA0110314 %long   0x5D156A0A
data.set 0xA0110318 %long   0x9912DF34
data.set 0xA011031C %long   0x0215AE78
data.set 0xA0110320 %long   0x06838033
data.set 0xA0110324 %long   0xF8216DD9
data.set 0xA0110328 %long   0x570BC0F8
data.set 0xA011032C %long   0xFE723D23
data.set 0xA0110330 %long   0x51EF6B32
data.set 0xA0110334 %long   0x2EECDD35
data.set 0xA0110338 %long   0x191C846B
data.set 0xA011033C %long   0x63E123D8
data.set 0xA0110340 %long   0x93FC3F40
data.set 0xA0110344 %long   0xC5CFD0EF
data.set 0xA0110348 %long   0x9C5CAC93
data.set 0xA011034C %long   0x3733D94F
data.set 0xA0110350 %long   0xBBF18016
data.set 0xA0110354 %long   0x14EAF497
data.set 0xA0110358 %long   0x6EBF1598
data.set 0xA011035C %long   0x980548CE
data.set 0xA0110360 %long   0x5801FBA3
data.set 0xA0110364 %long   0xE173DB78
data.set 0xA0110368 %long   0xB83ABF4E
data.set 0xA011036C %long   0x4F2D1495
data.set 0xA0110370 %long   0x072E6FF6
data.set 0xA0110374 %long   0xA9B8C8D3
data.set 0xA0110378 %long   0x899C0FDA
data.set 0xA011037C %long   0x82C1FF1F
data.set 0xA0110380 %long   0xEFF7A958
data.set 0xA0110384 %long   0x1078A83A
data.set 0xA0110388 %long   0x3C7F1C7B
data.set 0xA011038C %long   0x7E44EBAF
data.set 0xA0110390 %long   0x46EF14DC
data.set 0xA0110394 %long   0x73BF8608
data.set 0xA0110398 %long   0x6F885F52
data.set 0xA011039C %long   0x1F8A6182
data.set 0xA01103A0 %long   0xD549008C
data.set 0xA01103A4 %long   0x1A690114
data.set 0xA01103A8 %long   0xE2505B51
data.set 0xA01103AC %long   0xE0F98288
data.set 0xA01103B0 %long   0x77EE2665
data.set 0xA01103B4 %long   0x26ABC01A
data.set 0xA01103B8 %long   0x6A6FE834
data.set 0xA01103BC %long   0xD0637D22
data.set 0xA01103C0 %long   0xA9791B19
data.set 0xA01103C4 %long   0x39933478
data.set 0xA01103C8 %long   0x0DC320A3
data.set 0xA01103CC %long   0x681A5458
data.set 0xA01103D0 %long   0x66B52A59
data.set 0xA01103D4 %long   0x8C92AF74
data.set 0xA01103D8 %long   0x89C7CD58
data.set 0xA01103DC %long   0x7E85F665
data.set 0xA01103E0 %long   0xB068A630
data.set 0xA01103E4 %long   0xBD62115A
data.set 0xA01103E8 %long   0xB10AB782
data.set 0xA01103EC %long   0x54090683
data.set 0xA01103F0 %long   0x92A3FC61
data.set 0xA01103F4 %long   0x264AEC2D
data.set 0xA01103F8 %long   0x026456A8
data.set 0xA01103FC %long   0x030B59F1
data.set 0xA0110400 %long   0xDA21F2DF
data.set 0xA0110404 %long   0x9CC84AF3
data.set 0xA0110408 %long   0x301FCA2D
data.set 0xA011040C %long   0x4BD99B00
data.set 0xA0110410 %long   0x37047EBF
data.set 0xA0110414 %long   0xFCF5246F
data.set 0xA0110418 %long   0xD1E70317
data.set 0xA011041C %long   0xA8B6D4AA
data.set 0xA0110420 %long   0xB355FD5A
data.set 0xA0110424 %long   0xED5A1D85
data.set 0xA0110428 %long   0xF6CBF4B7
data.set 0xA011042C %long   0x5EDF89B8
data.set 0xA0110430 %long   0x50EB1479
data.set 0xA0110434 %long   0x339BD9DE
data.set 0xA0110438 %long   0x0B7422B6
data.set 0xA011043C %long   0x31CEE63D
data.set 0xA0110440 %long   0x884AD2CE
data.set 0xA0110444 %long   0x2BAA9E52
data.set 0xA0110448 %long   0xDF2B29E6
data.set 0xA011044C %long   0x8EA51CE2
data.set 0xA0110450 %long   0xE54B9BB1
data.set 0xA0110454 %long   0x5BAD5DA9
data.set 0xA0110458 %long   0x7FB5A93B
data.set 0xA011045C %long   0x4B8027E0
data.set 0xA0110460 %long   0xA3D2C2E4
data.set 0xA0110464 %long   0xD716B17E
data.set 0xA0110468 %long   0x130B3C60
data.set 0xA011046C %long   0x0AEC85F9
data.set 0xA0110470 %long   0xDE887861
data.set 0xA0110474 %long   0x3E9517ED
data.set 0xA0110478 %long   0x76148D66
data.set 0xA011047C %long   0x67409241
data.set 0xA0110480 %long   0x2BBA0933
data.set 0xA0110484 %long   0x073AE031
data.set 0xA0110488 %long   0x0DE42B61
data.set 0xA011048C %long   0xBF1A24CD
data.set 0xA0110490 %long   0x46C0725C
data.set 0xA0110494 %long   0xD6221D9F
data.set 0xA0110498 %long   0xC7AB1CC2
data.set 0xA011049C %long   0x0C1238A0
data.set 0xA01104A0 %long   0x1795F136
data.set 0xA01104A4 %long   0xDE0C512A
data.set 0xA01104A8 %long   0x0EEC07F6
data.set 0xA01104AC %long   0x3912959B
data.set 0xA01104B0 %long   0x378B3B27
data.set 0xA01104B4 %long   0x62910FCC
data.set 0xA01104B8 %long   0x1AD77857
data.set 0xA01104BC %long   0xEEEDFAE6
data.set 0xA01104C0 %long   0x51597340
data.set 0xA01104C4 %long   0xA672CF9D
data.set 0xA01104C8 %long   0x4B3C2D79
data.set 0xA01104CC %long   0x1F783B5F
data.set 0xA01104D0 %long   0x8971F40B
data.set 0xA01104D4 %long   0xD6F237F3
data.set 0xA01104D8 %long   0x522B52B3
data.set 0xA01104DC %long   0x39815DA3
data.set 0xA01104E0 %long   0xF8D16A81
data.set 0xA01104E4 %long   0xF37D9C17
data.set 0xA01104E8 %long   0x81BD6912
data.set 0xA01104EC %long   0xFEA8ED14
data.set 0xA01104F0 %long   0xD244A496
data.set 0xA01104F4 %long   0x7E5F9A44
data.set 0xA01104F8 %long   0x3A381E5C
data.set 0xA01104FC %long   0x7B324BF9
data.set 0xA0110500 %long   0x8EEC86C1
data.set 0xA0110504 %long   0xDB420728
data.set 0xA0110508 %long   0xE325CE2B
data.set 0xA011050C %long   0x22A24E0D
data.set 0xA0110510 %long   0xD5DB1093
data.set 0xA0110514 %long   0x98DD683A
data.set 0xA0110518 %long   0x20BE418D
data.set 0xA011051C %long   0xC2826435
data.set 0xA0110520 %long   0xE1B54729
data.set 0xA0110524 %long   0x04B1CCA4
data.set 0xA0110528 %long   0xFAFC4ADC
data.set 0xA011052C %long   0x4E809BDB
data.set 0xA0110530 %long   0x6AD56694
data.set 0xA0110534 %long   0xAD19AA53
data.set 0xA0110538 %long   0xFAC471B8
data.set 0xA011053C %long   0xDC12A564
data.set 0xA0110540 %long   0xBBC3B62D
data.set 0xA0110544 %long   0x256A870C
data.set 0xA0110548 %long   0xF977CB00
data.set 0xA011054C %long   0xC0933F0D
data.set 0xA0110550 %long   0x135380FD
data.set 0xA0110554 %long   0xB6F417A7
data.set 0xA0110558 %long   0x39D179F8
data.set 0xA011055C %long   0xEB3BD49E
data.set 0xA0110560 %long   0x737DAF31
data.set 0xA0110564 %long   0xD53C4E6A
data.set 0xA0110568 %long   0x49259E76
data.set 0xA011056C %long   0x0AE541AA
data.set 0xA0110570 %long   0x748B66B9
data.set 0xA0110574 %long   0xBFC94035
data.set 0xA0110578 %long   0x6E97AF5B
data.set 0xA011057C %long   0x8612ACE1
data.set 0xA0110580 %long   0x1B1ECDA6
data.set 0xA0110584 %long   0x1D5A2262
data.set 0xA0110588 %long   0xE1675228
data.set 0xA011058C %long   0x2B8807CD
data.set 0xA0110590 %long   0xF8C1E152
data.set 0xA0110594 %long   0x07C02121
data.set 0xA0110598 %long   0xB2C4188B
data.set 0xA011059C %long   0x7A5C2DA7
data.set 0xA01105A0 %long   0x109874A1
data.set 0xA01105A4 %long   0xCA61B915
data.set 0xA01105A8 %long   0xCBFD9C65
data.set 0xA01105AC %long   0x71CABA95
data.set 0xA01105B0 %long   0x174747A5
data.set 0xA01105B4 %long   0x7FB4B81A
data.set 0xA01105B8 %long   0x985C082C
data.set 0xA01105BC %long   0xED28B840
data.set 0xA01105C0 %long   0xD23CF20B
data.set 0xA01105C4 %long   0x7737E0ED
data.set 0xA01105C8 %long   0x94D90E10
data.set 0xA01105CC %long   0x97201DC6
data.set 0xA01105D0 %long   0x310C1B4A
data.set 0xA01105D4 %long   0xA3F07DC8
data.set 0xA01105D8 %long   0x07383E29
data.set 0xA01105DC %long   0x35BF0D79
data.set 0xA01105E0 %long   0xE30CE2A0
data.set 0xA01105E4 %long   0x487A3893
data.set 0xA01105E8 %long   0x5203020A
data.set 0xA01105EC %long   0x2D472DDF
data.set 0xA01105F0 %long   0xC7F33EEE
data.set 0xA01105F4 %long   0xE35263A7
data.set 0xA01105F8 %long   0xA2FC1962
data.set 0xA01105FC %long   0xB6268CA0
data.set 0xA0110600 %long   0xF3EEEF7A
data.set 0xA0110604 %long   0xD9BE3E1A
data.set 0xA0110608 %long   0x4BD83588
data.set 0xA011060C %long   0x63E2943C
data.set 0xA0110610 %long   0x312361A8
data.set 0xA0110614 %long   0x512089CA
data.set 0xA0110618 %long   0x4499D59C
data.set 0xA011061C %long   0x22F98323
data.set 0xA0110620 %long   0x6DBF2565
data.set 0xA0110624 %long   0x268CAD13
data.set 0xA0110628 %long   0xB57ADB2A
data.set 0xA011062C %long   0xFB2E83EC
data.set 0xA0110630 %long   0x50CE27A5
data.set 0xA0110634 %long   0x74FEDC1E
data.set 0xA0110638 %long   0x698A539A
data.set 0xA011063C %long   0xE8B54669
data.set 0xA0110640 %long   0x6FD1758E
data.set 0xA0110644 %long   0xDB89C7C0
data.set 0xA0110648 %long   0x128D3AE8
data.set 0xA011064C %long   0x4E2B8A9F
data.set 0xA0110650 %long   0xDA4A498C
data.set 0xA0110654 %long   0xC78C51F9
data.set 0xA0110658 %long   0xADDA6B7E
data.set 0xA011065C %long   0x2F4D3779
data.set 0xA0110660 %long   0x11E846AC
data.set 0xA0110664 %long   0x7C64EA4E
data.set 0xA0110668 %long   0x51C60DAA
data.set 0xA011066C %long   0xCC07E86A
data.set 0xA0110670 %long   0xA4C8C33C
data.set 0xA0110674 %long   0x5A2ABA26
data.set 0xA0110678 %long   0xBD775BBD
data.set 0xA011067C %long   0xC242853B
data.set 0xA0110680 %long   0x1DFD3FCD
data.set 0xA0110684 %long   0xEFBEFA6D
data.set 0xA0110688 %long   0x6521C1D0
data.set 0xA011068C %long   0x4DEE4B21
data.set 0xA0110690 %long   0x8A3DB605
data.set 0xA0110694 %long   0x8BCFA5A4
data.set 0xA0110698 %long   0xCF546940
data.set 0xA011069C %long   0xAEA80B01
data.set 0xA01106A0 %long   0xCECD88C3
data.set 0xA01106A4 %long   0x46BE1C87
data.set 0xA01106A8 %long   0x6FFD7B31
data.set 0xA01106AC %long   0x8A20534C
data.set 0xA01106B0 %long   0xE7EA2738
data.set 0xA01106B4 %long   0x4FC9FBC5
data.set 0xA01106B8 %long   0x3778D0C9
data.set 0xA01106BC %long   0x416CA145
data.set 0xA01106C0 %long   0xFFE409EB
data.set 0xA01106C4 %long   0xDC606B94
data.set 0xA01106C8 %long   0x3A1E7316
data.set 0xA01106CC %long   0x32660709
data.set 0xA01106D0 %long   0xEF33F862
data.set 0xA01106D4 %long   0x7EE3A9C5
data.set 0xA01106D8 %long   0x0FADD1B0
data.set 0xA01106DC %long   0xCA00D692
data.set 0xA01106E0 %long   0xBC75D005
data.set 0xA01106E4 %long   0xA5BECBBC
data.set 0xA01106E8 %long   0xF89AAE63
data.set 0xA01106EC %long   0x25194064
data.set 0xA01106F0 %long   0xC7EAB637
data.set 0xA01106F4 %long   0xB28E0923
data.set 0xA01106F8 %long   0xFA76FC86
data.set 0xA01106FC %long   0x31BF9F18
data.set 0xA0110700 %long   0x00CDAE30
data.set 0xA0110704 %long   0x3E789C1C
data.set 0xA0110708 %long   0xF6129038
data.set 0xA011070C %long   0x489B4313
data.set 0xA0110710 %long   0xFDEE28FD
data.set 0xA0110714 %long   0x21EB59F5
data.set 0xA0110718 %long   0x19910EB2
data.set 0xA011071C %long   0x4572F1DE
data.set 0xA0110720 %long   0x6F90FCFB
data.set 0xA0110724 %long   0x0FC99310
data.set 0xA0110728 %long   0xE4503903
data.set 0xA011072C %long   0xDDA7E6C0
data.set 0xA0110730 %long   0x3F965508
data.set 0xA0110734 %long   0xFFFC73D2
data.set 0xA0110738 %long   0xB6B1EFCE
data.set 0xA011073C %long   0x86DAD39F
data.set 0xA0110740 %long   0x02F8D488
data.set 0xA0110744 %long   0x10BCA857
data.set 0xA0110748 %long   0xB0AECEE9
data.set 0xA011074C %long   0xA94B6C96
data.set 0xA0110750 %long   0x2D40DC19
data.set 0xA0110754 %long   0xF701B4BC
data.set 0xA0110758 %long   0xE6E68AF8
data.set 0xA011075C %long   0x29A7279C
data.set 0xA0110760 %long   0xBC548382
data.set 0xA0110764 %long   0xB862A99F
data.set 0xA0110768 %long   0x0A851341
data.set 0xA011076C %long   0xAE393708
data.set 0xA0110770 %long   0xE817B898
data.set 0xA0110774 %long   0xF2732251
data.set 0xA0110778 %long   0xD2DE2A43
data.set 0xA011077C %long   0xCA24CF24
data.set 0xA0110780 %long   0x01E3112C
data.set 0xA0110784 %long   0xC6179C19
data.set 0xA0110788 %long   0x8F009ACB
data.set 0xA011078C %long   0x334C729B
data.set 0xA0110790 %long   0xA75F84FF
data.set 0xA0110794 %long   0x7323D1FC
data.set 0xA0110798 %long   0x9766FE6B
data.set 0xA011079C %long   0xB56DFB15
data.set 0xA01107A0 %long   0x568BE6CB
data.set 0xA01107A4 %long   0xE1FF77EE
data.set 0xA01107A8 %long   0xD6DD375F
data.set 0xA01107AC %long   0x476B2C59
data.set 0xA01107B0 %long   0x5DF78884
data.set 0xA01107B4 %long   0x71ED27E6
data.set 0xA01107B8 %long   0x32338B85
data.set 0xA01107BC %long   0x59D958CC
data.set 0xA01107C0 %long   0x71198800
data.set 0xA01107C4 %long   0x833FCBFF
data.set 0xA01107C8 %long   0x32C6F6F8
data.set 0xA01107CC %long   0xCF4C9C69
data.set 0xA01107D0 %long   0xC9C6375C
data.set 0xA01107D4 %long   0x982B99EA
data.set 0xA01107D8 %long   0x789F1017
data.set 0xA01107DC %long   0x847501E4
data.set 0xA01107E0 %long   0xFBED5D0E
data.set 0xA01107E4 %long   0xE5A746D8
data.set 0xA01107E8 %long   0x09F56080
data.set 0xA01107EC %long   0x22D45BAE
data.set 0xA01107F0 %long   0xC38E3728
data.set 0xA01107F4 %long   0x36CA28A3
data.set 0xA01107F8 %long   0x3AFA40C6
data.set 0xA01107FC %long   0xE17875E3
data.set 0xA0110800 %long   0xC2EBBC28
data.set 0xA0110804 %long   0x70AC1A0C
data.set 0xA0110808 %long   0xB6689B25
data.set 0xA011080C %long   0x6776811C
data.set 0xA0110810 %long   0xD8363ECB
data.set 0xA0110814 %long   0xB3438978
data.set 0xA0110818 %long   0x687001D3
data.set 0xA011081C %long   0x9DF4CA8D
data.set 0xA0110820 %long   0x5705A1A8
data.set 0xA0110824 %long   0x5037679F
data.set 0xA0110828 %long   0x54A16A53
data.set 0xA011082C %long   0x65F718A8
data.set 0xA0110830 %long   0x099EFCA1
data.set 0xA0110834 %long   0x5369EEB5
data.set 0xA0110838 %long   0xD97AA0AE
data.set 0xA011083C %long   0x60E9C1B2
data.set 0xA0110840 %long   0x66800942
data.set 0xA0110844 %long   0x666E1010
data.set 0xA0110848 %long   0xF526F964
data.set 0xA011084C %long   0xAE77B066
data.set 0xA0110850 %long   0x9C22F359
data.set 0xA0110854 %long   0x07F94717
data.set 0xA0110858 %long   0xD791ED0D
data.set 0xA011085C %long   0xA5F0793D
data.set 0xA0110860 %long   0x51B75BB2
data.set 0xA0110864 %long   0x62F9742D
data.set 0xA0110868 %long   0xB33B91F2
data.set 0xA011086C %long   0x2BA98D7B
data.set 0xA0110870 %long   0x523BBF10
data.set 0xA0110874 %long   0x62227811
data.set 0xA0110878 %long   0x6A253B52
data.set 0xA011087C %long   0x975E57D7
data.set 0xA0110880 %long   0xA5BEF2D0
data.set 0xA0110884 %long   0x8FFFB2BC
data.set 0xA0110888 %long   0x92454AE8
data.set 0xA011088C %long   0xBC6F002E
data.set 0xA0110890 %long   0x1B6920CE
data.set 0xA0110894 %long   0xF3B8F325
data.set 0xA0110898 %long   0x6068DC7F
data.set 0xA011089C %long   0x91DC7C2C
data.set 0xA01108A0 %long   0x5D814098
data.set 0xA01108A4 %long   0x79296C1E
data.set 0xA01108A8 %long   0x377FCFF1
data.set 0xA01108AC %long   0x2652F7B7
data.set 0xA01108B0 %long   0x50769364
data.set 0xA01108B4 %long   0x5A4FF9C3
data.set 0xA01108B8 %long   0x9D132C86
data.set 0xA01108BC %long   0xD362C9C9
data.set 0xA01108C0 %long   0xE11B72AF
data.set 0xA01108C4 %long   0x426E6A3C
data.set 0xA01108C8 %long   0xEA2A7844
data.set 0xA01108CC %long   0xD38A233A
data.set 0xA01108D0 %long   0x4D492D0B
data.set 0xA01108D4 %long   0x95983210
data.set 0xA01108D8 %long   0xAAE17C2E
data.set 0xA01108DC %long   0xC411777E
data.set 0xA01108E0 %long   0x33E378A9
data.set 0xA01108E4 %long   0x6E573410
data.set 0xA01108E8 %long   0x1B016FEB
data.set 0xA01108EC %long   0x99BB9AF4
data.set 0xA01108F0 %long   0xBFEE96A1
data.set 0xA01108F4 %long   0xC24FA96E
data.set 0xA01108F8 %long   0x1C7B8411
data.set 0xA01108FC %long   0x9332C5CA
data.set 0xA0110900 %long   0x3226AB0E
data.set 0xA0110904 %long   0x18F35EF8
data.set 0xA0110908 %long   0xC136F7D7
data.set 0xA011090C %long   0x6CAEBE96
data.set 0xA0110910 %long   0x0E9A6D91
data.set 0xA0110914 %long   0x2C617615
data.set 0xA0110918 %long   0x6CEE9043
data.set 0xA011091C %long   0xF4A51ABD
data.set 0xA0110920 %long   0x03FBCC13
data.set 0xA0110924 %long   0x4578A788
data.set 0xA0110928 %long   0x626ACCDF
data.set 0xA011092C %long   0xBB94B1C2
data.set 0xA0110930 %long   0x3B9B8BDB
data.set 0xA0110934 %long   0x1919FA78
data.set 0xA0110938 %long   0x34143CF9
data.set 0xA011093C %long   0xCB428C2C
data.set 0xA0110940 %long   0x5F072518
data.set 0xA0110944 %long   0xF0AF6DA9
data.set 0xA0110948 %long   0x0D34BBBA
data.set 0xA011094C %long   0x6517643E
data.set 0xA0110950 %long   0x552F3CB5
data.set 0xA0110954 %long   0x375819BE
data.set 0xA0110958 %long   0xF45EB21C
data.set 0xA011095C %long   0x125E0090
data.set 0xA0110960 %long   0xAC26309D
data.set 0xA0110964 %long   0x6A3FF4C3
data.set 0xA0110968 %long   0x8CCD8E45
data.set 0xA011096C %long   0x6E59D70D
data.set 0xA0110970 %long   0x6C19B5EE
data.set 0xA0110974 %long   0x15648B82
data.set 0xA0110978 %long   0x4D93C7AD
data.set 0xA011097C %long   0x8A381826
data.set 0xA0110980 %long   0x745AD0BC
data.set 0xA0110984 %long   0x63CCACE5
data.set 0xA0110988 %long   0x615A3B18
data.set 0xA011098C %long   0x563E6EFF
data.set 0xA0110990 %long   0x5C73C785
data.set 0xA0110994 %long   0x552217EA
data.set 0xA0110998 %long   0xA97C69CD
data.set 0xA011099C %long   0xED91E642
data.set 0xA01109A0 %long   0x47D07C01
data.set 0xA01109A4 %long   0x1ED18B11
data.set 0xA01109A8 %long   0xBFFDE2B7
data.set 0xA01109AC %long   0x878C2289
data.set 0xA01109B0 %long   0x6C99AB07
data.set 0xA01109B4 %long   0x94155D27
data.set 0xA01109B8 %long   0xFF7F9B61
data.set 0xA01109BC %long   0xD1E9A942
data.set 0xA01109C0 %long   0xD6ABE9DB
data.set 0xA01109C4 %long   0xE346E393
data.set 0xA01109C8 %long   0x0C09F288
data.set 0xA01109CC %long   0x86821024
data.set 0xA01109D0 %long   0x47586E04
data.set 0xA01109D4 %long   0x4259D1ED
data.set 0xA01109D8 %long   0x9E235380
data.set 0xA01109DC %long   0xF481E0F6
data.set 0xA01109E0 %long   0x853A7AD1
data.set 0xA01109E4 %long   0x20CAE52A
data.set 0xA01109E8 %long   0x7E9CF6CA
data.set 0xA01109EC %long   0x640B5B1F
data.set 0xA01109F0 %long   0x753840D2
data.set 0xA01109F4 %long   0x7EA74688
data.set 0xA01109F8 %long   0x48530D57
data.set 0xA01109FC %long   0x2CBB8476
data.set 0xA0110A00 %long   0x83B20BDD
data.set 0xA0110A04 %long   0x7173399C
data.set 0xA0110A08 %long   0xBEE1F2B2
data.set 0xA0110A0C %long   0x83A98788
data.set 0xA0110A10 %long   0x4E9BF8AB
data.set 0xA0110A14 %long   0x11D06DCA
data.set 0xA0110A18 %long   0x82793D08
data.set 0xA0110A1C %long   0xC7DD8DB9
data.set 0xA0110A20 %long   0x0B0E2BAA
data.set 0xA0110A24 %long   0xE52A515D
data.set 0xA0110A28 %long   0x83C2299A
data.set 0xA0110A2C %long   0xFF1ACC6E
data.set 0xA0110A30 %long   0xAD539B57
data.set 0xA0110A34 %long   0x21C95390
data.set 0xA0110A38 %long   0x387BC209
data.set 0xA0110A3C %long   0xDF618E16
data.set 0xA0110A40 %long   0x8EECA15A
data.set 0xA0110A44 %long   0x1299E7EE
data.set 0xA0110A48 %long   0xC0D0E847
data.set 0xA0110A4C %long   0x67434125
data.set 0xA0110A50 %long   0x1500A1C3
data.set 0xA0110A54 %long   0xB3A0E17C
data.set 0xA0110A58 %long   0xFF6755B7
data.set 0xA0110A5C %long   0x29F22080
data.set 0xA0110A60 %long   0x1418200B
data.set 0xA0110A64 %long   0x234BB512
data.set 0xA0110A68 %long   0x93620DB4
data.set 0xA0110A6C %long   0xD87CF86E
data.set 0xA0110A70 %long   0x2ACD7D83
data.set 0xA0110A74 %long   0xC478E67C
data.set 0xA0110A78 %long   0x0DFA1BF2
data.set 0xA0110A7C %long   0xEC06FD9F
data.set 0xA0110A80 %long   0x4235ABBE
data.set 0xA0110A84 %long   0x6674150A
data.set 0xA0110A88 %long   0x158E7C5D
data.set 0xA0110A8C %long   0x7438DD21
data.set 0xA0110A90 %long   0x2FA57130
data.set 0xA0110A94 %long   0xA93E5899
data.set 0xA0110A98 %long   0xCEB5404D
data.set 0xA0110A9C %long   0x9D304A00
data.set 0xA0110AA0 %long   0x90B327EB
data.set 0xA0110AA4 %long   0xA9E7A7B8
data.set 0xA0110AA8 %long   0x54CE2F03
data.set 0xA0110AAC %long   0x2A5295DF
data.set 0xA0110AB0 %long   0xB13EC2D3
data.set 0xA0110AB4 %long   0x8ABE63A9
data.set 0xA0110AB8 %long   0xB7C000AF
data.set 0xA0110ABC %long   0x9059873C
data.set 0xA0110AC0 %long   0x98381372
data.set 0xA0110AC4 %long   0x6FA813CA
data.set 0xA0110AC8 %long   0x08F5AFE8
data.set 0xA0110ACC %long   0xF1D84FAF
data.set 0xA0110AD0 %long   0xCBBF7EED
data.set 0xA0110AD4 %long   0x351D61FE
data.set 0xA0110AD8 %long   0xC60D54E9
data.set 0xA0110ADC %long   0xD0CBE0CE
data.set 0xA0110AE0 %long   0x60A4CB67
data.set 0xA0110AE4 %long   0x26D971D5
data.set 0xA0110AE8 %long   0xE634EBD1
data.set 0xA0110AEC %long   0x62D6506D
data.set 0xA0110AF0 %long   0xDE00A894
data.set 0xA0110AF4 %long   0x918587C1
data.set 0xA0110AF8 %long   0x65DDDA34
data.set 0xA0110AFC %long   0xD449EE25
data.set 0xA0110B00 %long   0x0B77DCAB
data.set 0xA0110B04 %long   0x3BA33400
data.set 0xA0110B08 %long   0x2F53C2D2
data.set 0xA0110B0C %long   0x9DEF897A
data.set 0xA0110B10 %long   0x62BD3040
data.set 0xA0110B14 %long   0xCB9083F4
data.set 0xA0110B18 %long   0x689436D4
data.set 0xA0110B1C %long   0x5E04704E
data.set 0xA0110B20 %long   0x0935B1FE
data.set 0xA0110B24 %long   0x13AE3F9E
data.set 0xA0110B28 %long   0x04E3ADE7
data.set 0xA0110B2C %long   0xD0964F06
data.set 0xA0110B30 %long   0xDB92AD3D
data.set 0xA0110B34 %long   0x025D7AE1
data.set 0xA0110B38 %long   0xB06A7E5A
data.set 0xA0110B3C %long   0x7F0A1B49
data.set 0xA0110B40 %long   0xDCB75EC9
data.set 0xA0110B44 %long   0xC7632F24
data.set 0xA0110B48 %long   0x6583DE38
data.set 0xA0110B4C %long   0xF9CE5D3B
data.set 0xA0110B50 %long   0x44B40762
data.set 0xA0110B54 %long   0xC9FC5E50
data.set 0xA0110B58 %long   0x6C61EF8C
data.set 0xA0110B5C %long   0xF5D90A5B
data.set 0xA0110B60 %long   0x9C7D6403
data.set 0xA0110B64 %long   0xFC74833D
data.set 0xA0110B68 %long   0x227CF749
data.set 0xA0110B6C %long   0x5F2589E5
data.set 0xA0110B70 %long   0x393D0573
data.set 0xA0110B74 %long   0x9EB2BB7E
data.set 0xA0110B78 %long   0x7DC42A2D
data.set 0xA0110B7C %long   0x5DCFC870
data.set 0xA0110B80 %long   0x6DCA7B73
data.set 0xA0110B84 %long   0xD9515ED8
data.set 0xA0110B88 %long   0xC3ADE255
data.set 0xA0110B8C %long   0xAF5A6C01
data.set 0xA0110B90 %long   0xE33A9035
data.set 0xA0110B94 %long   0xFA931D19
data.set 0xA0110B98 %long   0x8EE5B125
data.set 0xA0110B9C %long   0x950CC4FF
data.set 0xA0110BA0 %long   0xE1F2A49F
data.set 0xA0110BA4 %long   0xF3302767
data.set 0xA0110BA8 %long   0xAAC9315F
data.set 0xA0110BAC %long   0xD0194D4F
data.set 0xA0110BB0 %long   0xF4458D23
data.set 0xA0110BB4 %long   0xF6CB6021
data.set 0xA0110BB8 %long   0xDD60D503
data.set 0xA0110BBC %long   0x84759037
data.set 0xA0110BC0 %long   0xA98B15E0
data.set 0xA0110BC4 %long   0x3E878787
data.set 0xA0110BC8 %long   0x11903C24
data.set 0xA0110BCC %long   0xF06A43F9
data.set 0xA0110BD0 %long   0xF183F5DC
data.set 0xA0110BD4 %long   0x9BB5E558
data.set 0xA0110BD8 %long   0x5B5E10BF
data.set 0xA0110BDC %long   0xFED08432
data.set 0xA0110BE0 %long   0x768217DD
data.set 0xA0110BE4 %long   0x2A9FDB47
data.set 0xA0110BE8 %long   0x7F14C2C9
data.set 0xA0110BEC %long   0x9FBC9510
data.set 0xA0110BF0 %long   0x2E2B862C
data.set 0xA0110BF4 %long   0x9FED153A
data.set 0xA0110BF8 %long   0x2486DB4B
data.set 0xA0110BFC %long   0xE491EE38
data.set 0xA0110C00 %long   0x5461C072
data.set 0xA0110C04 %long   0xA1401A2A
data.set 0xA0110C08 %long   0x8F8E6F22
data.set 0xA0110C0C %long   0x584767B7
data.set 0xA0110C10 %long   0x0FA0C8C7
data.set 0xA0110C14 %long   0xD77673B4
data.set 0xA0110C18 %long   0xABA424E2
data.set 0xA0110C1C %long   0xD5A4700A
data.set 0xA0110C20 %long   0xDABE4B19
data.set 0xA0110C24 %long   0x0C5BF2A6
data.set 0xA0110C28 %long   0x31EE3A07
data.set 0xA0110C2C %long   0xA31D4978
data.set 0xA0110C30 %long   0x3E1C4CBB
data.set 0xA0110C34 %long   0xD93132EB
data.set 0xA0110C38 %long   0xB76AC527
data.set 0xA0110C3C %long   0xB5C20A90
data.set 0xA0110C40 %long   0x89C26A39
data.set 0xA0110C44 %long   0x8B029437
data.set 0xA0110C48 %long   0x4359B182
data.set 0xA0110C4C %long   0x024C48A5
data.set 0xA0110C50 %long   0xA6A09427
data.set 0xA0110C54 %long   0x889AD3DD
data.set 0xA0110C58 %long   0xD16DB05B
data.set 0xA0110C5C %long   0x6D07E399
data.set 0xA0110C60 %long   0x9AE06E10
data.set 0xA0110C64 %long   0x019AA76B
data.set 0xA0110C68 %long   0x02F2ACAB
data.set 0xA0110C6C %long   0xA5CBD740
data.set 0xA0110C70 %long   0xEAACE36A
data.set 0xA0110C74 %long   0x12FA96A1
data.set 0xA0110C78 %long   0x9C606DA9
data.set 0xA0110C7C %long   0x587734A2
data.set 0xA0110C80 %long   0x312C5190
data.set 0xA0110C84 %long   0xB8BBE7A1
data.set 0xA0110C88 %long   0xC1F9056F
data.set 0xA0110C8C %long   0x4943E4D2
data.set 0xA0110C90 %long   0x611D6CD1
data.set 0xA0110C94 %long   0xE936FEAA
data.set 0xA0110C98 %long   0xCC6656B1
data.set 0xA0110C9C %long   0x8936236D
data.set 0xA0110CA0 %long   0x3DCE5704
data.set 0xA0110CA4 %long   0xBBF28374
data.set 0xA0110CA8 %long   0xAB51A89C
data.set 0xA0110CAC %long   0x7640CA21
data.set 0xA0110CB0 %long   0x5C9FBF99
data.set 0xA0110CB4 %long   0xDE4605A3
data.set 0xA0110CB8 %long   0xE202139E
data.set 0xA0110CBC %long   0x74A9145B
data.set 0xA0110CC0 %long   0xD3F436EA
data.set 0xA0110CC4 %long   0x48BCAE0D
data.set 0xA0110CC8 %long   0x6709792F
data.set 0xA0110CCC %long   0x25AD6B0B
data.set 0xA0110CD0 %long   0x34D66CFB
data.set 0xA0110CD4 %long   0x5F33BEE2
data.set 0xA0110CD8 %long   0xEFF14F70
data.set 0xA0110CDC %long   0xA9E84B37
data.set 0xA0110CE0 %long   0x226D4BF6
data.set 0xA0110CE4 %long   0x7DCF9B19
data.set 0xA0110CE8 %long   0x73A4B834
data.set 0xA0110CEC %long   0x87C61BC0
data.set 0xA0110CF0 %long   0x93FD93F3
data.set 0xA0110CF4 %long   0xC3836246
data.set 0xA0110CF8 %long   0x16078209
data.set 0xA0110CFC %long   0x722C8F38
data.set 0xA0110D00 %long   0x267A8FB6
data.set 0xA0110D04 %long   0xC3E1CC29
data.set 0xA0110D08 %long   0x25F99D81
data.set 0xA0110D0C %long   0xE5ADF44F
data.set 0xA0110D10 %long   0xC09524F8
data.set 0xA0110D14 %long   0x833E8F5E
data.set 0xA0110D18 %long   0x4AFE28F1
data.set 0xA0110D1C %long   0x0F749D22
data.set 0xA0110D20 %long   0xD6DBFA4E
data.set 0xA0110D24 %long   0x49C9A3B5
data.set 0xA0110D28 %long   0x8538A747
data.set 0xA0110D2C %long   0x81D024EF
data.set 0xA0110D30 %long   0x81643023
data.set 0xA0110D34 %long   0x6C621452
data.set 0xA0110D38 %long   0xE2F3FBF2
data.set 0xA0110D3C %long   0x3A2C35C3
data.set 0xA0110D40 %long   0xB6056F3B
data.set 0xA0110D44 %long   0x1B7CB989
data.set 0xA0110D48 %long   0x69A17488
data.set 0xA0110D4C %long   0x7954F924
data.set 0xA0110D50 %long   0x69AF61F9
data.set 0xA0110D54 %long   0xC3DD2C9D
data.set 0xA0110D58 %long   0x28932F53
data.set 0xA0110D5C %long   0x0CD72218
data.set 0xA0110D60 %long   0x8A3B58DE
data.set 0xA0110D64 %long   0xF218C95D
data.set 0xA0110D68 %long   0x65859411
data.set 0xA0110D6C %long   0x426F6F2F
data.set 0xA0110D70 %long   0x8BF4A07D
data.set 0xA0110D74 %long   0xAA9BDA2C
data.set 0xA0110D78 %long   0x8078FDA2
data.set 0xA0110D7C %long   0x7824F3B5
data.set 0xA0110D80 %long   0x2B7383A8
data.set 0xA0110D84 %long   0x44145A3C
data.set 0xA0110D88 %long   0x60BBEF2B
data.set 0xA0110D8C %long   0xD4ED8B1D
data.set 0xA0110D90 %long   0xCD6590D7
data.set 0xA0110D94 %long   0xA2B236EA
data.set 0xA0110D98 %long   0x26D204C9
data.set 0xA0110D9C %long   0xE2A6061B
data.set 0xA0110DA0 %long   0xD77AB3B5
data.set 0xA0110DA4 %long   0x6B417609
data.set 0xA0110DA8 %long   0x2442CEAD
data.set 0xA0110DAC %long   0x286C28BD
data.set 0xA0110DB0 %long   0x5FFEDA49
data.set 0xA0110DB4 %long   0xC8AB903C
data.set 0xA0110DB8 %long   0xAA97B583
data.set 0xA0110DBC %long   0x6673CDC4
data.set 0xA0110DC0 %long   0x7ADD9038
data.set 0xA0110DC4 %long   0x1EF2725B
data.set 0xA0110DC8 %long   0x26E1F79B
data.set 0xA0110DCC %long   0x31AF36C6
data.set 0xA0110DD0 %long   0x400AAD2F
data.set 0xA0110DD4 %long   0xDCA8462E
data.set 0xA0110DD8 %long   0xC4D060A5
data.set 0xA0110DDC %long   0xADDB466D
data.set 0xA0110DE0 %long   0x7F0F99A7
data.set 0xA0110DE4 %long   0x5B307E5A
data.set 0xA0110DE8 %long   0x6155F9AE
data.set 0xA0110DEC %long   0xF89F1D10
data.set 0xA0110DF0 %long   0xB0810F74
data.set 0xA0110DF4 %long   0x77868A89
data.set 0xA0110DF8 %long   0xCD50F97F
data.set 0xA0110DFC %long   0xBA138944
data.set 0xA0110E00 %long   0x64DDD159
data.set 0xA0110E04 %long   0xD70FD97C
data.set 0xA0110E08 %long   0x9D5FA069
data.set 0xA0110E0C %long   0x0637794A
data.set 0xA0110E10 %long   0xF8644DD9
data.set 0xA0110E14 %long   0xEADC19B0
data.set 0xA0110E18 %long   0x4932FAAA
data.set 0xA0110E1C %long   0xE792DB21
data.set 0xA0110E20 %long   0x096E6EA3
data.set 0xA0110E24 %long   0x8D10A58D
data.set 0xA0110E28 %long   0xC3279169
data.set 0xA0110E2C %long   0xF9A40210
data.set 0xA0110E30 %long   0x1CC21B8D
data.set 0xA0110E34 %long   0x213B1237
data.set 0xA0110E38 %long   0x68CAD2CA
data.set 0xA0110E3C %long   0xDE80AC27
data.set 0xA0110E40 %long   0xD7D4B2E8
data.set 0xA0110E44 %long   0x49F3EB24
data.set 0xA0110E48 %long   0x29BF0D2B
data.set 0xA0110E4C %long   0xF198D36D
data.set 0xA0110E50 %long   0xB241EF3C
data.set 0xA0110E54 %long   0xAF294396
data.set 0xA0110E58 %long   0x658CAE4B
data.set 0xA0110E5C %long   0x39225356
data.set 0xA0110E60 %long   0x4515E109
data.set 0xA0110E64 %long   0x5DBC1145
data.set 0xA0110E68 %long   0x2ABD624B
data.set 0xA0110E6C %long   0xCF5980A2
data.set 0xA0110E70 %long   0xBAD0B2D5
data.set 0xA0110E74 %long   0xBA6B8279
data.set 0xA0110E78 %long   0xD927405A
data.set 0xA0110E7C %long   0xEF7A2AFB
data.set 0xA0110E80 %long   0x72DA7A82
data.set 0xA0110E84 %long   0x9B65DEDC
data.set 0xA0110E88 %long   0xE2B196E6
data.set 0xA0110E8C %long   0xB456F16C
data.set 0xA0110E90 %long   0x2D69A7F6
data.set 0xA0110E94 %long   0xF0D3D63F
data.set 0xA0110E98 %long   0x8342E5F0
data.set 0xA0110E9C %long   0xD837ECDB
data.set 0xA0110EA0 %long   0x0A3F365F
data.set 0xA0110EA4 %long   0xB99DC044
data.set 0xA0110EA8 %long   0xF2B51D41
data.set 0xA0110EAC %long   0x711356E7
data.set 0xA0110EB0 %long   0xDBCC4D10
data.set 0xA0110EB4 %long   0x102D6DBE
data.set 0xA0110EB8 %long   0xB100BC4F
data.set 0xA0110EBC %long   0xAC153193
data.set 0xA0110EC0 %long   0x023EF709
data.set 0xA0110EC4 %long   0xC021357A
data.set 0xA0110EC8 %long   0x5DE34183
data.set 0xA0110ECC %long   0xD3573F94
data.set 0xA0110ED0 %long   0x5E8B9D73
data.set 0xA0110ED4 %long   0x085896DF
data.set 0xA0110ED8 %long   0x21BEF5B0
data.set 0xA0110EDC %long   0x75D427A2
data.set 0xA0110EE0 %long   0xC78BEFBB
data.set 0xA0110EE4 %long   0x1A1F887B
data.set 0xA0110EE8 %long   0xBD849062
data.set 0xA0110EEC %long   0xABB9B59A
data.set 0xA0110EF0 %long   0x37FEB4D0
data.set 0xA0110EF4 %long   0x8C705B24
data.set 0xA0110EF8 %long   0x59C6F8AE
data.set 0xA0110EFC %long   0xB0881EF7
data.set 0xA0110F00 %long   0x52AB9473
data.set 0xA0110F04 %long   0xB25B81FD
data.set 0xA0110F08 %long   0x8C6E2563
data.set 0xA0110F0C %long   0x93602931
data.set 0xA0110F10 %long   0x2FFB3AAB
data.set 0xA0110F14 %long   0x2AC334DA
data.set 0xA0110F18 %long   0xD1FA061A
data.set 0xA0110F1C %long   0x8D0DC052
data.set 0xA0110F20 %long   0x4429CFA6
data.set 0xA0110F24 %long   0xB569C8E9
data.set 0xA0110F28 %long   0x1515E6C0
data.set 0xA0110F2C %long   0x945B6BF1
data.set 0xA0110F30 %long   0xB3AA3CC8
data.set 0xA0110F34 %long   0x5768A67D
data.set 0xA0110F38 %long   0x3A728167
data.set 0xA0110F3C %long   0x04565C6A
data.set 0xA0110F40 %long   0xD5F7A840
data.set 0xA0110F44 %long   0x08F58D89
data.set 0xA0110F48 %long   0x1C00460D
data.set 0xA0110F4C %long   0xD7F39F81
data.set 0xA0110F50 %long   0xAB6BB8F9
data.set 0xA0110F54 %long   0x561F4DD7
data.set 0xA0110F58 %long   0x143822D4
data.set 0xA0110F5C %long   0x942DD978
data.set 0xA0110F60 %long   0x136E9ABB
data.set 0xA0110F64 %long   0x6BA2A078
data.set 0xA0110F68 %long   0x9C64CF15
data.set 0xA0110F6C %long   0x8D58527C
data.set 0xA0110F70 %long   0x2AD92842
data.set 0xA0110F74 %long   0x357544AF
data.set 0xA0110F78 %long   0x997DACDA
data.set 0xA0110F7C %long   0xE5F0364C
data.set 0xA0110F80 %long   0x94FEEF17
data.set 0xA0110F84 %long   0xDEE582C3
data.set 0xA0110F88 %long   0xA6FA6500
data.set 0xA0110F8C %long   0x137B6817
data.set 0xA0110F90 %long   0x231FEEB5
data.set 0xA0110F94 %long   0xE0FB68F3
data.set 0xA0110F98 %long   0x54F352A2
data.set 0xA0110F9C %long   0xCF571E1F
data.set 0xA0110FA0 %long   0x01899C1C
data.set 0xA0110FA4 %long   0x022CA49D
data.set 0xA0110FA8 %long   0xB73548A8
data.set 0xA0110FAC %long   0x3B9E393B
data.set 0xA0110FB0 %long   0x55B6B4F2
data.set 0xA0110FB4 %long   0x936F8F02
data.set 0xA0110FB8 %long   0xAAB33FB9
data.set 0xA0110FBC %long   0x63D0D92C
data.set 0xA0110FC0 %long   0x30A14005
data.set 0xA0110FC4 %long   0x17E82586
data.set 0xA0110FC8 %long   0xF5D09C90
data.set 0xA0110FCC %long   0xCAEE39CA
data.set 0xA0110FD0 %long   0x6C3C8829
data.set 0xA0110FD4 %long   0xAD47A0E9
data.set 0xA0110FD8 %long   0x56843586
data.set 0xA0110FDC %long   0xDAE8CF0E
data.set 0xA0110FE0 %long   0xC960852D
data.set 0xA0110FE4 %long   0x66BAD21D
data.set 0xA0110FE8 %long   0x517C1A12
data.set 0xA0110FEC %long   0xBFAC1CB5
data.set 0xA0110FF0 %long   0xE7628019
data.set 0xA0110FF4 %long   0x86A25FA3
data.set 0xA0110FF8 %long   0xD6DF20A7
data.set 0xA0110FFC %long   0x84B6801E
data.set 0xA0111000 %long   0xD2E3C967
data.set 0xA0111004 %long   0x3DFAF396
data.set 0xA0111008 %long   0x3B2CA530
data.set 0xA011100C %long   0x3D2D97F1
data.set 0xA0111010 %long   0x73DFDC74
data.set 0xA0111014 %long   0xFB1FAE91
data.set 0xA0111018 %long   0x0978EC11
data.set 0xA011101C %long   0x315F135C
data.set 0xA0111020 %long   0x0CFF91C7
data.set 0xA0111024 %long   0xFB6BADD6
data.set 0xA0111028 %long   0x5B154140
data.set 0xA011102C %long   0x945FCDA1
data.set 0xA0111030 %long   0x70E6119E
data.set 0xA0111034 %long   0x57523868
data.set 0xA0111038 %long   0xCE35C8A4
data.set 0xA011103C %long   0xA0BC27BD
data.set 0xA0111040 %long   0xFA26654C
data.set 0xA0111044 %long   0x59EFAA22
data.set 0xA0111048 %long   0x398EE967
data.set 0xA011104C %long   0x6FE7DF62
data.set 0xA0111050 %long   0xBA7C8A35
data.set 0xA0111054 %long   0x4B8BA93C
data.set 0xA0111058 %long   0x4B181A5B
data.set 0xA011105C %long   0x1FFDE5A4
data.set 0xA0111060 %long   0xF565CA4D
data.set 0xA0111064 %long   0xF27024A0
data.set 0xA0111068 %long   0xC1A3CE05
data.set 0xA011106C %long   0x2997E7B2
data.set 0xA0111070 %long   0x72CBD2B8
data.set 0xA0111074 %long   0x404377D4
data.set 0xA0111078 %long   0xBDB9FA70
data.set 0xA011107C %long   0x24BB2D45
data.set 0xA0111080 %long   0xDDC62A5E
data.set 0xA0111084 %long   0xB03FCC1F
data.set 0xA0111088 %long   0xC72EBBD6
data.set 0xA011108C %long   0x3C17D82A
data.set 0xA0111090 %long   0x6A06BD67
data.set 0xA0111094 %long   0x5C31A0AA
data.set 0xA0111098 %long   0x713F5B6D
data.set 0xA011109C %long   0xA714861B
data.set 0xA01110A0 %long   0xF8E0624A
data.set 0xA01110A4 %long   0x99BB9810
data.set 0xA01110A8 %long   0x133D5E85
data.set 0xA01110AC %long   0xF384AE6F
data.set 0xA01110B0 %long   0xE537573C
data.set 0xA01110B4 %long   0xD47542ED
data.set 0xA01110B8 %long   0xAC9E93A7
data.set 0xA01110BC %long   0xDFE16B9A
data.set 0xA01110C0 %long   0x58579310
data.set 0xA01110C4 %long   0x8E8A5167
data.set 0xA01110C8 %long   0x084B43D0
data.set 0xA01110CC %long   0x322AA210
data.set 0xA01110D0 %long   0xDE1C4E0A
data.set 0xA01110D4 %long   0x7FE65774
data.set 0xA01110D8 %long   0xA09B0AEF
data.set 0xA01110DC %long   0xF15D8BE3
data.set 0xA01110E0 %long   0x5657E6A9
data.set 0xA01110E4 %long   0x49DA5C1A
data.set 0xA01110E8 %long   0x2E2C2BD6
data.set 0xA01110EC %long   0x999DC5BC
data.set 0xA01110F0 %long   0xE9CCE8C2
data.set 0xA01110F4 %long   0x028A18B6
data.set 0xA01110F8 %long   0x564A2773
data.set 0xA01110FC %long   0x4A45903D
data.set 0xA0111100 %long   0xDA21CBE1
data.set 0xA0111104 %long   0x5B5DC5BD
data.set 0xA0111108 %long   0x31943092
data.set 0xA011110C %long   0xE9DEFCFB
data.set 0xA0111110 %long   0x9F451739
data.set 0xA0111114 %long   0xFEF59509
data.set 0xA0111118 %long   0xABEF3E5B
data.set 0xA011111C %long   0x846E4390
data.set 0xA0111120 %long   0x3DC74FC6
data.set 0xA0111124 %long   0x33814F4E
data.set 0xA0111128 %long   0xFFC5ECA8
data.set 0xA011112C %long   0xA7672585
data.set 0xA0111130 %long   0x5A00CEB1
data.set 0xA0111134 %long   0xE742A943
data.set 0xA0111138 %long   0xC3F961DF
data.set 0xA011113C %long   0x158FBE05
data.set 0xA0111140 %long   0x0AF1BC63
data.set 0xA0111144 %long   0xF3D3D013
data.set 0xA0111148 %long   0x5F0A1DD4
data.set 0xA011114C %long   0x37B3A672
data.set 0xA0111150 %long   0x14CEDBD7
data.set 0xA0111154 %long   0xD6728B4D
data.set 0xA0111158 %long   0x5D558180
data.set 0xA011115C %long   0x1618D144
data.set 0xA0111160 %long   0xDF9D3AFF
data.set 0xA0111164 %long   0xA4B34C74
data.set 0xA0111168 %long   0xCB93BAFB
data.set 0xA011116C %long   0xB39B923B
data.set 0xA0111170 %long   0x8B6CBF65
data.set 0xA0111174 %long   0x996CFD9B
data.set 0xA0111178 %long   0x23FC38A6
data.set 0xA011117C %long   0xD3E688D9
data.set 0xA0111180 %long   0x8239330B
data.set 0xA0111184 %long   0x43299210
data.set 0xA0111188 %long   0x0BE3D55E
data.set 0xA011118C %long   0x169940B8
data.set 0xA0111190 %long   0x37AF44DB
data.set 0xA0111194 %long   0x274FBF74
data.set 0xA0111198 %long   0x9656D1CC
data.set 0xA011119C %long   0x69D3A7E4
data.set 0xA01111A0 %long   0xB205A915
data.set 0xA01111A4 %long   0x9E63B839
data.set 0xA01111A8 %long   0x8561896F
data.set 0xA01111AC %long   0x00C5436E
data.set 0xA01111B0 %long   0xDE5F2A74
data.set 0xA01111B4 %long   0x8AB51B06
data.set 0xA01111B8 %long   0xD1F5EF67
data.set 0xA01111BC %long   0x0588793C
data.set 0xA01111C0 %long   0xB91CE3BB
data.set 0xA01111C4 %long   0xA082C6EC
data.set 0xA01111C8 %long   0x07536116
data.set 0xA01111CC %long   0xDE761AE2
data.set 0xA01111D0 %long   0x05D2F250
data.set 0xA01111D4 %long   0x0F6C4C7A
data.set 0xA01111D8 %long   0xCEA3642D
data.set 0xA01111DC %long   0x2F4D2B8C
data.set 0xA01111E0 %long   0x8E478806
data.set 0xA01111E4 %long   0x99D7F942
data.set 0xA01111E8 %long   0xBA90F996
data.set 0xA01111EC %long   0x9B02E21A
data.set 0xA01111F0 %long   0x1209F180
data.set 0xA01111F4 %long   0x1D98F170
data.set 0xA01111F8 %long   0xBE39F6DC
data.set 0xA01111FC %long   0xDAF5781B
data.set 0xA0111200 %long   0x98708A8F
data.set 0xA0111204 %long   0x53488D43
data.set 0xA0111208 %long   0x3AD0F4AD
data.set 0xA011120C %long   0xA6CCB3B2
data.set 0xA0111210 %long   0x2025AACB
data.set 0xA0111214 %long   0x81CF9A10
data.set 0xA0111218 %long   0x1558FD93
data.set 0xA011121C %long   0x6D05739C
data.set 0xA0111220 %long   0x33351FBE
data.set 0xA0111224 %long   0x30242D9D
data.set 0xA0111228 %long   0xFA5FC650
data.set 0xA011122C %long   0xDC3E10AC
data.set 0xA0111230 %long   0x91D825B3
data.set 0xA0111234 %long   0xB2343C83
data.set 0xA0111238 %long   0x08869182
data.set 0xA011123C %long   0x68573A3D
data.set 0xA0111240 %long   0x2EDAE099
data.set 0xA0111244 %long   0x398396AE
data.set 0xA0111248 %long   0xC5B8F778
data.set 0xA011124C %long   0xE4BD946B
data.set 0xA0111250 %long   0x35FAB9F4
data.set 0xA0111254 %long   0x4B8BBE7F
data.set 0xA0111258 %long   0xFB0C80A4
data.set 0xA011125C %long   0xF0D6DDB7
data.set 0xA0111260 %long   0xAF678E2B
data.set 0xA0111264 %long   0x61FBC958
data.set 0xA0111268 %long   0x636FBFA8
data.set 0xA011126C %long   0x9415D9F6
data.set 0xA0111270 %long   0x5B747773
data.set 0xA0111274 %long   0xEE7BAA89
data.set 0xA0111278 %long   0xA8F437E0
data.set 0xA011127C %long   0x3E5164F4
data.set 0xA0111280 %long   0x63C2EAD2
data.set 0xA0111284 %long   0x18971ADF
data.set 0xA0111288 %long   0x6DC33059
data.set 0xA011128C %long   0xE7E10F41
data.set 0xA0111290 %long   0xCC000BC9
data.set 0xA0111294 %long   0xDE544499
data.set 0xA0111298 %long   0x01AAADC8
data.set 0xA011129C %long   0x423A4045
data.set 0xA01112A0 %long   0x93E8981A
data.set 0xA01112A4 %long   0x520D9787
data.set 0xA01112A8 %long   0x15D8647E
data.set 0xA01112AC %long   0x74D94114
data.set 0xA01112B0 %long   0xF1AC7EB0
data.set 0xA01112B4 %long   0xCA3F38D7
data.set 0xA01112B8 %long   0xAD59E773
data.set 0xA01112BC %long   0x010EEF2A
data.set 0xA01112C0 %long   0x0772ADDA
data.set 0xA01112C4 %long   0x88EB057B
data.set 0xA01112C8 %long   0xD7E72755
data.set 0xA01112CC %long   0xB61C8CEC
data.set 0xA01112D0 %long   0xFCD8607D
data.set 0xA01112D4 %long   0x8019A5B2
data.set 0xA01112D8 %long   0x15CA4C51
data.set 0xA01112DC %long   0x1FBADF99
data.set 0xA01112E0 %long   0xEC5A18FF
data.set 0xA01112E4 %long   0x05B437FB
data.set 0xA01112E8 %long   0x4213EA9F
data.set 0xA01112EC %long   0x3C43ABD7
data.set 0xA01112F0 %long   0x3433FEF1
data.set 0xA01112F4 %long   0x3AB804CA
data.set 0xA01112F8 %long   0x75642FA9
data.set 0xA01112FC %long   0x55C6B5D0
data.set 0xA0111300 %long   0xA47A7730
data.set 0xA0111304 %long   0xD10CAE9B
data.set 0xA0111308 %long   0xB8A7184C
data.set 0xA011130C %long   0x2A8F361B
data.set 0xA0111310 %long   0x8A2A004C
data.set 0xA0111314 %long   0xDB2A824B
data.set 0xA0111318 %long   0x3C01EAA5
data.set 0xA011131C %long   0xBD0D6807
data.set 0xA0111320 %long   0x5E53062F
data.set 0xA0111324 %long   0x6E75DB12
data.set 0xA0111328 %long   0x5BB41347
data.set 0xA011132C %long   0x0DF3945E
data.set 0xA0111330 %long   0x4366F215
data.set 0xA0111334 %long   0xA2DEFE6F
data.set 0xA0111338 %long   0x364308D5
data.set 0xA011133C %long   0xA2F69FAE
data.set 0xA0111340 %long   0x80E95FF5
data.set 0xA0111344 %long   0x37B9B82A
data.set 0xA0111348 %long   0x63399C61
data.set 0xA011134C %long   0x72FB1994
data.set 0xA0111350 %long   0x4DD99188
data.set 0xA0111354 %long   0x4893997E
data.set 0xA0111358 %long   0x4918DC94
data.set 0xA011135C %long   0x34F6550C
data.set 0xA0111360 %long   0x00045056
data.set 0xA0111364 %long   0xE94C32AE
data.set 0xA0111368 %long   0x5C1CC968
data.set 0xA011136C %long   0x15048768
data.set 0xA0111370 %long   0x7A96253E
data.set 0xA0111374 %long   0x9B9A49B6
data.set 0xA0111378 %long   0xB2E68B1B
data.set 0xA011137C %long   0xACF3629E
data.set 0xA0111380 %long   0x0A3C0C95
data.set 0xA0111384 %long   0x14B239DA
data.set 0xA0111388 %long   0x19834E81
data.set 0xA011138C %long   0x628FBC70
data.set 0xA0111390 %long   0xD29A6BB1
data.set 0xA0111394 %long   0x43193F41
data.set 0xA0111398 %long   0xC6B129B3
data.set 0xA011139C %long   0xBBF8F8F8
data.set 0xA01113A0 %long   0xAB1530F7
data.set 0xA01113A4 %long   0x317FF043
data.set 0xA01113A8 %long   0xE5EFDAB9
data.set 0xA01113AC %long   0x13785A48
data.set 0xA01113B0 %long   0xA41C7F38
data.set 0xA01113B4 %long   0x39FE97ED
data.set 0xA01113B8 %long   0xD99C9645
data.set 0xA01113BC %long   0x081779A7
data.set 0xA01113C0 %long   0x15CAEC23
data.set 0xA01113C4 %long   0x7B3C8F3C
data.set 0xA01113C8 %long   0xE723A93A
data.set 0xA01113CC %long   0x3CF45556
data.set 0xA01113D0 %long   0x348D32E3
data.set 0xA01113D4 %long   0xC9F8AC43
data.set 0xA01113D8 %long   0x89147276
data.set 0xA01113DC %long   0x2D7F2A59
data.set 0xA01113E0 %long   0x34CAA1F5
data.set 0xA01113E4 %long   0xE61DAF0F
data.set 0xA01113E8 %long   0xFBCCEAD2
data.set 0xA01113EC %long   0x3C1BD643
data.set 0xA01113F0 %long   0x5FEBD970
data.set 0xA01113F4 %long   0x58F3957B
data.set 0xA01113F8 %long   0x45F19040
data.set 0xA01113FC %long   0xB234583A
data.set 0xA0111400 %long   0xB22B5FA3
data.set 0xA0111404 %long   0x2589797E
data.set 0xA0111408 %long   0x0F2AE6A5
data.set 0xA011140C %long   0x9AF19769
data.set 0xA0111410 %long   0x8AC74511
data.set 0xA0111414 %long   0x21C1B3F9
data.set 0xA0111418 %long   0x89951740
data.set 0xA011141C %long   0xD3127061
data.set 0xA0111420 %long   0x4477E464
data.set 0xA0111424 %long   0x94AE4199
data.set 0xA0111428 %long   0x9AC86BFE
data.set 0xA011142C %long   0xDF5D545D
data.set 0xA0111430 %long   0xD114C29F
data.set 0xA0111434 %long   0x93BA513C
data.set 0xA0111438 %long   0x953A4251
data.set 0xA011143C %long   0x0D6F8CFF
data.set 0xA0111440 %long   0xE6265DED
data.set 0xA0111444 %long   0xBAF97A9D
data.set 0xA0111448 %long   0xEF742727
data.set 0xA011144C %long   0xF497FDA3
data.set 0xA0111450 %long   0x4AB94111
data.set 0xA0111454 %long   0x8495C452
data.set 0xA0111458 %long   0xCFB5CF83
data.set 0xA011145C %long   0x65DB4F3F
data.set 0xA0111460 %long   0xFAF69887
data.set 0xA0111464 %long   0x6B0A97EF
data.set 0xA0111468 %long   0x4D011B32
data.set 0xA011146C %long   0x6D0CC290
data.set 0xA0111470 %long   0x9E7B1326
data.set 0xA0111474 %long   0xDFEDE5B2
data.set 0xA0111478 %long   0x59988F87
data.set 0xA011147C %long   0x468160B1
data.set 0xA0111480 %long   0x093ACE87
data.set 0xA0111484 %long   0xF803DEA6
data.set 0xA0111488 %long   0x97F1A092
data.set 0xA011148C %long   0x898179A0
data.set 0xA0111490 %long   0x409BED99
data.set 0xA0111494 %long   0xF6715B74
data.set 0xA0111498 %long   0x9DB90477
data.set 0xA011149C %long   0x2CDD2C2F
data.set 0xA01114A0 %long   0x1FE7B851
data.set 0xA01114A4 %long   0x7E90BAC8
data.set 0xA01114A8 %long   0xE486C3AC
data.set 0xA01114AC %long   0xDAC484CA
data.set 0xA01114B0 %long   0x3B4E93F6
data.set 0xA01114B4 %long   0xE28DD6E8
data.set 0xA01114B8 %long   0xEA312091
data.set 0xA01114BC %long   0x94E5C46D
data.set 0xA01114C0 %long   0x42F70468
data.set 0xA01114C4 %long   0xEFC38CB9
data.set 0xA01114C8 %long   0x01F757D0
data.set 0xA01114CC %long   0xB34562A4
data.set 0xA01114D0 %long   0x6B5F1FED
data.set 0xA01114D4 %long   0x96F79D4D
data.set 0xA01114D8 %long   0x29860016
data.set 0xA01114DC %long   0x2C2291E8
data.set 0xA01114E0 %long   0xCAC5411E
data.set 0xA01114E4 %long   0x5720AD10
data.set 0xA01114E8 %long   0x8B7410DC
data.set 0xA01114EC %long   0x9D567FC7
data.set 0xA01114F0 %long   0x0D74BD19
data.set 0xA01114F4 %long   0xDC761D74
data.set 0xA01114F8 %long   0x273F344B
data.set 0xA01114FC %long   0x5451A54A
data.set 0xA0111500 %long   0xC5FEE476
data.set 0xA0111504 %long   0x2076A9DC
data.set 0xA0111508 %long   0xF3ADD011
data.set 0xA011150C %long   0xE15C8BC3
data.set 0xA0111510 %long   0xB35976DF
data.set 0xA0111514 %long   0x7D82353F
data.set 0xA0111518 %long   0xF5E8CF4A
data.set 0xA011151C %long   0xE7EEB551
data.set 0xA0111520 %long   0xDD5AD14A
data.set 0xA0111524 %long   0xF93764A7
data.set 0xA0111528 %long   0x7FF4A75B
data.set 0xA011152C %long   0xFE620BBA
data.set 0xA0111530 %long   0xC6C0DF59
data.set 0xA0111534 %long   0x8CC798B4
data.set 0xA0111538 %long   0xC8AE6A5C
data.set 0xA011153C %long   0xA83C794E
data.set 0xA0111540 %long   0xE595F2D8
data.set 0xA0111544 %long   0x8C48BB38
data.set 0xA0111548 %long   0xBC19AE00
data.set 0xA011154C %long   0x0CC00331
data.set 0xA0111550 %long   0x04B28F80
data.set 0xA0111554 %long   0x647BD136
data.set 0xA0111558 %long   0x48E2932B
data.set 0xA011155C %long   0x8D50F792
data.set 0xA0111560 %long   0xC7E63E97
data.set 0xA0111564 %long   0xFD9250D6
data.set 0xA0111568 %long   0x68BAFBF6
data.set 0xA011156C %long   0x20C43363
data.set 0xA0111570 %long   0x27F999D0
data.set 0xA0111574 %long   0x237D6DAD
data.set 0xA0111578 %long   0xE832D9C0
data.set 0xA011157C %long   0x655F0ABB
data.set 0xA0111580 %long   0x7B1C0B4B
data.set 0xA0111584 %long   0xE7AFB73B
data.set 0xA0111588 %long   0x65910CF5
data.set 0xA011158C %long   0x90447682
data.set 0xA0111590 %long   0xADF523B9
data.set 0xA0111594 %long   0x8A8EE624
data.set 0xA0111598 %long   0x231FBC18
data.set 0xA011159C %long   0x8C98957D
data.set 0xA01115A0 %long   0xC072144E
data.set 0xA01115A4 %long   0x439AEF7E
data.set 0xA01115A8 %long   0x4FA4F25B
data.set 0xA01115AC %long   0x6A910B2E
data.set 0xA01115B0 %long   0x7220A97C
data.set 0xA01115B4 %long   0xC88738EE
data.set 0xA01115B8 %long   0x7AA05704
data.set 0xA01115BC %long   0x333B74A4
data.set 0xA01115C0 %long   0x6B128BC7
data.set 0xA01115C4 %long   0x87F30442
data.set 0xA01115C8 %long   0xBA59CBA4
data.set 0xA01115CC %long   0xB70F8EFE
data.set 0xA01115D0 %long   0xFAFBA50E
data.set 0xA01115D4 %long   0x856A9F87
data.set 0xA01115D8 %long   0xCB378E13
data.set 0xA01115DC %long   0xB8D939EA
data.set 0xA01115E0 %long   0xFD8579E3
data.set 0xA01115E4 %long   0xEC495431
data.set 0xA01115E8 %long   0xEC2B8F9F
data.set 0xA01115EC %long   0xD4BA1F4C
data.set 0xA01115F0 %long   0xF4B860B7
data.set 0xA01115F4 %long   0x9397D53A
data.set 0xA01115F8 %long   0xBC8C285F
data.set 0xA01115FC %long   0x9EA21F45
data.set 0xA0111600 %long   0x156C36CC
data.set 0xA0111604 %long   0x10A0475F
data.set 0xA0111608 %long   0xE5EDE172
data.set 0xA011160C %long   0x5BEB2B2A
data.set 0xA0111610 %long   0x6D287677
data.set 0xA0111614 %long   0x8F552E4F
data.set 0xA0111618 %long   0x7EC00E90
data.set 0xA011161C %long   0x9D41237F
data.set 0xA0111620 %long   0x263DF59F
data.set 0xA0111624 %long   0x70A106ED
data.set 0xA0111628 %long   0x3D1B8A57
data.set 0xA011162C %long   0xED2233FD
data.set 0xA0111630 %long   0x40F892EB
data.set 0xA0111634 %long   0x1FD527CB
data.set 0xA0111638 %long   0x0E6594DA
data.set 0xA011163C %long   0x68E0ADAF
data.set 0xA0111640 %long   0x944DFAB4
data.set 0xA0111644 %long   0x758F67FF
data.set 0xA0111648 %long   0xCB08B889
data.set 0xA011164C %long   0x4FFF602F
data.set 0xA0111650 %long   0x3286D42D
data.set 0xA0111654 %long   0xAE8A30EE
data.set 0xA0111658 %long   0x29521F78
data.set 0xA011165C %long   0xA70122C5
data.set 0xA0111660 %long   0xE23FE331
data.set 0xA0111664 %long   0x2F3AC2EC
data.set 0xA0111668 %long   0x680ECCBB
data.set 0xA011166C %long   0x68662A0E
data.set 0xA0111670 %long   0x08F138D4
data.set 0xA0111674 %long   0x9CC3E60F
data.set 0xA0111678 %long   0xDD4D3A22
data.set 0xA011167C %long   0xB0D6BE22
data.set 0xA0111680 %long   0x4C3109AB
data.set 0xA0111684 %long   0xC46BC830
data.set 0xA0111688 %long   0xC97C4695
data.set 0xA011168C %long   0xF3A9A008
data.set 0xA0111690 %long   0x61F9CCD3
data.set 0xA0111694 %long   0x233298D4
data.set 0xA0111698 %long   0xE89EB0F6
data.set 0xA011169C %long   0xD4451767
data.set 0xA01116A0 %long   0x16FE0E52
data.set 0xA01116A4 %long   0xCC9BE979
data.set 0xA01116A8 %long   0x75EFD9D6
data.set 0xA01116AC %long   0xF44309E9
data.set 0xA01116B0 %long   0xFBC717A2
data.set 0xA01116B4 %long   0x08CBB294
data.set 0xA01116B8 %long   0xAF535506
data.set 0xA01116BC %long   0xD87AEBB2
data.set 0xA01116C0 %long   0xEB80461D
data.set 0xA01116C4 %long   0x8B6E5845
data.set 0xA01116C8 %long   0xE55612FA
data.set 0xA01116CC %long   0x45E421F1
data.set 0xA01116D0 %long   0xB67F2F4A
data.set 0xA01116D4 %long   0x4745ED1D
data.set 0xA01116D8 %long   0xB69D6615
data.set 0xA01116DC %long   0xA0619DAC
data.set 0xA01116E0 %long   0x1FC81559
data.set 0xA01116E4 %long   0x5DF939C3
data.set 0xA01116E8 %long   0x9275556B
data.set 0xA01116EC %long   0x341DEDCE
data.set 0xA01116F0 %long   0xE9F328F9
data.set 0xA01116F4 %long   0x0A3EA03C
data.set 0xA01116F8 %long   0xD38551D2
data.set 0xA01116FC %long   0x3E108074
data.set 0xA0111700 %long   0x4FA7F9D9
data.set 0xA0111704 %long   0x53F47353
data.set 0xA0111708 %long   0x2C487954
data.set 0xA011170C %long   0x6A4E049C
data.set 0xA0111710 %long   0xA559BE0D
data.set 0xA0111714 %long   0x33BBB415
data.set 0xA0111718 %long   0x54CD2E2C
data.set 0xA011171C %long   0xC31D1A03
data.set 0xA0111720 %long   0x5148F4C3
data.set 0xA0111724 %long   0xC373FFB1
data.set 0xA0111728 %long   0xA145A683
data.set 0xA011172C %long   0x7F61FDD2
data.set 0xA0111730 %long   0xF25B6CF2
data.set 0xA0111734 %long   0x44C8033B
data.set 0xA0111738 %long   0x22D3D605
data.set 0xA011173C %long   0xEC81FE4A
data.set 0xA0111740 %long   0xC79B7D12
data.set 0xA0111744 %long   0xB73D605E
data.set 0xA0111748 %long   0x4372AA7E
data.set 0xA011174C %long   0x6BF4922E
data.set 0xA0111750 %long   0x8F1CC98A
data.set 0xA0111754 %long   0xDC650D23
data.set 0xA0111758 %long   0x924BEB35
data.set 0xA011175C %long   0xD8D43AA5
data.set 0xA0111760 %long   0xC5F69787
data.set 0xA0111764 %long   0x33351B9E
data.set 0xA0111768 %long   0x5647167F
data.set 0xA011176C %long   0x05C43F53
data.set 0xA0111770 %long   0x28F69682
data.set 0xA0111774 %long   0xB19F0FF2
data.set 0xA0111778 %long   0xD23A207C
data.set 0xA011177C %long   0xAA114C5F
data.set 0xA0111780 %long   0xF10A1AF6
data.set 0xA0111784 %long   0x4D84F5CD
data.set 0xA0111788 %long   0xAD03A2C9
data.set 0xA011178C %long   0x91E8E23F
data.set 0xA0111790 %long   0xA0E279E9
data.set 0xA0111794 %long   0x4D6D3594
data.set 0xA0111798 %long   0xEC36FCFB
data.set 0xA011179C %long   0x9659C5C5
data.set 0xA01117A0 %long   0x0C1085E7
data.set 0xA01117A4 %long   0x85E6266B
data.set 0xA01117A8 %long   0xE07FD773
data.set 0xA01117AC %long   0x96905F08
data.set 0xA01117B0 %long   0xBAEC2AA3
data.set 0xA01117B4 %long   0x33288EBB
data.set 0xA01117B8 %long   0x867F3259
data.set 0xA01117BC %long   0xAC4D4ED1
data.set 0xA01117C0 %long   0xB2903A4E
data.set 0xA01117C4 %long   0x4C10AE21
data.set 0xA01117C8 %long   0xB8B5C901
data.set 0xA01117CC %long   0xEA1C429F
data.set 0xA01117D0 %long   0x68DE0555
data.set 0xA01117D4 %long   0x8BBEB48C
data.set 0xA01117D8 %long   0x6CDEA9D9
data.set 0xA01117DC %long   0x70BC2530
data.set 0xA01117E0 %long   0x75032E20
data.set 0xA01117E4 %long   0x7D10EDE0
data.set 0xA01117E8 %long   0xAFC42B3F
data.set 0xA01117EC %long   0xB4391134
data.set 0xA01117F0 %long   0x8C3B87F6
data.set 0xA01117F4 %long   0x9E0340F3
data.set 0xA01117F8 %long   0x65623015
data.set 0xA01117FC %long   0xE715B015
data.set 0xA0111800 %long   0x356479F2
data.set 0xA0111804 %long   0x72C59514
data.set 0xA0111808 %long   0x12AD8058
data.set 0xA011180C %long   0x45BB1EAA
data.set 0xA0111810 %long   0x97E8EA6A
data.set 0xA0111814 %long   0x213E3604
data.set 0xA0111818 %long   0x6C3C2CC9
data.set 0xA011181C %long   0x489BC67A
data.set 0xA0111820 %long   0x3731FA1B
data.set 0xA0111824 %long   0xD190BAC9
data.set 0xA0111828 %long   0x449558EC
data.set 0xA011182C %long   0xC34ADB59
data.set 0xA0111830 %long   0xBB47E03C
data.set 0xA0111834 %long   0x47845349
data.set 0xA0111838 %long   0x5503B404
data.set 0xA011183C %long   0x2A624C2C
data.set 0xA0111840 %long   0xF0FCB539
data.set 0xA0111844 %long   0x372809AE
data.set 0xA0111848 %long   0x3C523692
data.set 0xA011184C %long   0xEA908BBF
data.set 0xA0111850 %long   0x2775F836
data.set 0xA0111854 %long   0x59E0AFE1
data.set 0xA0111858 %long   0xD3E4EC6C
data.set 0xA011185C %long   0xAD1985EB
data.set 0xA0111860 %long   0x6B2B40B3
data.set 0xA0111864 %long   0x12757A8E
data.set 0xA0111868 %long   0xEE72BFFC
data.set 0xA011186C %long   0x4175C3F7
data.set 0xA0111870 %long   0xA70DA03F
data.set 0xA0111874 %long   0x386CA37C
data.set 0xA0111878 %long   0x591F4C73
data.set 0xA011187C %long   0x1FB1B6A8
data.set 0xA0111880 %long   0x440D7CBF
data.set 0xA0111884 %long   0x561AF879
data.set 0xA0111888 %long   0x1E502B00
data.set 0xA011188C %long   0xC31C3028
data.set 0xA0111890 %long   0x64E39194
data.set 0xA0111894 %long   0x799A80C3
data.set 0xA0111898 %long   0xE6ACA6B0
data.set 0xA011189C %long   0xD081B976
data.set 0xA01118A0 %long   0xBCCB5865
data.set 0xA01118A4 %long   0xF152774B
data.set 0xA01118A8 %long   0x9A4CC5FD
data.set 0xA01118AC %long   0xEB9D69DA
data.set 0xA01118B0 %long   0x7C335E60
data.set 0xA01118B4 %long   0xC00DBDE9
data.set 0xA01118B8 %long   0xD7CA3CCB
data.set 0xA01118BC %long   0xA0E1D407
data.set 0xA01118C0 %long   0x63C9B794
data.set 0xA01118C4 %long   0xE7B870F7
data.set 0xA01118C8 %long   0xD448C91F
data.set 0xA01118CC %long   0x5A470177
data.set 0xA01118D0 %long   0x749B9975
data.set 0xA01118D4 %long   0xB793E6FD
data.set 0xA01118D8 %long   0xD807C0DD
data.set 0xA01118DC %long   0x8DBB813C
data.set 0xA01118E0 %long   0x211860B2
data.set 0xA01118E4 %long   0xE7B3C282
data.set 0xA01118E8 %long   0x94F61AC1
data.set 0xA01118EC %long   0xBC3D39AD
data.set 0xA01118F0 %long   0x34249EAE
data.set 0xA01118F4 %long   0x6DC05518
data.set 0xA01118F8 %long   0x1DCF5FFD
data.set 0xA01118FC %long   0x5ED2C0D6
data.set 0xA0111900 %long   0x935E4A29
data.set 0xA0111904 %long   0x603A02D8
data.set 0xA0111908 %long   0x3AE0EE4A
data.set 0xA011190C %long   0x40293364
data.set 0xA0111910 %long   0xA14FAC0B
data.set 0xA0111914 %long   0x0192181E
data.set 0xA0111918 %long   0xD3835431
data.set 0xA011191C %long   0x718C8ED3
data.set 0xA0111920 %long   0xCA90E236
data.set 0xA0111924 %long   0x2599DBCA
data.set 0xA0111928 %long   0x0E8A33D6
data.set 0xA011192C %long   0xECAD5A92
data.set 0xA0111930 %long   0x7CABD6FF
data.set 0xA0111934 %long   0x16AA3DB2
data.set 0xA0111938 %long   0x79677AAB
data.set 0xA011193C %long   0xF5BD5217
data.set 0xA0111940 %long   0xF1F95B58
data.set 0xA0111944 %long   0xAC67E00E
data.set 0xA0111948 %long   0x219ECB8B
data.set 0xA011194C %long   0x0DD6A968
data.set 0xA0111950 %long   0x4570DA40
data.set 0xA0111954 %long   0xEA53E5A1
data.set 0xA0111958 %long   0xD9EAB9E5
data.set 0xA011195C %long   0xB2978D94
data.set 0xA0111960 %long   0xE135224C
data.set 0xA0111964 %long   0x5F556EAF
data.set 0xA0111968 %long   0xB7A2FAD1
data.set 0xA011196C %long   0x6E842916
data.set 0xA0111970 %long   0xEB1EA734
data.set 0xA0111974 %long   0x0956F96C
data.set 0xA0111978 %long   0xF9DCD8D7
data.set 0xA011197C %long   0x31264AE5
data.set 0xA0111980 %long   0x99C62F73
data.set 0xA0111984 %long   0x41EC0854
data.set 0xA0111988 %long   0x576EB4C6
data.set 0xA011198C %long   0x6B7A6700
data.set 0xA0111990 %long   0xDB741508
data.set 0xA0111994 %long   0x8E105466
data.set 0xA0111998 %long   0x1099C68A
data.set 0xA011199C %long   0x5EDEBFF0
data.set 0xA01119A0 %long   0x69539380
data.set 0xA01119A4 %long   0xF628D812
data.set 0xA01119A8 %long   0x8C69A92E
data.set 0xA01119AC %long   0x28C27184
data.set 0xA01119B0 %long   0xA59DBAB7
data.set 0xA01119B4 %long   0x7A200C12
data.set 0xA01119B8 %long   0xE5466207
data.set 0xA01119BC %long   0xFA719952
data.set 0xA01119C0 %long   0xD3C32A1D
data.set 0xA01119C4 %long   0xF6A2FB1A
data.set 0xA01119C8 %long   0x76E76318
data.set 0xA01119CC %long   0xCA6F7E38
data.set 0xA01119D0 %long   0x2C08DE1C
data.set 0xA01119D4 %long   0x24F2E236
data.set 0xA01119D8 %long   0x6257DB59
data.set 0xA01119DC %long   0x0F648DEC
data.set 0xA01119E0 %long   0xC166C6EE
data.set 0xA01119E4 %long   0xAAD7DC34
data.set 0xA01119E8 %long   0x4810265B
data.set 0xA01119EC %long   0xE6194ACE
data.set 0xA01119F0 %long   0xE384120F
data.set 0xA01119F4 %long   0x90C6E6C3
data.set 0xA01119F8 %long   0x148ECF6C
data.set 0xA01119FC %long   0x183A5DC2
data.set 0xA0111A00 %long   0x333FC12E
data.set 0xA0111A04 %long   0x55166DF3
data.set 0xA0111A08 %long   0x02D37BBE
data.set 0xA0111A0C %long   0x98F7C4AC
data.set 0xA0111A10 %long   0x4956EDA7
data.set 0xA0111A14 %long   0x953838F7
data.set 0xA0111A18 %long   0xCCADA022
data.set 0xA0111A1C %long   0x1448C9D3
data.set 0xA0111A20 %long   0x96BBA839
data.set 0xA0111A24 %long   0x3D2B1DEB
data.set 0xA0111A28 %long   0x8BAD5867
data.set 0xA0111A2C %long   0x627397A0
data.set 0xA0111A30 %long   0x340C6D6B
data.set 0xA0111A34 %long   0x244A93E0
data.set 0xA0111A38 %long   0x9CEFDAF7
data.set 0xA0111A3C %long   0x953572C9
data.set 0xA0111A40 %long   0x09448F1D
data.set 0xA0111A44 %long   0x4AD90086
data.set 0xA0111A48 %long   0x4C626E5A
data.set 0xA0111A4C %long   0x94102D89
data.set 0xA0111A50 %long   0xF7C765E2
data.set 0xA0111A54 %long   0x37089168
data.set 0xA0111A58 %long   0x986479FD
data.set 0xA0111A5C %long   0x25768D9A
data.set 0xA0111A60 %long   0xB8549FF6
data.set 0xA0111A64 %long   0xDE4DB08F
data.set 0xA0111A68 %long   0xB16C1425
data.set 0xA0111A6C %long   0x8C3703C7
data.set 0xA0111A70 %long   0xDD6C6CBE
data.set 0xA0111A74 %long   0x708B0082
data.set 0xA0111A78 %long   0xD3A99AAA
data.set 0xA0111A7C %long   0x85BA7D55
data.set 0xA0111A80 %long   0x06FBE0F4
data.set 0xA0111A84 %long   0x4AFC916A
data.set 0xA0111A88 %long   0x85F2F665
data.set 0xA0111A8C %long   0x22497B8B
data.set 0xA0111A90 %long   0xDC58563D
data.set 0xA0111A94 %long   0x3662B2BC
data.set 0xA0111A98 %long   0xDA54BC9C
data.set 0xA0111A9C %long   0x7B0CD990
data.set 0xA0111AA0 %long   0x20409440
data.set 0xA0111AA4 %long   0x0CFC9751
data.set 0xA0111AA8 %long   0xD57F2316
data.set 0xA0111AAC %long   0x1DAC2E3A
data.set 0xA0111AB0 %long   0x496C7515
data.set 0xA0111AB4 %long   0xE007DA86
data.set 0xA0111AB8 %long   0x104BC6A3
data.set 0xA0111ABC %long   0xB05BD5F0
data.set 0xA0111AC0 %long   0x473A3B0B
data.set 0xA0111AC4 %long   0xB313C3A2
data.set 0xA0111AC8 %long   0x59BB0F13
data.set 0xA0111ACC %long   0x41DB5C11
data.set 0xA0111AD0 %long   0x6FD27686
data.set 0xA0111AD4 %long   0x28C12474
data.set 0xA0111AD8 %long   0x3A1EEB84
data.set 0xA0111ADC %long   0x02E1F394
data.set 0xA0111AE0 %long   0x30DDD278
data.set 0xA0111AE4 %long   0x9EB86E7D
data.set 0xA0111AE8 %long   0x4B7FF483
data.set 0xA0111AEC %long   0xD07605E5
data.set 0xA0111AF0 %long   0x0CCC4036
data.set 0xA0111AF4 %long   0x5D1D8EA2
data.set 0xA0111AF8 %long   0xC0ABFAFC
data.set 0xA0111AFC %long   0xF61EFE63
data.set 0xA0111B00 %long   0xABF0657E
data.set 0xA0111B04 %long   0xED02A293
data.set 0xA0111B08 %long   0x674137CC
data.set 0xA0111B0C %long   0x1FF51AFC
data.set 0xA0111B10 %long   0x75CEAC47
data.set 0xA0111B14 %long   0xC05EC657
data.set 0xA0111B18 %long   0x110FDAB7
data.set 0xA0111B1C %long   0x1A559CF1
data.set 0xA0111B20 %long   0x0737F2C8
data.set 0xA0111B24 %long   0xBABCCAB1
data.set 0xA0111B28 %long   0x649AC8FE
data.set 0xA0111B2C %long   0xF4EB77FB
data.set 0xA0111B30 %long   0x7FB72D60
data.set 0xA0111B34 %long   0x6A8756C1
data.set 0xA0111B38 %long   0x0F5CCC5C
data.set 0xA0111B3C %long   0xBAA46553
data.set 0xA0111B40 %long   0xFF2179A3
data.set 0xA0111B44 %long   0xF3DCC43B
data.set 0xA0111B48 %long   0xC47F9093
data.set 0xA0111B4C %long   0x1A91F9C6
data.set 0xA0111B50 %long   0x57265364
data.set 0xA0111B54 %long   0xF6623D46
data.set 0xA0111B58 %long   0x2031BBEB
data.set 0xA0111B5C %long   0x749E7681
data.set 0xA0111B60 %long   0x6A898F57
data.set 0xA0111B64 %long   0x87B5ED87
data.set 0xA0111B68 %long   0x7933269D
data.set 0xA0111B6C %long   0x40D6FCA3
data.set 0xA0111B70 %long   0x3C968FFA
data.set 0xA0111B74 %long   0xD5EB1B34
data.set 0xA0111B78 %long   0xD6C81446
data.set 0xA0111B7C %long   0x5340733F
data.set 0xA0111B80 %long   0x62724627
data.set 0xA0111B84 %long   0x73E91613
data.set 0xA0111B88 %long   0xC6EB3A10
data.set 0xA0111B8C %long   0xEED21AAE
data.set 0xA0111B90 %long   0xF9681903
data.set 0xA0111B94 %long   0x987FD2D1
data.set 0xA0111B98 %long   0xD2C7B9E5
data.set 0xA0111B9C %long   0x9BBDC686
data.set 0xA0111BA0 %long   0x5F4A4096
data.set 0xA0111BA4 %long   0xECE20EE7
data.set 0xA0111BA8 %long   0x678B33ED
data.set 0xA0111BAC %long   0x61655205
data.set 0xA0111BB0 %long   0x83F6E130
data.set 0xA0111BB4 %long   0x350FE0F8
data.set 0xA0111BB8 %long   0xC2C0780D
data.set 0xA0111BBC %long   0x83F547BD
data.set 0xA0111BC0 %long   0x6B1EF15E
data.set 0xA0111BC4 %long   0xA7A30801
data.set 0xA0111BC8 %long   0x3A5300D4
data.set 0xA0111BCC %long   0x81742B52
data.set 0xA0111BD0 %long   0x5B131EAC
data.set 0xA0111BD4 %long   0xA85FBD2E
data.set 0xA0111BD8 %long   0x5BC8B5D2
data.set 0xA0111BDC %long   0xB5EAA72B
data.set 0xA0111BE0 %long   0xDDFDED16
data.set 0xA0111BE4 %long   0x62670638
data.set 0xA0111BE8 %long   0x48EE6B1D
data.set 0xA0111BEC %long   0xE41667CA
data.set 0xA0111BF0 %long   0xB6C5344B
data.set 0xA0111BF4 %long   0x8BE253DF
data.set 0xA0111BF8 %long   0xB76B7D96
data.set 0xA0111BFC %long   0x0AE4AD6A
data.set 0xA0111C00 %long   0x8B284AB4
data.set 0xA0111C04 %long   0x0A5DF996
data.set 0xA0111C08 %long   0xD149383D
data.set 0xA0111C0C %long   0x9E462820
data.set 0xA0111C10 %long   0x76E869A3
data.set 0xA0111C14 %long   0xE9A5306A
data.set 0xA0111C18 %long   0xDD39F62D
data.set 0xA0111C1C %long   0x12E79BEE
data.set 0xA0111C20 %long   0x68C64D6A
data.set 0xA0111C24 %long   0x8E98AD32
data.set 0xA0111C28 %long   0xC13C4334
data.set 0xA0111C2C %long   0x96C2A9C4
data.set 0xA0111C30 %long   0x2A98CC53
data.set 0xA0111C34 %long   0x422EE821
data.set 0xA0111C38 %long   0xC337437E
data.set 0xA0111C3C %long   0x62BA01C6
data.set 0xA0111C40 %long   0xCBFFF363
data.set 0xA0111C44 %long   0x138B09EE
data.set 0xA0111C48 %long   0x381E7E9F
data.set 0xA0111C4C %long   0x240F0F83
data.set 0xA0111C50 %long   0x061B5C6B
data.set 0xA0111C54 %long   0xB5259347
data.set 0xA0111C58 %long   0x721B5CB6
data.set 0xA0111C5C %long   0x93AA3F03
data.set 0xA0111C60 %long   0x77CF1C4E
data.set 0xA0111C64 %long   0x331A85A7
data.set 0xA0111C68 %long   0xB096D5F5
data.set 0xA0111C6C %long   0xA7CEC1A4
data.set 0xA0111C70 %long   0x83B1338B
data.set 0xA0111C74 %long   0xE6553C49
data.set 0xA0111C78 %long   0x7689DB3E
data.set 0xA0111C7C %long   0xE8031FDC
data.set 0xA0111C80 %long   0xB2308ED8
data.set 0xA0111C84 %long   0x667CAAB8
data.set 0xA0111C88 %long   0x7AF0B79E
data.set 0xA0111C8C %long   0x4784056F
data.set 0xA0111C90 %long   0xBA81A7BF
data.set 0xA0111C94 %long   0xB28F5F4D
data.set 0xA0111C98 %long   0x5682E32D
data.set 0xA0111C9C %long   0xB35BCEBB
data.set 0xA0111CA0 %long   0xF1E4E174
data.set 0xA0111CA4 %long   0x6E17BF30
data.set 0xA0111CA8 %long   0x052EC500
data.set 0xA0111CAC %long   0xEE939B2E
data.set 0xA0111CB0 %long   0x415F6D3A
data.set 0xA0111CB4 %long   0x5C1273DA
data.set 0xA0111CB8 %long   0x7D3CDD57
data.set 0xA0111CBC %long   0x8239104B
data.set 0xA0111CC0 %long   0x13675EEB
data.set 0xA0111CC4 %long   0xDDF8E087
data.set 0xA0111CC8 %long   0x4F511686
data.set 0xA0111CCC %long   0x5C13C8F2
data.set 0xA0111CD0 %long   0xC7E7703A
data.set 0xA0111CD4 %long   0x443576B4
data.set 0xA0111CD8 %long   0xF720E4C7
data.set 0xA0111CDC %long   0x96A38974
data.set 0xA0111CE0 %long   0x1F87B70D
data.set 0xA0111CE4 %long   0x45FFDC16
data.set 0xA0111CE8 %long   0x1EAD4A0D
data.set 0xA0111CEC %long   0x455BD7C6
data.set 0xA0111CF0 %long   0x2077EC52
data.set 0xA0111CF4 %long   0x72985BA6
data.set 0xA0111CF8 %long   0xD6BEB3D2
data.set 0xA0111CFC %long   0xE048895B
data.set 0xA0111D00 %long   0x32B14FB0
data.set 0xA0111D04 %long   0x710780F4
data.set 0xA0111D08 %long   0x8B182B37
data.set 0xA0111D0C %long   0xE5C6E2DB
data.set 0xA0111D10 %long   0x4DDADBD7
data.set 0xA0111D14 %long   0xF55E4CF3
data.set 0xA0111D18 %long   0x8AF02B9E
data.set 0xA0111D1C %long   0x287D89C2
data.set 0xA0111D20 %long   0x016EA756
data.set 0xA0111D24 %long   0xA3D117A9
data.set 0xA0111D28 %long   0xDAB048CA
data.set 0xA0111D2C %long   0x1AD96369
data.set 0xA0111D30 %long   0xCF82F91B
data.set 0xA0111D34 %long   0x64F09A0F
data.set 0xA0111D38 %long   0x2EFFF058
data.set 0xA0111D3C %long   0x7E98D552
data.set 0xA0111D40 %long   0x9CB16FFB
data.set 0xA0111D44 %long   0xC039F9A4
data.set 0xA0111D48 %long   0x34F05665
data.set 0xA0111D4C %long   0x708A8B44
data.set 0xA0111D50 %long   0xB247E55E
data.set 0xA0111D54 %long   0x4B012EE6
data.set 0xA0111D58 %long   0x90EE3641
data.set 0xA0111D5C %long   0x0914B96A
data.set 0xA0111D60 %long   0xE570FE50
data.set 0xA0111D64 %long   0x5FE76CB3
data.set 0xA0111D68 %long   0xB983DFFC
data.set 0xA0111D6C %long   0x77256DD0
data.set 0xA0111D70 %long   0xCC058EA3
data.set 0xA0111D74 %long   0xF961E360
data.set 0xA0111D78 %long   0xEB68B246
data.set 0xA0111D7C %long   0x8B09F7DF
data.set 0xA0111D80 %long   0xD243CA61
data.set 0xA0111D84 %long   0x66164F81
data.set 0xA0111D88 %long   0x387B4586
data.set 0xA0111D8C %long   0x9E44E7F0
data.set 0xA0111D90 %long   0xA69A4964
data.set 0xA0111D94 %long   0xC09F468C
data.set 0xA0111D98 %long   0x1DE378CC
data.set 0xA0111D9C %long   0xBB7A37A2
data.set 0xA0111DA0 %long   0x133DFD9E
data.set 0xA0111DA4 %long   0x5346365D
data.set 0xA0111DA8 %long   0x5FC07561
data.set 0xA0111DAC %long   0x86C422BA
data.set 0xA0111DB0 %long   0xF0D50E45
data.set 0xA0111DB4 %long   0xEE713591
data.set 0xA0111DB8 %long   0xF86C905F
data.set 0xA0111DBC %long   0xD93E10AC
data.set 0xA0111DC0 %long   0xF86FFEBF
data.set 0xA0111DC4 %long   0xD33F2D68
data.set 0xA0111DC8 %long   0x8012744F
data.set 0xA0111DCC %long   0x33DCBCF3
data.set 0xA0111DD0 %long   0x715EB286
data.set 0xA0111DD4 %long   0xC2E4A5F0
data.set 0xA0111DD8 %long   0x9321617C
data.set 0xA0111DDC %long   0x7B426FBB
data.set 0xA0111DE0 %long   0x7ED74AB8
data.set 0xA0111DE4 %long   0xCC893B31
data.set 0xA0111DE8 %long   0x52AE1D6C
data.set 0xA0111DEC %long   0x9F5B23DD
data.set 0xA0111DF0 %long   0xBCED4503
data.set 0xA0111DF4 %long   0x10F5B73E
data.set 0xA0111DF8 %long   0xDF71A563
data.set 0xA0111DFC %long   0x3AE784E8
data.set 0xA0111E00 %long   0x43A43671
data.set 0xA0111E04 %long   0x15031512
data.set 0xA0111E08 %long   0x495E2D27
data.set 0xA0111E0C %long   0xEFE340AC
data.set 0xA0111E10 %long   0x75B40693
data.set 0xA0111E14 %long   0xCEA9860F
data.set 0xA0111E18 %long   0xB2884844
data.set 0xA0111E1C %long   0x716F2605
data.set 0xA0111E20 %long   0x83632F29
data.set 0xA0111E24 %long   0x3FF30209
data.set 0xA0111E28 %long   0xDAD9B206
data.set 0xA0111E2C %long   0x1EDDDAED
data.set 0xA0111E30 %long   0xA399CBFA
data.set 0xA0111E34 %long   0xC1423CB1
data.set 0xA0111E38 %long   0xDFDC19B4
data.set 0xA0111E3C %long   0x5EAAD393
data.set 0xA0111E40 %long   0xB8775C24
data.set 0xA0111E44 %long   0xAB7FDEAA
data.set 0xA0111E48 %long   0x08C16579
data.set 0xA0111E4C %long   0x86952C73
data.set 0xA0111E50 %long   0x7029B78B
data.set 0xA0111E54 %long   0x1CC800F8
data.set 0xA0111E58 %long   0xAD0F82CE
data.set 0xA0111E5C %long   0x6CCFE8E2
data.set 0xA0111E60 %long   0xC2E34B05
data.set 0xA0111E64 %long   0xBD252C5C
data.set 0xA0111E68 %long   0x6CB8FFAB
data.set 0xA0111E6C %long   0x79C9F03B
data.set 0xA0111E70 %long   0x712B32E2
data.set 0xA0111E74 %long   0x96332112
data.set 0xA0111E78 %long   0x2BAEDD7F
data.set 0xA0111E7C %long   0xDB756DFB
data.set 0xA0111E80 %long   0x2090B648
data.set 0xA0111E84 %long   0x40BAC1F0
data.set 0xA0111E88 %long   0x0233AA1F
data.set 0xA0111E8C %long   0x416A8AC3
data.set 0xA0111E90 %long   0x1B86349E
data.set 0xA0111E94 %long   0xCFF5AE7B
data.set 0xA0111E98 %long   0x745DC576
data.set 0xA0111E9C %long   0xC84339BB
data.set 0xA0111EA0 %long   0xD568D3D5
data.set 0xA0111EA4 %long   0xD758F278
data.set 0xA0111EA8 %long   0x2600D556
data.set 0xA0111EAC %long   0xB03B4B3E
data.set 0xA0111EB0 %long   0x37399579
data.set 0xA0111EB4 %long   0xB44AC09C
data.set 0xA0111EB8 %long   0x717A490E
data.set 0xA0111EBC %long   0x6159DB0A
data.set 0xA0111EC0 %long   0xF3B43D32
data.set 0xA0111EC4 %long   0x07FC00B0
data.set 0xA0111EC8 %long   0xA78F0B57
data.set 0xA0111ECC %long   0x29E8F50B
data.set 0xA0111ED0 %long   0x6255C3CF
data.set 0xA0111ED4 %long   0xCD488F1C
data.set 0xA0111ED8 %long   0xD183637B
data.set 0xA0111EDC %long   0x8D842E7C
data.set 0xA0111EE0 %long   0xA4EB9C76
data.set 0xA0111EE4 %long   0x9271E946
data.set 0xA0111EE8 %long   0xEAE6CFF7
data.set 0xA0111EEC %long   0xB8528F51
data.set 0xA0111EF0 %long   0xFBA4E75C
data.set 0xA0111EF4 %long   0xA8C63BD2
data.set 0xA0111EF8 %long   0x9F3E7FC7
data.set 0xA0111EFC %long   0xCB8B8904
data.set 0xA0111F00 %long   0xFF22DD5D
data.set 0xA0111F04 %long   0xFB9B1AFE
data.set 0xA0111F08 %long   0x8CA491BD
data.set 0xA0111F0C %long   0x9CD9386B
data.set 0xA0111F10 %long   0x31D79CB1
data.set 0xA0111F14 %long   0xBC548F9A
data.set 0xA0111F18 %long   0x2DC9C985
data.set 0xA0111F1C %long   0xD90C40B4
data.set 0xA0111F20 %long   0x1F2E0C11
data.set 0xA0111F24 %long   0x9DCFB3BB
data.set 0xA0111F28 %long   0x10210F1D
data.set 0xA0111F2C %long   0x7A22A1E3
data.set 0xA0111F30 %long   0x6B34D8F9
data.set 0xA0111F34 %long   0xB17D323B
data.set 0xA0111F38 %long   0x56EB1D9E
data.set 0xA0111F3C %long   0x44ACC861
data.set 0xA0111F40 %long   0x677FDD10
data.set 0xA0111F44 %long   0xE5F53790
data.set 0xA0111F48 %long   0x26A58AE0
data.set 0xA0111F4C %long   0xD4CC1B0B
data.set 0xA0111F50 %long   0x716F9182
data.set 0xA0111F54 %long   0xE2EAF4C0
data.set 0xA0111F58 %long   0x7B758AD0
data.set 0xA0111F5C %long   0x8EB7E048
data.set 0xA0111F60 %long   0xE590EB07
data.set 0xA0111F64 %long   0xDDF3C9A1
data.set 0xA0111F68 %long   0x159ABF94
data.set 0xA0111F6C %long   0xDCAFDCCC
data.set 0xA0111F70 %long   0x2082BB15
data.set 0xA0111F74 %long   0x6C945A4B
data.set 0xA0111F78 %long   0x57CB33B8
data.set 0xA0111F7C %long   0xE0256BA9
data.set 0xA0111F80 %long   0xCB9B902F
data.set 0xA0111F84 %long   0xC8859109
data.set 0xA0111F88 %long   0xB9225327
data.set 0xA0111F8C %long   0x28928004
data.set 0xA0111F90 %long   0x7B35F0A9
data.set 0xA0111F94 %long   0x4B8404BB
data.set 0xA0111F98 %long   0x83BB4599
data.set 0xA0111F9C %long   0xD38303EE
data.set 0xA0111FA0 %long   0x0C26B244
data.set 0xA0111FA4 %long   0xD6A40745
data.set 0xA0111FA8 %long   0x347C3B0C
data.set 0xA0111FAC %long   0x0E70E791
data.set 0xA0111FB0 %long   0xB9B8CBD4
data.set 0xA0111FB4 %long   0x481AEAB3
data.set 0xA0111FB8 %long   0x9183AD1C
data.set 0xA0111FBC %long   0x621FA6B5
data.set 0xA0111FC0 %long   0x9CCF6906
data.set 0xA0111FC4 %long   0xCB509206
data.set 0xA0111FC8 %long   0x3F12121D
data.set 0xA0111FCC %long   0xEE33E62A
data.set 0xA0111FD0 %long   0x681B9A6A
data.set 0xA0111FD4 %long   0xF9D2121F
data.set 0xA0111FD8 %long   0x38D60B01
data.set 0xA0111FDC %long   0x366DCED4
data.set 0xA0111FE0 %long   0x728A9D51
data.set 0xA0111FE4 %long   0x3611D643
data.set 0xA0111FE8 %long   0x0E237E57
data.set 0xA0111FEC %long   0xB8842A18
data.set 0xA0111FF0 %long   0x5D7B4315
data.set 0xA0111FF4 %long   0x1201A9AF
data.set 0xA0111FF8 %long   0xE9968A83
data.set 0xA0111FFC %long   0x7FDC9487
data.set 0xA0112000 %long   0x051F4711
data.set 0xA0112004 %long   0x97052F69
data.set 0xA0112008 %long   0xBDBEAF4E
data.set 0xA011200C %long   0x918399D4
data.set 0xA0112010 %long   0xD1F29596
data.set 0xA0112014 %long   0xE3084932
data.set 0xA0112018 %long   0x65DF2DBE
data.set 0xA011201C %long   0x5DA31489
data.set 0xA0112020 %long   0x1B389FB7
data.set 0xA0112024 %long   0xADA227A6
data.set 0xA0112028 %long   0xB32B543C
data.set 0xA011202C %long   0x20E1DF63
data.set 0xA0112030 %long   0x48171429
data.set 0xA0112034 %long   0x7604CEF5
data.set 0xA0112038 %long   0xFF039174
data.set 0xA011203C %long   0x2625AAF5
data.set 0xA0112040 %long   0x178CC1CD
data.set 0xA0112044 %long   0x0B9F3532
data.set 0xA0112048 %long   0x39A3501E
data.set 0xA011204C %long   0x173B721B
data.set 0xA0112050 %long   0xACF9C43C
data.set 0xA0112054 %long   0xC9ADA36A
data.set 0xA0112058 %long   0x7FECCFFE
data.set 0xA011205C %long   0x14E7D9B2
data.set 0xA0112060 %long   0x558BC2B4
data.set 0xA0112064 %long   0xBE05E579
data.set 0xA0112068 %long   0x28FDC771
data.set 0xA011206C %long   0x0BF279C6
data.set 0xA0112070 %long   0x67C2EC18
data.set 0xA0112074 %long   0x3DE964CB
data.set 0xA0112078 %long   0x9C055786
data.set 0xA011207C %long   0x3555B32B
data.set 0xA0112080 %long   0x2CD5F932
data.set 0xA0112084 %long   0x3F76737A
data.set 0xA0112088 %long   0x02217A8D
data.set 0xA011208C %long   0x1F37B1F8
data.set 0xA0112090 %long   0x05F0798C
data.set 0xA0112094 %long   0x75636F15
data.set 0xA0112098 %long   0x11F1646E
data.set 0xA011209C %long   0x64C7BF85
data.set 0xA01120A0 %long   0x60221340
data.set 0xA01120A4 %long   0x92253319
data.set 0xA01120A8 %long   0x2785699A
data.set 0xA01120AC %long   0xB5D21458
data.set 0xA01120B0 %long   0x09F7839F
data.set 0xA01120B4 %long   0x162E447F
data.set 0xA01120B8 %long   0x02D37AE6
data.set 0xA01120BC %long   0x3A753256
data.set 0xA01120C0 %long   0x2A32B2FA
data.set 0xA01120C4 %long   0xBAF50C37
data.set 0xA01120C8 %long   0x4C3DA125
data.set 0xA01120CC %long   0xDFD9C731
data.set 0xA01120D0 %long   0xF5B4CE19
data.set 0xA01120D4 %long   0x3977DE83
data.set 0xA01120D8 %long   0x78EEB9BB
data.set 0xA01120DC %long   0x7FC662E1
data.set 0xA01120E0 %long   0x2F274356
data.set 0xA01120E4 %long   0x37EEDB5F
data.set 0xA01120E8 %long   0xEB844AB4
data.set 0xA01120EC %long   0xD16ADCBA
data.set 0xA01120F0 %long   0xB2DA2577
data.set 0xA01120F4 %long   0x9515F5C9
data.set 0xA01120F8 %long   0xCF0ED5F9
data.set 0xA01120FC %long   0xD80BB6B1
data.set 0xA0112100 %long   0x5BD521D4
data.set 0xA0112104 %long   0xF28BBBA8
data.set 0xA0112108 %long   0x71A6CFCB
data.set 0xA011210C %long   0x75F7D0E5
data.set 0xA0112110 %long   0x500D0518
data.set 0xA0112114 %long   0xAD9739D5
data.set 0xA0112118 %long   0x2CD72254
data.set 0xA011211C %long   0xA2B4075B
data.set 0xA0112120 %long   0x6522475E
data.set 0xA0112124 %long   0x2B5AD09D
data.set 0xA0112128 %long   0x621AAFC1
data.set 0xA011212C %long   0x61D41D49
data.set 0xA0112130 %long   0x03884158
data.set 0xA0112134 %long   0x9B2340A8
data.set 0xA0112138 %long   0x64316C38
data.set 0xA011213C %long   0x7B25AFE0
data.set 0xA0112140 %long   0x5D4F62B3
data.set 0xA0112144 %long   0x92CEE08B
data.set 0xA0112148 %long   0xDA5CF4B6
data.set 0xA011214C %long   0x778A7F98
data.set 0xA0112150 %long   0x780D7904
data.set 0xA0112154 %long   0x9C34DAA2
data.set 0xA0112158 %long   0x6E927D6F
data.set 0xA011215C %long   0x5FAAB4D3
data.set 0xA0112160 %long   0x39C904E9
data.set 0xA0112164 %long   0xD58E741E
data.set 0xA0112168 %long   0xE16448B0
data.set 0xA011216C %long   0x97C7C377
data.set 0xA0112170 %long   0x477B043D
data.set 0xA0112174 %long   0x09AC1F24
data.set 0xA0112178 %long   0xB67A4D88
data.set 0xA011217C %long   0x950CE1C5
data.set 0xA0112180 %long   0x870EC05B
data.set 0xA0112184 %long   0x293A2937
data.set 0xA0112188 %long   0x4E226799
data.set 0xA011218C %long   0xBB7A0E02
data.set 0xA0112190 %long   0x5D1CC2C1
data.set 0xA0112194 %long   0x37B37F7B
data.set 0xA0112198 %long   0xC729E9A8
data.set 0xA011219C %long   0x165793DE
data.set 0xA01121A0 %long   0xD3D0DE11
data.set 0xA01121A4 %long   0x81973ADA
data.set 0xA01121A8 %long   0x5F8C9254
data.set 0xA01121AC %long   0xD1E1C189
data.set 0xA01121B0 %long   0x861E9CED
data.set 0xA01121B4 %long   0xC82AB324
data.set 0xA01121B8 %long   0x1DB3154B
data.set 0xA01121BC %long   0x447029A8
data.set 0xA01121C0 %long   0x061D68D6
data.set 0xA01121C4 %long   0x194223E9
data.set 0xA01121C8 %long   0xF62317B1
data.set 0xA01121CC %long   0x94975975
data.set 0xA01121D0 %long   0xA54E74D1
data.set 0xA01121D4 %long   0xE83C5A90
data.set 0xA01121D8 %long   0x1F53F219
data.set 0xA01121DC %long   0x69D6CDFA
data.set 0xA01121E0 %long   0x4E2C8FDD
data.set 0xA01121E4 %long   0xEF7D071A
data.set 0xA01121E8 %long   0xFA985513
data.set 0xA01121EC %long   0x93A6AAD3
data.set 0xA01121F0 %long   0xE2C22DAF
data.set 0xA01121F4 %long   0xFB944EFF
data.set 0xA01121F8 %long   0xEA66303B
data.set 0xA01121FC %long   0xC5BBE2D2
data.set 0xA0112200 %long   0x0B514D15
data.set 0xA0112204 %long   0x1F6AC3CA
data.set 0xA0112208 %long   0x4D1BD196
data.set 0xA011220C %long   0xEE5A8287
data.set 0xA0112210 %long   0xDDD20E4A
data.set 0xA0112214 %long   0x1C9747F6
data.set 0xA0112218 %long   0xB9A219C4
data.set 0xA011221C %long   0x61C5307B
data.set 0xA0112220 %long   0x48C52212
data.set 0xA0112224 %long   0x0668644D
data.set 0xA0112228 %long   0xC0E8276A
data.set 0xA011222C %long   0xED779827
data.set 0xA0112230 %long   0x56C2435E
data.set 0xA0112234 %long   0x2690782E
data.set 0xA0112238 %long   0x6A348002
data.set 0xA011223C %long   0x5727591C
data.set 0xA0112240 %long   0x9E85E52C
data.set 0xA0112244 %long   0x5201F50D
data.set 0xA0112248 %long   0xCCA1190A
data.set 0xA011224C %long   0x67831775
data.set 0xA0112250 %long   0x345751BB
data.set 0xA0112254 %long   0x11DC536F
data.set 0xA0112258 %long   0x91DC65DB
data.set 0xA011225C %long   0x2223C1D4
data.set 0xA0112260 %long   0x5DDD6244
data.set 0xA0112264 %long   0xB6E9083D
data.set 0xA0112268 %long   0x8310055C
data.set 0xA011226C %long   0x5FD84DD6
data.set 0xA0112270 %long   0xBA0E382E
data.set 0xA0112274 %long   0x3DEF8117
data.set 0xA0112278 %long   0x86D96B8C
data.set 0xA011227C %long   0x1D6744E1
data.set 0xA0112280 %long   0x81EDE09A
data.set 0xA0112284 %long   0x07A2D3B4
data.set 0xA0112288 %long   0xEB521C39
data.set 0xA011228C %long   0x7FE6270D
data.set 0xA0112290 %long   0x42CADE6E
data.set 0xA0112294 %long   0xA0ECC81F
data.set 0xA0112298 %long   0xF094FDA0
data.set 0xA011229C %long   0xADED1F08
data.set 0xA01122A0 %long   0xB3FC6074
data.set 0xA01122A4 %long   0x09202C2F
data.set 0xA01122A8 %long   0x46D6FCFD
data.set 0xA01122AC %long   0xF32A5069
data.set 0xA01122B0 %long   0xAC08D8C0
data.set 0xA01122B4 %long   0x2992DAA4
data.set 0xA01122B8 %long   0xFCB38DB8
data.set 0xA01122BC %long   0x6D395E40
data.set 0xA01122C0 %long   0x8B93197B
data.set 0xA01122C4 %long   0xCBA65F12
data.set 0xA01122C8 %long   0x3E2B0C35
data.set 0xA01122CC %long   0xCD9758C1
data.set 0xA01122D0 %long   0x29C747CE
data.set 0xA01122D4 %long   0x228FA8B5
data.set 0xA01122D8 %long   0x8B38E4D6
data.set 0xA01122DC %long   0xE54660B4
data.set 0xA01122E0 %long   0x2F24B38F
data.set 0xA01122E4 %long   0x92FCD421
data.set 0xA01122E8 %long   0xA4EC2C3F
data.set 0xA01122EC %long   0x27A019ED
data.set 0xA01122F0 %long   0xEB256706
data.set 0xA01122F4 %long   0xF7C9DE0C
data.set 0xA01122F8 %long   0xBD51231C
data.set 0xA01122FC %long   0xC4B8D7E2
data.set 0xA0112300 %long   0xD8639DEB
data.set 0xA0112304 %long   0x1C87C838
data.set 0xA0112308 %long   0x50103B8E
data.set 0xA011230C %long   0x37E72D10
data.set 0xA0112310 %long   0x3842CB4A
data.set 0xA0112314 %long   0x52AB158F
data.set 0xA0112318 %long   0x13C93267
data.set 0xA011231C %long   0xE75BAC3C
data.set 0xA0112320 %long   0x36149B99
data.set 0xA0112324 %long   0x050B1E37
data.set 0xA0112328 %long   0xFDFE5B91
data.set 0xA011232C %long   0x445E3453
data.set 0xA0112330 %long   0x7F405B11
data.set 0xA0112334 %long   0xF978F8F8
data.set 0xA0112338 %long   0x9A98F222
data.set 0xA011233C %long   0x03684734
data.set 0xA0112340 %long   0x85888589
data.set 0xA0112344 %long   0xCF84B415
data.set 0xA0112348 %long   0x611388BC
data.set 0xA011234C %long   0x9178DB4D
data.set 0xA0112350 %long   0x85E6E86F
data.set 0xA0112354 %long   0x3C53B22F
data.set 0xA0112358 %long   0x5D5AF681
data.set 0xA011235C %long   0xDBD9003E
data.set 0xA0112360 %long   0xB00311D4
data.set 0xA0112364 %long   0x99168D28
data.set 0xA0112368 %long   0x8D82655A
data.set 0xA011236C %long   0xF3AE610A
data.set 0xA0112370 %long   0x65C040A0
data.set 0xA0112374 %long   0x667CE152
data.set 0xA0112378 %long   0x2C097BF3
data.set 0xA011237C %long   0x59CFDA71
data.set 0xA0112380 %long   0x0FF5036B
data.set 0xA0112384 %long   0xC1EA903D
data.set 0xA0112388 %long   0x6B6936FC
data.set 0xA011238C %long   0xC3D74064
data.set 0xA0112390 %long   0xD276E2E7
data.set 0xA0112394 %long   0xC3442857
data.set 0xA0112398 %long   0xCE23DD84
data.set 0xA011239C %long   0x540C31EB
data.set 0xA01123A0 %long   0xE2D9D1C5
data.set 0xA01123A4 %long   0xD21B1D19
data.set 0xA01123A8 %long   0xB6E9BE3A
data.set 0xA01123AC %long   0xC7356D57
data.set 0xA01123B0 %long   0x48198832
data.set 0xA01123B4 %long   0x6BCD9D74
data.set 0xA01123B8 %long   0xA28D08FC
data.set 0xA01123BC %long   0x18E10294
data.set 0xA01123C0 %long   0x06391F5B
data.set 0xA01123C4 %long   0xB983A7A2
data.set 0xA01123C8 %long   0x6257A351
data.set 0xA01123CC %long   0xBB95F490
data.set 0xA01123D0 %long   0x417FCFC8
data.set 0xA01123D4 %long   0xBED752FD
data.set 0xA01123D8 %long   0x23CFB131
data.set 0xA01123DC %long   0xC31CF684
data.set 0xA01123E0 %long   0x3E7E863C
data.set 0xA01123E4 %long   0xBF9FECB5
data.set 0xA01123E8 %long   0xFB3864EA
data.set 0xA01123EC %long   0x4E1FEF97
data.set 0xA01123F0 %long   0xEDF2BAF9
data.set 0xA01123F4 %long   0x3C218461
data.set 0xA01123F8 %long   0x0BF94539
data.set 0xA01123FC %long   0xB39B3259
data.set 0xA0112400 %long   0x0C516343
data.set 0xA0112404 %long   0xEF216F4E
data.set 0xA0112408 %long   0x7F3E04B7
data.set 0xA011240C %long   0xD2A31FBC
data.set 0xA0112410 %long   0x163EDFD5
data.set 0xA0112414 %long   0xD33C856D
data.set 0xA0112418 %long   0xFFEC934B
data.set 0xA011241C %long   0x074E01F9
data.set 0xA0112420 %long   0x384A7A87
data.set 0xA0112424 %long   0xA9574D89
data.set 0xA0112428 %long   0xC06FD9A7
data.set 0xA011242C %long   0x8F8E5A63
data.set 0xA0112430 %long   0xF3E9DAF3
data.set 0xA0112434 %long   0xA9B095AF
data.set 0xA0112438 %long   0x2FAA38B2
data.set 0xA011243C %long   0x3DFD1105
data.set 0xA0112440 %long   0xD1A439E7
data.set 0xA0112444 %long   0xD243C6CA
data.set 0xA0112448 %long   0x234CD321
data.set 0xA011244C %long   0x7B1C3DA7
data.set 0xA0112450 %long   0xCB0AABAD
data.set 0xA0112454 %long   0x5D66AE02
data.set 0xA0112458 %long   0x4B09B306
data.set 0xA011245C %long   0x34FB14F9
data.set 0xA0112460 %long   0x596ACFD1
data.set 0xA0112464 %long   0xABB1874B
data.set 0xA0112468 %long   0x38E0B9A0
data.set 0xA011246C %long   0x23FC6B98
data.set 0xA0112470 %long   0xBFAE071F
data.set 0xA0112474 %long   0x0760D363
data.set 0xA0112478 %long   0xE401DEB1
data.set 0xA011247C %long   0x23D0B708
data.set 0xA0112480 %long   0x75E29A6E
data.set 0xA0112484 %long   0x862A7C11
data.set 0xA0112488 %long   0xE7D2DDAE
data.set 0xA011248C %long   0xC516B3F6
data.set 0xA0112490 %long   0xB4E96DB8
data.set 0xA0112494 %long   0x5C54CF1A
data.set 0xA0112498 %long   0xE930EEC7
data.set 0xA011249C %long   0x3E8ABF4D
data.set 0xA01124A0 %long   0xE7050D25
data.set 0xA01124A4 %long   0xD49CD02F
data.set 0xA01124A8 %long   0x08CB9496
data.set 0xA01124AC %long   0x1B189080
data.set 0xA01124B0 %long   0xF619E5C5
data.set 0xA01124B4 %long   0xA69D7955
data.set 0xA01124B8 %long   0x2ECE2EF5
data.set 0xA01124BC %long   0x0D552154
data.set 0xA01124C0 %long   0xA0D326C0
data.set 0xA01124C4 %long   0x21066CE8
data.set 0xA01124C8 %long   0xDB348285
data.set 0xA01124CC %long   0x675CF104
data.set 0xA01124D0 %long   0x9B5574FB
data.set 0xA01124D4 %long   0x1D44ACE2
data.set 0xA01124D8 %long   0x46842131
data.set 0xA01124DC %long   0x61206D8A
data.set 0xA01124E0 %long   0x9F1732DC
data.set 0xA01124E4 %long   0x58861044
data.set 0xA01124E8 %long   0xF0D1C5B4
data.set 0xA01124EC %long   0x929BE3AC
data.set 0xA01124F0 %long   0x7F0A5459
data.set 0xA01124F4 %long   0x0FD26016
data.set 0xA01124F8 %long   0x71071B36
data.set 0xA01124FC %long   0x25C716BD
data.set 0xA0112500 %long   0x5A4777FE
data.set 0xA0112504 %long   0xD40815BD
data.set 0xA0112508 %long   0x4075562C
data.set 0xA011250C %long   0xACDEF384
data.set 0xA0112510 %long   0xEB00FA1C
data.set 0xA0112514 %long   0xE48FB1BF
data.set 0xA0112518 %long   0x6F674D38
data.set 0xA011251C %long   0x572A3F78
data.set 0xA0112520 %long   0x0D7C2D2C
data.set 0xA0112524 %long   0xA63C4E9D
data.set 0xA0112528 %long   0xD1EA749D
data.set 0xA011252C %long   0x802EC5A9
data.set 0xA0112530 %long   0x27ABFEA3
data.set 0xA0112534 %long   0x862E3CB7
data.set 0xA0112538 %long   0xE9FF775A
data.set 0xA011253C %long   0x2BE8F6D5
data.set 0xA0112540 %long   0x61E6430C
data.set 0xA0112544 %long   0x58CD847D
data.set 0xA0112548 %long   0x9257D403
data.set 0xA011254C %long   0x3203D369
data.set 0xA0112550 %long   0x0481E05F
data.set 0xA0112554 %long   0xD647F58E
data.set 0xA0112558 %long   0xEB5CB153
data.set 0xA011255C %long   0x31CF8B8C
data.set 0xA0112560 %long   0x0912F081
data.set 0xA0112564 %long   0xBE692766
data.set 0xA0112568 %long   0xCB3FC37D
data.set 0xA011256C %long   0xE83D220C
data.set 0xA0112570 %long   0x7727A9C6
data.set 0xA0112574 %long   0x40CA910A
data.set 0xA0112578 %long   0x7E52F145
data.set 0xA011257C %long   0x10FD9E00
data.set 0xA0112580 %long   0x0D4DB077
data.set 0xA0112584 %long   0xAF89F340
data.set 0xA0112588 %long   0x69466746
data.set 0xA011258C %long   0x3851663D
data.set 0xA0112590 %long   0xBB330F23
data.set 0xA0112594 %long   0xDEC8B421
data.set 0xA0112598 %long   0xCC9E628C
data.set 0xA011259C %long   0x2B6A528A
data.set 0xA01125A0 %long   0xCE0C89AF
data.set 0xA01125A4 %long   0x85DB6569
data.set 0xA01125A8 %long   0xC13367F5
data.set 0xA01125AC %long   0x3C8365BF
data.set 0xA01125B0 %long   0x80A8A242
data.set 0xA01125B4 %long   0x144DC385
data.set 0xA01125B8 %long   0x7FA0A875
data.set 0xA01125BC %long   0x5FCCF78C
data.set 0xA01125C0 %long   0xD2722D83
data.set 0xA01125C4 %long   0x79DED2D4
data.set 0xA01125C8 %long   0xAFB6F483
data.set 0xA01125CC %long   0x36BA4C75
data.set 0xA01125D0 %long   0x5EA3E93B
data.set 0xA01125D4 %long   0x75CC840F
data.set 0xA01125D8 %long   0x26A3F51A
data.set 0xA01125DC %long   0xF8D760A0
data.set 0xA01125E0 %long   0x5F823130
data.set 0xA01125E4 %long   0xE8AC872D
data.set 0xA01125E8 %long   0xD2419147
data.set 0xA01125EC %long   0x6067A735
data.set 0xA01125F0 %long   0x355A6316
data.set 0xA01125F4 %long   0xF6BB0203
data.set 0xA01125F8 %long   0xBC5274BC
data.set 0xA01125FC %long   0x4E311BFA
data.set 0xA0112600 %long   0x1493D301
data.set 0xA0112604 %long   0xB11B61FD
data.set 0xA0112608 %long   0x95CE0FA9
data.set 0xA011260C %long   0xDF2CEAEB
data.set 0xA0112610 %long   0x7EC2F0BD
data.set 0xA0112614 %long   0xCA1ED6E2
data.set 0xA0112618 %long   0xF48CB195
data.set 0xA011261C %long   0x363F4DAC
data.set 0xA0112620 %long   0x8208CF99
data.set 0xA0112624 %long   0x27565535
data.set 0xA0112628 %long   0x4C3F8A60
data.set 0xA011262C %long   0x4C9093E3
data.set 0xA0112630 %long   0x06269344
data.set 0xA0112634 %long   0x07979644
data.set 0xA0112638 %long   0x5DFF645D
data.set 0xA011263C %long   0xD2A951BC
data.set 0xA0112640 %long   0x5B7B26C9
data.set 0xA0112644 %long   0x2DBBF660
data.set 0xA0112648 %long   0x15474DAE
data.set 0xA011264C %long   0xE47A12C9
data.set 0xA0112650 %long   0x8829DA01
data.set 0xA0112654 %long   0x06DA5F67
data.set 0xA0112658 %long   0x1E553113
data.set 0xA011265C %long   0xC55495FD
data.set 0xA0112660 %long   0x4CBE84BB
data.set 0xA0112664 %long   0x43DFCCA0
data.set 0xA0112668 %long   0x09938D35
data.set 0xA011266C %long   0xFD5BB20D
data.set 0xA0112670 %long   0x847714D2
data.set 0xA0112674 %long   0x7584AA28
data.set 0xA0112678 %long   0xC9257E0F
data.set 0xA011267C %long   0xF1F91AA3
data.set 0xA0112680 %long   0x271C9144
data.set 0xA0112684 %long   0x10A7E41F
data.set 0xA0112688 %long   0xD22405D6
data.set 0xA011268C %long   0x7BBFF95B
data.set 0xA0112690 %long   0x1BE6D7F2
data.set 0xA0112694 %long   0x3F95ABD5
data.set 0xA0112698 %long   0x2D2D69C7
data.set 0xA011269C %long   0xB048F0BA
data.set 0xA01126A0 %long   0x796D92BD
data.set 0xA01126A4 %long   0x79D634D9
data.set 0xA01126A8 %long   0x9CAD8DCF
data.set 0xA01126AC %long   0x646F5683
data.set 0xA01126B0 %long   0x5E894D77
data.set 0xA01126B4 %long   0xD0FC72C9
data.set 0xA01126B8 %long   0xD3C0A4CC
data.set 0xA01126BC %long   0x92DA9AB6
data.set 0xA01126C0 %long   0x783C4D04
data.set 0xA01126C4 %long   0xDDB02405
data.set 0xA01126C8 %long   0x137FB8B8
data.set 0xA01126CC %long   0x7E27621F
data.set 0xA01126D0 %long   0xE6737F3E
data.set 0xA01126D4 %long   0x44E84FA8
data.set 0xA01126D8 %long   0x016A164B
data.set 0xA01126DC %long   0x4FD3E381
data.set 0xA01126E0 %long   0xA03C6E46
data.set 0xA01126E4 %long   0x3CB84CBE
data.set 0xA01126E8 %long   0x38CAC6DD
data.set 0xA01126EC %long   0x587C5ABF
data.set 0xA01126F0 %long   0x794EB114
data.set 0xA01126F4 %long   0x832620F5
data.set 0xA01126F8 %long   0x2C6E8D9F
data.set 0xA01126FC %long   0x456616A7
data.set 0xA0112700 %long   0x33486843
data.set 0xA0112704 %long   0xE755E27F
data.set 0xA0112708 %long   0xC89B533C
data.set 0xA011270C %long   0x9FA77935
data.set 0xA0112710 %long   0x318E0A79
data.set 0xA0112714 %long   0x16AF622E
data.set 0xA0112718 %long   0x7D188917
data.set 0xA011271C %long   0xFD19FE80
data.set 0xA0112720 %long   0xFF2EAD8B
data.set 0xA0112724 %long   0xD831D302
data.set 0xA0112728 %long   0xC3C13288
data.set 0xA011272C %long   0x20AA0A04
data.set 0xA0112730 %long   0x83761E0A
data.set 0xA0112734 %long   0xDCB45E09
data.set 0xA0112738 %long   0x198C8BD7
data.set 0xA011273C %long   0x0E067F64
data.set 0xA0112740 %long   0x3F3E08E3
data.set 0xA0112744 %long   0x4E774FB9
data.set 0xA0112748 %long   0xA2D8738C
data.set 0xA011274C %long   0xC6294775
data.set 0xA0112750 %long   0xB57A94E7
data.set 0xA0112754 %long   0xE279A1D8
data.set 0xA0112758 %long   0x0AE92A12
data.set 0xA011275C %long   0xF74CC93C
data.set 0xA0112760 %long   0x9FC258E5
data.set 0xA0112764 %long   0xFD6CACD5
data.set 0xA0112768 %long   0xFC85DEFC
data.set 0xA011276C %long   0xEB644755
data.set 0xA0112770 %long   0xCA31403A
data.set 0xA0112774 %long   0x2E7EDCD1
data.set 0xA0112778 %long   0x59DFE5BF
data.set 0xA011277C %long   0xDF6AE7FE
data.set 0xA0112780 %long   0xA582AD8E
data.set 0xA0112784 %long   0x82073401
data.set 0xA0112788 %long   0x620E3591
data.set 0xA011278C %long   0x08D47AA2
data.set 0xA0112790 %long   0x5161F4C8
data.set 0xA0112794 %long   0xB636022E
data.set 0xA0112798 %long   0x37B32FA7
data.set 0xA011279C %long   0x0E0A42F3
data.set 0xA01127A0 %long   0x6B1872BB
data.set 0xA01127A4 %long   0xE169BA26
data.set 0xA01127A8 %long   0xF0DC57D6
data.set 0xA01127AC %long   0x95E2DB08
data.set 0xA01127B0 %long   0xC6F8470D
data.set 0xA01127B4 %long   0xEA6C662E
data.set 0xA01127B8 %long   0xED42B263
data.set 0xA01127BC %long   0xF085E22C
data.set 0xA01127C0 %long   0xB2D785F9
data.set 0xA01127C4 %long   0xC3E80E02
data.set 0xA01127C8 %long   0xFC257EDC
data.set 0xA01127CC %long   0x3CC015B7
data.set 0xA01127D0 %long   0x1C5DAE95
data.set 0xA01127D4 %long   0x4F930B3D
data.set 0xA01127D8 %long   0x61D91A9A
data.set 0xA01127DC %long   0x63E8ED13
data.set 0xA01127E0 %long   0x4928343B
data.set 0xA01127E4 %long   0x9238C992
data.set 0xA01127E8 %long   0xA6DF927A
data.set 0xA01127EC %long   0x9E2C542C
data.set 0xA01127F0 %long   0x83C404F7
data.set 0xA01127F4 %long   0xF6282427
data.set 0xA01127F8 %long   0x4127F490
data.set 0xA01127FC %long   0xA75E82C5
data.set 0xA0112800 %long   0x910CDEF4
data.set 0xA0112804 %long   0x9E03D70C
data.set 0xA0112808 %long   0x30CAFE2F
data.set 0xA011280C %long   0xC44E616B
data.set 0xA0112810 %long   0xBC2DFE51
data.set 0xA0112814 %long   0x52ADCE71
data.set 0xA0112818 %long   0x2C6A1C6B
data.set 0xA011281C %long   0x1BF0F2A0
data.set 0xA0112820 %long   0xD2B724B9
data.set 0xA0112824 %long   0x2676500A
data.set 0xA0112828 %long   0x8DE1FB3C
data.set 0xA011282C %long   0xC24F5FB7
data.set 0xA0112830 %long   0xE35BC313
data.set 0xA0112834 %long   0xF365F985
data.set 0xA0112838 %long   0x65B80BD0
data.set 0xA011283C %long   0x4FC88937
data.set 0xA0112840 %long   0xE0518632
data.set 0xA0112844 %long   0x775D5FF2
data.set 0xA0112848 %long   0x0C1F4149
data.set 0xA011284C %long   0x56FFBE51
data.set 0xA0112850 %long   0xE8972188
data.set 0xA0112854 %long   0xFF7BE3E2
data.set 0xA0112858 %long   0x30146B0C
data.set 0xA011285C %long   0x36482625
data.set 0xA0112860 %long   0x9988BE93
data.set 0xA0112864 %long   0xFF5926A1
data.set 0xA0112868 %long   0xB76C9DD6
data.set 0xA011286C %long   0xBE3B4AD9
data.set 0xA0112870 %long   0x284C5392
data.set 0xA0112874 %long   0xABD420EA
data.set 0xA0112878 %long   0x4EDAF3F3
data.set 0xA011287C %long   0x488D6EBA
data.set 0xA0112880 %long   0xADEE337A
data.set 0xA0112884 %long   0xFBAF9B64
data.set 0xA0112888 %long   0x54E35932
data.set 0xA011288C %long   0x9BA240FA
data.set 0xA0112890 %long   0x4B99F5ED
data.set 0xA0112894 %long   0x645B5F93
data.set 0xA0112898 %long   0xE640B324
data.set 0xA011289C %long   0xD2973FF8
data.set 0xA01128A0 %long   0xD6D3DFB3
data.set 0xA01128A4 %long   0xFA15F24B
data.set 0xA01128A8 %long   0x12E78A55
data.set 0xA01128AC %long   0x28903BCF
data.set 0xA01128B0 %long   0x9C42FA60
data.set 0xA01128B4 %long   0xF698BE5D
data.set 0xA01128B8 %long   0x68E40A32
data.set 0xA01128BC %long   0xA9BDF2FF
data.set 0xA01128C0 %long   0xD7B59E45
data.set 0xA01128C4 %long   0xDEB81BA8
data.set 0xA01128C8 %long   0x61599BBE
data.set 0xA01128CC %long   0x4C8C4485
data.set 0xA01128D0 %long   0xF00BF7B4
data.set 0xA01128D4 %long   0x2191550F
data.set 0xA01128D8 %long   0x4BEBA3DA
data.set 0xA01128DC %long   0xABF6D0CC
data.set 0xA01128E0 %long   0x60D214C4
data.set 0xA01128E4 %long   0x87AF258B
data.set 0xA01128E8 %long   0x68DD011B
data.set 0xA01128EC %long   0xB9752033
data.set 0xA01128F0 %long   0xFBC5D906
data.set 0xA01128F4 %long   0x74ABDABF
data.set 0xA01128F8 %long   0xFF3C29EA
data.set 0xA01128FC %long   0x6361A746
data.set 0xA0112900 %long   0x2C5902FD
data.set 0xA0112904 %long   0x8AA124F3
data.set 0xA0112908 %long   0x343B1D6D
data.set 0xA011290C %long   0xC5A53A5A
data.set 0xA0112910 %long   0x38964DC0
data.set 0xA0112914 %long   0x2756F240
data.set 0xA0112918 %long   0x52B174D5
data.set 0xA011291C %long   0x5333D0D1
data.set 0xA0112920 %long   0x2EC3F17F
data.set 0xA0112924 %long   0x1A8749C8
data.set 0xA0112928 %long   0xCC7263D1
data.set 0xA011292C %long   0x26860D65
data.set 0xA0112930 %long   0xE256525E
data.set 0xA0112934 %long   0xBCA5E41C
data.set 0xA0112938 %long   0x5DBC4F55
data.set 0xA011293C %long   0x9DF5DC1A
data.set 0xA0112940 %long   0x675D563C
data.set 0xA0112944 %long   0x8B98B80D
data.set 0xA0112948 %long   0x687276FF
data.set 0xA011294C %long   0x04AB2795
data.set 0xA0112950 %long   0x59E06243
data.set 0xA0112954 %long   0x149103C7
data.set 0xA0112958 %long   0xD552FE50
data.set 0xA011295C %long   0x98F54C4F
data.set 0xA0112960 %long   0x19333D0D
data.set 0xA0112964 %long   0x077133D1
data.set 0xA0112968 %long   0x6FB2CCE6
data.set 0xA011296C %long   0xDF0C706E
data.set 0xA0112970 %long   0x30A25DEE
data.set 0xA0112974 %long   0x1CB833DA
data.set 0xA0112978 %long   0xB8ED9FD2
data.set 0xA011297C %long   0x8B062A38
data.set 0xA0112980 %long   0x6946596C
data.set 0xA0112984 %long   0x12785603
data.set 0xA0112988 %long   0x77F4878E
data.set 0xA011298C %long   0x4C875E40
data.set 0xA0112990 %long   0xA48B0F01
data.set 0xA0112994 %long   0x9006AA97
data.set 0xA0112998 %long   0x19064E49
data.set 0xA011299C %long   0x1E1071F2
data.set 0xA01129A0 %long   0xF87FBBE9
data.set 0xA01129A4 %long   0x3411DF9D
data.set 0xA01129A8 %long   0x15B98C60
data.set 0xA01129AC %long   0x98A801AA
data.set 0xA01129B0 %long   0x2A0DC564
data.set 0xA01129B4 %long   0x1EA8E1B3
data.set 0xA01129B8 %long   0xA84B0888
data.set 0xA01129BC %long   0xA3EFE986
data.set 0xA01129C0 %long   0x95C62E25
data.set 0xA01129C4 %long   0x1BA4A3D6
data.set 0xA01129C8 %long   0x4376C90B
data.set 0xA01129CC %long   0xC4D42CDC
data.set 0xA01129D0 %long   0xDAB0605D
data.set 0xA01129D4 %long   0xEBBC1390
data.set 0xA01129D8 %long   0x42D8B66C
data.set 0xA01129DC %long   0xCE8634E8
data.set 0xA01129E0 %long   0x57F00BF0
data.set 0xA01129E4 %long   0x1484569E
data.set 0xA01129E8 %long   0xB349DB40
data.set 0xA01129EC %long   0xB023F1A3
data.set 0xA01129F0 %long   0x4C5073B0
data.set 0xA01129F4 %long   0x99A57A47
data.set 0xA01129F8 %long   0xFBEB8743
data.set 0xA01129FC %long   0x15E39EB2
data.set 0xA0112A00 %long   0xDACD2D35
data.set 0xA0112A04 %long   0xBC0A8377
data.set 0xA0112A08 %long   0x13AC5F2C
data.set 0xA0112A0C %long   0x2EB179F0
data.set 0xA0112A10 %long   0x8ACE02B7
data.set 0xA0112A14 %long   0x97E24013
data.set 0xA0112A18 %long   0xDDAAC451
data.set 0xA0112A1C %long   0x51BAC931
data.set 0xA0112A20 %long   0xC357A381
data.set 0xA0112A24 %long   0x3DE29A71
data.set 0xA0112A28 %long   0xE5CDBC5F
data.set 0xA0112A2C %long   0xE762B91F
data.set 0xA0112A30 %long   0xC6586C7A
data.set 0xA0112A34 %long   0x27755984
data.set 0xA0112A38 %long   0xA308CB51
data.set 0xA0112A3C %long   0xCFBDD7A4
data.set 0xA0112A40 %long   0x50153490
data.set 0xA0112A44 %long   0xAECE15EA
data.set 0xA0112A48 %long   0x2FBC7B2B
data.set 0xA0112A4C %long   0xF40FCC63
data.set 0xA0112A50 %long   0xEBD0541E
data.set 0xA0112A54 %long   0x0BB34F9B
data.set 0xA0112A58 %long   0xC5A37B59
data.set 0xA0112A5C %long   0x2C0A3BBC
data.set 0xA0112A60 %long   0x7544F38C
data.set 0xA0112A64 %long   0x9C2F802C
data.set 0xA0112A68 %long   0x520F63AB
data.set 0xA0112A6C %long   0xF66EBEB1
data.set 0xA0112A70 %long   0x3A25424E
data.set 0xA0112A74 %long   0x1797FDCD
data.set 0xA0112A78 %long   0x6CC9761C
data.set 0xA0112A7C %long   0x2A1626AC
data.set 0xA0112A80 %long   0x77C522D9
data.set 0xA0112A84 %long   0x0998CE8C
data.set 0xA0112A88 %long   0x71ED12EA
data.set 0xA0112A8C %long   0x4D3BD575
data.set 0xA0112A90 %long   0x43FEE5D4
data.set 0xA0112A94 %long   0x13AC0C11
data.set 0xA0112A98 %long   0x431A8916
data.set 0xA0112A9C %long   0x3BE53085
data.set 0xA0112AA0 %long   0xF93CA7E7
data.set 0xA0112AA4 %long   0xEFCCF289
data.set 0xA0112AA8 %long   0xC1CC6869
data.set 0xA0112AAC %long   0xCD05454E
data.set 0xA0112AB0 %long   0x928D1725
data.set 0xA0112AB4 %long   0x936F416D
data.set 0xA0112AB8 %long   0x0CB9FFEC
data.set 0xA0112ABC %long   0xA53618A7
data.set 0xA0112AC0 %long   0xC29153CF
data.set 0xA0112AC4 %long   0x151B8C5F
data.set 0xA0112AC8 %long   0xE899D7D0
data.set 0xA0112ACC %long   0xB4D542B2
data.set 0xA0112AD0 %long   0x7465ACAA
data.set 0xA0112AD4 %long   0xB1A38BAD
data.set 0xA0112AD8 %long   0xFCEE3F40
data.set 0xA0112ADC %long   0xAB94165E
data.set 0xA0112AE0 %long   0xA078CFE3
data.set 0xA0112AE4 %long   0x0F5AA5E9
data.set 0xA0112AE8 %long   0x84F0603B
data.set 0xA0112AEC %long   0x10A9DD49
data.set 0xA0112AF0 %long   0x97572624
data.set 0xA0112AF4 %long   0xAA66DFDC
data.set 0xA0112AF8 %long   0x8702C992
data.set 0xA0112AFC %long   0x8E09D076
data.set 0xA0112B00 %long   0x5388756B
data.set 0xA0112B04 %long   0x9314B522
data.set 0xA0112B08 %long   0x6FAB6E41
data.set 0xA0112B0C %long   0xC5CA5306
data.set 0xA0112B10 %long   0x6A8EFC2A
data.set 0xA0112B14 %long   0x88441C2A
data.set 0xA0112B18 %long   0x61AA4836
data.set 0xA0112B1C %long   0xB0810567
data.set 0xA0112B20 %long   0x4F41C987
data.set 0xA0112B24 %long   0xC64A3F79
data.set 0xA0112B28 %long   0x60F47E1E
data.set 0xA0112B2C %long   0x7CD8AEBD
data.set 0xA0112B30 %long   0xF012A09D
data.set 0xA0112B34 %long   0xCB9DC32D
data.set 0xA0112B38 %long   0xC0DD676F
data.set 0xA0112B3C %long   0xE36EFBC7
data.set 0xA0112B40 %long   0xAB5979C0
data.set 0xA0112B44 %long   0x6ACFEE7F
data.set 0xA0112B48 %long   0x21F1C61E
data.set 0xA0112B4C %long   0x917D472A
data.set 0xA0112B50 %long   0x2BEDBFF8
data.set 0xA0112B54 %long   0x02549CA8
data.set 0xA0112B58 %long   0x1933A5BB
data.set 0xA0112B5C %long   0x7F209E10
data.set 0xA0112B60 %long   0xAE34DCC2
data.set 0xA0112B64 %long   0xABA81F39
data.set 0xA0112B68 %long   0x2A4EA7B5
data.set 0xA0112B6C %long   0x514C95BF
data.set 0xA0112B70 %long   0xDD269ABE
data.set 0xA0112B74 %long   0x52DE5D3F
data.set 0xA0112B78 %long   0xACF57280
data.set 0xA0112B7C %long   0x1902CCE4
data.set 0xA0112B80 %long   0xF4DB9FD4
data.set 0xA0112B84 %long   0x17915D94
data.set 0xA0112B88 %long   0x858F40DB
data.set 0xA0112B8C %long   0x0BDFE8CE
data.set 0xA0112B90 %long   0xBA0E3CAE
data.set 0xA0112B94 %long   0x16459AB5
data.set 0xA0112B98 %long   0xC346DEC6
data.set 0xA0112B9C %long   0x54BF3700
data.set 0xA0112BA0 %long   0x8D43AC7B
data.set 0xA0112BA4 %long   0xEC88034F
data.set 0xA0112BA8 %long   0x8D9A546C
data.set 0xA0112BAC %long   0x02F0E81C
data.set 0xA0112BB0 %long   0xDD08B4B9
data.set 0xA0112BB4 %long   0xB1AF60A1
data.set 0xA0112BB8 %long   0xE4746BDB
data.set 0xA0112BBC %long   0x83985D1F
data.set 0xA0112BC0 %long   0x56A97248
data.set 0xA0112BC4 %long   0x03ECE01C
data.set 0xA0112BC8 %long   0x22046ACF
data.set 0xA0112BCC %long   0xC9079076
data.set 0xA0112BD0 %long   0x41FD3D7B
data.set 0xA0112BD4 %long   0x7D611B2A
data.set 0xA0112BD8 %long   0xD0335385
data.set 0xA0112BDC %long   0xAAFA0851
data.set 0xA0112BE0 %long   0x74F1FEEF
data.set 0xA0112BE4 %long   0x352ABACC
data.set 0xA0112BE8 %long   0x46E1D7BF
data.set 0xA0112BEC %long   0x3778DCF7
data.set 0xA0112BF0 %long   0xD6811725
data.set 0xA0112BF4 %long   0xB99B1AC9
data.set 0xA0112BF8 %long   0xB6241BEB
data.set 0xA0112BFC %long   0x0FE37359
data.set 0xA0112C00 %long   0x0B2AB023
data.set 0xA0112C04 %long   0xF234B349
data.set 0xA0112C08 %long   0xFBA3CE44
data.set 0xA0112C0C %long   0x3174136B
data.set 0xA0112C10 %long   0x5332D72E
data.set 0xA0112C14 %long   0x29C5CA55
data.set 0xA0112C18 %long   0x58F98C0E
data.set 0xA0112C1C %long   0x5A4ADB5D
data.set 0xA0112C20 %long   0xD06B5356
data.set 0xA0112C24 %long   0x5F375413
data.set 0xA0112C28 %long   0xDD1FA070
data.set 0xA0112C2C %long   0x50AF3076
data.set 0xA0112C30 %long   0xE9EC65F8
data.set 0xA0112C34 %long   0x757BD0CE
data.set 0xA0112C38 %long   0x0BBBEB2F
data.set 0xA0112C3C %long   0x0B506ED7
data.set 0xA0112C40 %long   0x927A991E
data.set 0xA0112C44 %long   0x83FCB147
data.set 0xA0112C48 %long   0xC2021142
data.set 0xA0112C4C %long   0x05171311
data.set 0xA0112C50 %long   0x8AF9B92F
data.set 0xA0112C54 %long   0x4455124F
data.set 0xA0112C58 %long   0x44D4BA0C
data.set 0xA0112C5C %long   0xEB04C739
data.set 0xA0112C60 %long   0x7E73694F
data.set 0xA0112C64 %long   0x2790C77F
data.set 0xA0112C68 %long   0xE72A20BE
data.set 0xA0112C6C %long   0x042288B9
data.set 0xA0112C70 %long   0x86BBC2E1
data.set 0xA0112C74 %long   0x5C996BE1
data.set 0xA0112C78 %long   0xC64F9E32
data.set 0xA0112C7C %long   0x2D5B584B
data.set 0xA0112C80 %long   0xD84F5ABE
data.set 0xA0112C84 %long   0xE2ECB8F3
data.set 0xA0112C88 %long   0x658D6460
data.set 0xA0112C8C %long   0xF2E91EC9
data.set 0xA0112C90 %long   0x2BE146AF
data.set 0xA0112C94 %long   0xFFECD7E7
data.set 0xA0112C98 %long   0x2CDCC543
data.set 0xA0112C9C %long   0x77866E85
data.set 0xA0112CA0 %long   0x5F3DDA74
data.set 0xA0112CA4 %long   0xF7BD88D2
data.set 0xA0112CA8 %long   0x4FC1CDDF
data.set 0xA0112CAC %long   0xF947356D
data.set 0xA0112CB0 %long   0x4F50A1D8
data.set 0xA0112CB4 %long   0xAAC8FD4A
data.set 0xA0112CB8 %long   0x3A032668
data.set 0xA0112CBC %long   0x69E512E5
data.set 0xA0112CC0 %long   0x1C75392A
data.set 0xA0112CC4 %long   0xEB3BCC9C
data.set 0xA0112CC8 %long   0xE6AA7F1E
data.set 0xA0112CCC %long   0x848B4BAD
data.set 0xA0112CD0 %long   0xDAFFB9AB
data.set 0xA0112CD4 %long   0xC40CBB15
data.set 0xA0112CD8 %long   0x4ADF86A2
data.set 0xA0112CDC %long   0x875CFBDE
data.set 0xA0112CE0 %long   0x9D5D96CD
data.set 0xA0112CE4 %long   0x672785C0
data.set 0xA0112CE8 %long   0x610A76A9
data.set 0xA0112CEC %long   0x64DF9489
data.set 0xA0112CF0 %long   0x24B367AB
data.set 0xA0112CF4 %long   0xF8D993AD
data.set 0xA0112CF8 %long   0xE97F0A85
data.set 0xA0112CFC %long   0xD635B66F
data.set 0xA0112D00 %long   0xE8486CD9
data.set 0xA0112D04 %long   0x7AE14EF9
data.set 0xA0112D08 %long   0x16FFB0C6
data.set 0xA0112D0C %long   0xDD0EF3B0
data.set 0xA0112D10 %long   0x7AE7A60B
data.set 0xA0112D14 %long   0x76E6A15A
data.set 0xA0112D18 %long   0xED22DC1D
data.set 0xA0112D1C %long   0x6462C4B5
data.set 0xA0112D20 %long   0x7BA010ED
data.set 0xA0112D24 %long   0x08F7EE70
data.set 0xA0112D28 %long   0xFCD8ABDF
data.set 0xA0112D2C %long   0x81796881
data.set 0xA0112D30 %long   0xEDD1E31A
data.set 0xA0112D34 %long   0x08F51F6C
data.set 0xA0112D38 %long   0xDC889814
data.set 0xA0112D3C %long   0x3BFD8162
data.set 0xA0112D40 %long   0xEBE5D2FB
data.set 0xA0112D44 %long   0x68792E91
data.set 0xA0112D48 %long   0x0E050443
data.set 0xA0112D4C %long   0xA77160DD
data.set 0xA0112D50 %long   0xD346AB2A
data.set 0xA0112D54 %long   0xF8A344FF
data.set 0xA0112D58 %long   0x655DD367
data.set 0xA0112D5C %long   0x731F0C96
data.set 0xA0112D60 %long   0x13A972A1
data.set 0xA0112D64 %long   0x8EF397B9
data.set 0xA0112D68 %long   0xBA606F9A
data.set 0xA0112D6C %long   0x1F342259
data.set 0xA0112D70 %long   0xFB925D4D
data.set 0xA0112D74 %long   0xBF9E41D8
data.set 0xA0112D78 %long   0x8A3086AF
data.set 0xA0112D7C %long   0x47CD78DF
data.set 0xA0112D80 %long   0xCBEED7E4
data.set 0xA0112D84 %long   0x9D2A411C
data.set 0xA0112D88 %long   0xF5A8460C
data.set 0xA0112D8C %long   0xCF31C5F8
data.set 0xA0112D90 %long   0xE6592A5F
data.set 0xA0112D94 %long   0x21F7B90D
data.set 0xA0112D98 %long   0x7EB258CC
data.set 0xA0112D9C %long   0x81840CE6
data.set 0xA0112DA0 %long   0xE412A24D
data.set 0xA0112DA4 %long   0xCA39C477
data.set 0xA0112DA8 %long   0x3F4F67AD
data.set 0xA0112DAC %long   0xB9A85E27
data.set 0xA0112DB0 %long   0xAB1596C0
data.set 0xA0112DB4 %long   0x26C8A74F
data.set 0xA0112DB8 %long   0x2F1A7A79
data.set 0xA0112DBC %long   0xEE3E86E6
data.set 0xA0112DC0 %long   0x429D2BBC
data.set 0xA0112DC4 %long   0x091278B2
data.set 0xA0112DC8 %long   0xCD0404BD
data.set 0xA0112DCC %long   0x9E3CD37E
data.set 0xA0112DD0 %long   0x3B39F4B3
data.set 0xA0112DD4 %long   0xF8870648
data.set 0xA0112DD8 %long   0x5CDDC221
data.set 0xA0112DDC %long   0x4EDC4200
data.set 0xA0112DE0 %long   0x8613CFE0
data.set 0xA0112DE4 %long   0xF911EF8A
data.set 0xA0112DE8 %long   0xBC458343
data.set 0xA0112DEC %long   0x8C14C426
data.set 0xA0112DF0 %long   0x5A70D954
data.set 0xA0112DF4 %long   0xFCAEB6E3
data.set 0xA0112DF8 %long   0xE80B830A
data.set 0xA0112DFC %long   0xC07B4265
data.set 0xA0112E00 %long   0xD317E6DB
data.set 0xA0112E04 %long   0x7D8C4FF7
data.set 0xA0112E08 %long   0x3F60953E
data.set 0xA0112E0C %long   0xCDB62866
data.set 0xA0112E10 %long   0xE36FB23A
data.set 0xA0112E14 %long   0x063EBFE0
data.set 0xA0112E18 %long   0x8EBE7848
data.set 0xA0112E1C %long   0x5D2FB9BC
data.set 0xA0112E20 %long   0xAA32035B
data.set 0xA0112E24 %long   0x077845F9
data.set 0xA0112E28 %long   0xA8EB1B52
data.set 0xA0112E2C %long   0x042C71C1
data.set 0xA0112E30 %long   0xCCDC8094
data.set 0xA0112E34 %long   0x96C53A2B
data.set 0xA0112E38 %long   0xF0A88C64
data.set 0xA0112E3C %long   0xD63CEF9D
data.set 0xA0112E40 %long   0x71A27BC1
data.set 0xA0112E44 %long   0xDA50EEC4
data.set 0xA0112E48 %long   0x33F7F6B0
data.set 0xA0112E4C %long   0xDEE1E817
data.set 0xA0112E50 %long   0x7440BFDF
data.set 0xA0112E54 %long   0xF32CF82D
data.set 0xA0112E58 %long   0xDBC73B7A
data.set 0xA0112E5C %long   0x182E212D
data.set 0xA0112E60 %long   0x01E660A3
data.set 0xA0112E64 %long   0x8DF8A16B
data.set 0xA0112E68 %long   0xE687F3D0
data.set 0xA0112E6C %long   0x8598A9CB
data.set 0xA0112E70 %long   0xD56AF5FF
data.set 0xA0112E74 %long   0x1504ED7F
data.set 0xA0112E78 %long   0xCC99522D
data.set 0xA0112E7C %long   0xCE895688
data.set 0xA0112E80 %long   0xFB67E69C
data.set 0xA0112E84 %long   0x15B784EC
data.set 0xA0112E88 %long   0x5A8F2000
data.set 0xA0112E8C %long   0xD3F08FD3
data.set 0xA0112E90 %long   0x88AFFB36
data.set 0xA0112E94 %long   0xEC9E06A4
data.set 0xA0112E98 %long   0x45E86D92
data.set 0xA0112E9C %long   0xE7C9BD62
data.set 0xA0112EA0 %long   0x20AB8B0F
data.set 0xA0112EA4 %long   0x83B869FA
data.set 0xA0112EA8 %long   0x1F8CD0CB
data.set 0xA0112EAC %long   0xE51435BF
data.set 0xA0112EB0 %long   0x1F13F744
data.set 0xA0112EB4 %long   0x33B9B100
data.set 0xA0112EB8 %long   0xB446C373
data.set 0xA0112EBC %long   0xC71F7924
data.set 0xA0112EC0 %long   0xAEAA426F
data.set 0xA0112EC4 %long   0xEFC8DE0F
data.set 0xA0112EC8 %long   0xD91E9FBD
data.set 0xA0112ECC %long   0xD2069752
data.set 0xA0112ED0 %long   0x2D01C665
data.set 0xA0112ED4 %long   0xB144FDF0
data.set 0xA0112ED8 %long   0xB7905D7B
data.set 0xA0112EDC %long   0x6357DCC2
data.set 0xA0112EE0 %long   0x8D5DE694
data.set 0xA0112EE4 %long   0x1103FD4E
data.set 0xA0112EE8 %long   0xF88640B4
data.set 0xA0112EEC %long   0xCA25DE14
data.set 0xA0112EF0 %long   0x2D452DA8
data.set 0xA0112EF4 %long   0xA450EA95
data.set 0xA0112EF8 %long   0xD2A3092A
data.set 0xA0112EFC %long   0x76ADEA9A
data.set 0xA0112F00 %long   0xFBE3B36E
data.set 0xA0112F04 %long   0xFDDB101F
data.set 0xA0112F08 %long   0x079B0BDF
data.set 0xA0112F0C %long   0xF0D47D66
data.set 0xA0112F10 %long   0x9AAAF856
data.set 0xA0112F14 %long   0x3F922143
data.set 0xA0112F18 %long   0xA41A6C6E
data.set 0xA0112F1C %long   0x911DB325
data.set 0xA0112F20 %long   0x525CC006
data.set 0xA0112F24 %long   0x411D085B
data.set 0xA0112F28 %long   0xA157FAC8
data.set 0xA0112F2C %long   0x3DDB23BE
data.set 0xA0112F30 %long   0x01116FF8
data.set 0xA0112F34 %long   0x52253983
data.set 0xA0112F38 %long   0xD8FB03EF
data.set 0xA0112F3C %long   0x2A9C8B35
data.set 0xA0112F40 %long   0x9D0C8F4E
data.set 0xA0112F44 %long   0x479A5B39
data.set 0xA0112F48 %long   0x2DEC7535
data.set 0xA0112F4C %long   0xE62F5D18
data.set 0xA0112F50 %long   0x47DDF36E
data.set 0xA0112F54 %long   0x21583A2E
data.set 0xA0112F58 %long   0x6A55EA7B
data.set 0xA0112F5C %long   0x67AA2286
data.set 0xA0112F60 %long   0xE783AF3F
data.set 0xA0112F64 %long   0x01A9F739
data.set 0xA0112F68 %long   0x639681C8
data.set 0xA0112F6C %long   0x6E119209
data.set 0xA0112F70 %long   0x4E3450E3
data.set 0xA0112F74 %long   0x7FC6E292
data.set 0xA0112F78 %long   0x630A65BC
data.set 0xA0112F7C %long   0x09DF729C
data.set 0xA0112F80 %long   0x3A6F74A1
data.set 0xA0112F84 %long   0x35221F41
data.set 0xA0112F88 %long   0x24B3D348
data.set 0xA0112F8C %long   0x076B85B7
data.set 0xA0112F90 %long   0xFF20A535
data.set 0xA0112F94 %long   0xD7F5CCA5
data.set 0xA0112F98 %long   0x7ACCC870
data.set 0xA0112F9C %long   0x02F61EBE
data.set 0xA0112FA0 %long   0xD72B958C
data.set 0xA0112FA4 %long   0x91AA29CE
data.set 0xA0112FA8 %long   0x40792BC8
data.set 0xA0112FAC %long   0x368A4409
data.set 0xA0112FB0 %long   0x89061425
data.set 0xA0112FB4 %long   0x7FDF4EC0
data.set 0xA0112FB8 %long   0x2FE8D968
data.set 0xA0112FBC %long   0x6A0D2731
data.set 0xA0112FC0 %long   0xE04E7063
data.set 0xA0112FC4 %long   0x20B3C387
data.set 0xA0112FC8 %long   0x7CEBE321
data.set 0xA0112FCC %long   0xABB8DB29
data.set 0xA0112FD0 %long   0xE293F84B
data.set 0xA0112FD4 %long   0x7818C346
data.set 0xA0112FD8 %long   0x353C50FC
data.set 0xA0112FDC %long   0x1D3FBC1B
data.set 0xA0112FE0 %long   0x661282DD
data.set 0xA0112FE4 %long   0x5F5B18BB
data.set 0xA0112FE8 %long   0x3DE0B8AC
data.set 0xA0112FEC %long   0xAB2FB7BD
data.set 0xA0112FF0 %long   0xBD4E9908
data.set 0xA0112FF4 %long   0x375C9D86
data.set 0xA0112FF8 %long   0xB80B3C16
data.set 0xA0112FFC %long   0x90DEBFB7
data.set 0xA0113000 %long   0xC4B1717B
data.set 0xA0113004 %long   0xDECE34FC
data.set 0xA0113008 %long   0xAD425EDC
data.set 0xA011300C %long   0xB3B7644B
data.set 0xA0113010 %long   0x350D0DC5
data.set 0xA0113014 %long   0x9B7E43D7
data.set 0xA0113018 %long   0x8D05EAD9
data.set 0xA011301C %long   0x99DE3286
data.set 0xA0113020 %long   0xB57AA35E
data.set 0xA0113024 %long   0xFDE19FA7
data.set 0xA0113028 %long   0x9D44AC13
data.set 0xA011302C %long   0x4FC5D389
data.set 0xA0113030 %long   0x3183D331
data.set 0xA0113034 %long   0x06E28A69
data.set 0xA0113038 %long   0x47628A23
data.set 0xA011303C %long   0xE9ED6F2E
data.set 0xA0113040 %long   0x2E9732AA
data.set 0xA0113044 %long   0x4FF4962A
data.set 0xA0113048 %long   0x229D1A29
data.set 0xA011304C %long   0x865A99BD
data.set 0xA0113050 %long   0xE11FB252
data.set 0xA0113054 %long   0x0BE28049
data.set 0xA0113058 %long   0x154BE3ED
data.set 0xA011305C %long   0xDEA8B034
data.set 0xA0113060 %long   0x2CC738D9
data.set 0xA0113064 %long   0x9A94C5FE
data.set 0xA0113068 %long   0x6294ACBA
data.set 0xA011306C %long   0x789E59CB
data.set 0xA0113070 %long   0x8C85CD08
data.set 0xA0113074 %long   0xD408746A
data.set 0xA0113078 %long   0xEC47E5BE
data.set 0xA011307C %long   0xE26A4F43
data.set 0xA0113080 %long   0x2DD4B945
data.set 0xA0113084 %long   0x7E6102FA
data.set 0xA0113088 %long   0xF6D7C60F
data.set 0xA011308C %long   0xDF40A694
data.set 0xA0113090 %long   0x19D73875
data.set 0xA0113094 %long   0x9A678646
data.set 0xA0113098 %long   0xCA8FC00A
data.set 0xA011309C %long   0x93DC35F5
data.set 0xA01130A0 %long   0x2717C75B
data.set 0xA01130A4 %long   0xD4F0B6E8
data.set 0xA01130A8 %long   0x2E675782
data.set 0xA01130AC %long   0x695DEA9D
data.set 0xA01130B0 %long   0x3308B11A
data.set 0xA01130B4 %long   0x45E2E761
data.set 0xA01130B8 %long   0xE9E3A108
data.set 0xA01130BC %long   0xD3B1A3CD
data.set 0xA01130C0 %long   0x2B3E962C
data.set 0xA01130C4 %long   0x83824045
data.set 0xA01130C8 %long   0x430B6CB8
data.set 0xA01130CC %long   0xE07EF661
data.set 0xA01130D0 %long   0xFE51682C
data.set 0xA01130D4 %long   0x422CE817
data.set 0xA01130D8 %long   0xD75FC0BB
data.set 0xA01130DC %long   0xB2D24BE0
data.set 0xA01130E0 %long   0x167A0FB5
data.set 0xA01130E4 %long   0x7488D708
data.set 0xA01130E8 %long   0xB133F803
data.set 0xA01130EC %long   0x1744AED9
data.set 0xA01130F0 %long   0xAB2181C8
data.set 0xA01130F4 %long   0x1995F2C7
data.set 0xA01130F8 %long   0x72EF61C6
data.set 0xA01130FC %long   0x2A5DB2CC
data.set 0xA0113100 %long   0x383C1FB9
data.set 0xA0113104 %long   0xBE13A118
data.set 0xA0113108 %long   0xFEB34260
data.set 0xA011310C %long   0x2AC344BA
data.set 0xA0113110 %long   0x0E6BB147
data.set 0xA0113114 %long   0x9EBD0C61
data.set 0xA0113118 %long   0xF41393C4
data.set 0xA011311C %long   0x5562A5C1
data.set 0xA0113120 %long   0x32E75969
data.set 0xA0113124 %long   0x9B91F83C
data.set 0xA0113128 %long   0x44A5DD17
data.set 0xA011312C %long   0xD2D93688
data.set 0xA0113130 %long   0x0852286F
data.set 0xA0113134 %long   0xC969A53D
data.set 0xA0113138 %long   0x5AB4585D
data.set 0xA011313C %long   0x8A6FFF06
data.set 0xA0113140 %long   0x2198D9F8
data.set 0xA0113144 %long   0x3A30E4ED
data.set 0xA0113148 %long   0xE1AE1C7E
data.set 0xA011314C %long   0xA35D45B3
data.set 0xA0113150 %long   0x40F020F5
data.set 0xA0113154 %long   0xBDF01602
data.set 0xA0113158 %long   0x1CB615BC
data.set 0xA011315C %long   0xAD2BDCEF
data.set 0xA0113160 %long   0x63AB59E5
data.set 0xA0113164 %long   0xF66AD68E
data.set 0xA0113168 %long   0x0B67DFF4
data.set 0xA011316C %long   0xC9E8FF51
data.set 0xA0113170 %long   0x898598E0
data.set 0xA0113174 %long   0x535826B4
data.set 0xA0113178 %long   0xBCD6BF97
data.set 0xA011317C %long   0x237FFCE0
data.set 0xA0113180 %long   0x9B2D4FFC
data.set 0xA0113184 %long   0x369D66D9
data.set 0xA0113188 %long   0x7B807FDB
data.set 0xA011318C %long   0x3C2EE136
data.set 0xA0113190 %long   0xED624371
data.set 0xA0113194 %long   0x32A01214
data.set 0xA0113198 %long   0x3E8A9547
data.set 0xA011319C %long   0xC958FF49
data.set 0xA01131A0 %long   0x17BFAC34
data.set 0xA01131A4 %long   0x765DCB1D
data.set 0xA01131A8 %long   0x4AEEE6E6
data.set 0xA01131AC %long   0xE42C7419
data.set 0xA01131B0 %long   0xB04C8514
data.set 0xA01131B4 %long   0xE0D190E5
data.set 0xA01131B8 %long   0x0586C6E2
data.set 0xA01131BC %long   0xA699E2AC
data.set 0xA01131C0 %long   0x62461449
data.set 0xA01131C4 %long   0x4ACAA655
data.set 0xA01131C8 %long   0x779CF228
data.set 0xA01131CC %long   0x9449DE03
data.set 0xA01131D0 %long   0x435FF512
data.set 0xA01131D4 %long   0xD69964D3
data.set 0xA01131D8 %long   0x5713FCA6
data.set 0xA01131DC %long   0x582F4748
data.set 0xA01131E0 %long   0x4DC251B2
data.set 0xA01131E4 %long   0xEDCE029C
data.set 0xA01131E8 %long   0xFD18B089
data.set 0xA01131EC %long   0x5A25D9B0
data.set 0xA01131F0 %long   0xBD9BACB3
data.set 0xA01131F4 %long   0x20DE4707
data.set 0xA01131F8 %long   0x9F65793E
data.set 0xA01131FC %long   0x341FB3B1
data.set 0xA0113200 %long   0x3FD97751
data.set 0xA0113204 %long   0x5460B3AF
data.set 0xA0113208 %long   0x7CB51214
data.set 0xA011320C %long   0x05E186AB
data.set 0xA0113210 %long   0x1C3D46DB
data.set 0xA0113214 %long   0x56AAB7CD
data.set 0xA0113218 %long   0x2CA349BB
data.set 0xA011321C %long   0x66BC8380
data.set 0xA0113220 %long   0x7FA09690
data.set 0xA0113224 %long   0x66BA712C
data.set 0xA0113228 %long   0xE005BE57
data.set 0xA011322C %long   0xF45FF935
data.set 0xA0113230 %long   0xAC6F7D92
data.set 0xA0113234 %long   0xB14501E9
data.set 0xA0113238 %long   0x26DE494C
data.set 0xA011323C %long   0x9723F7FE
data.set 0xA0113240 %long   0x720D1CF7
data.set 0xA0113244 %long   0xED1A93E0
data.set 0xA0113248 %long   0x268524C3
data.set 0xA011324C %long   0xD42A819C
data.set 0xA0113250 %long   0x0B75DD0C
data.set 0xA0113254 %long   0xA41F32E1
data.set 0xA0113258 %long   0xDC320667
data.set 0xA011325C %long   0x448B4613
data.set 0xA0113260 %long   0x116A68C7
data.set 0xA0113264 %long   0x35331E8A
data.set 0xA0113268 %long   0xFF91B755
data.set 0xA011326C %long   0xED89E517
data.set 0xA0113270 %long   0xB48B72E5
data.set 0xA0113274 %long   0xE0514BF0
data.set 0xA0113278 %long   0x704C0393
data.set 0xA011327C %long   0xA8ACEB49
data.set 0xA0113280 %long   0x878DF17F
data.set 0xA0113284 %long   0xB9C64FDC
data.set 0xA0113288 %long   0x2C17947B
data.set 0xA011328C %long   0xBED7D855
data.set 0xA0113290 %long   0x6ACA021E
data.set 0xA0113294 %long   0xFE7ED79D
data.set 0xA0113298 %long   0x875EB177
data.set 0xA011329C %long   0xA71762CC
data.set 0xA01132A0 %long   0x224F399B
data.set 0xA01132A4 %long   0xA4420D45
data.set 0xA01132A8 %long   0xD481CC13
data.set 0xA01132AC %long   0xEB08E560
data.set 0xA01132B0 %long   0xFBA44A1C
data.set 0xA01132B4 %long   0x55190A64
data.set 0xA01132B8 %long   0x4FDA7552
data.set 0xA01132BC %long   0xC7CB331E
data.set 0xA01132C0 %long   0x07C5E158
data.set 0xA01132C4 %long   0xA6AA3710
data.set 0xA01132C8 %long   0x1B725879
data.set 0xA01132CC %long   0x6C5CAE11
data.set 0xA01132D0 %long   0xA08D1717
data.set 0xA01132D4 %long   0x05FE7908
data.set 0xA01132D8 %long   0xCFCE09BB
data.set 0xA01132DC %long   0x386DE29C
data.set 0xA01132E0 %long   0x31F6F7FA
data.set 0xA01132E4 %long   0x7DF3908A
data.set 0xA01132E8 %long   0x650AA505
data.set 0xA01132EC %long   0xF87877C2
data.set 0xA01132F0 %long   0x017BF581
data.set 0xA01132F4 %long   0x520CB86B
data.set 0xA01132F8 %long   0x5F723728
data.set 0xA01132FC %long   0xE713EEB7
data.set 0xA0113300 %long   0x295AC2F5
data.set 0xA0113304 %long   0x715283DB
data.set 0xA0113308 %long   0x2CD4DA01
data.set 0xA011330C %long   0xC18A1DA0
data.set 0xA0113310 %long   0xC0497D4F
data.set 0xA0113314 %long   0x3D4275E8
data.set 0xA0113318 %long   0xC0232E8B
data.set 0xA011331C %long   0x9EB74F95
data.set 0xA0113320 %long   0x04BE2A34
data.set 0xA0113324 %long   0xB3962059
data.set 0xA0113328 %long   0xC8924FB5
data.set 0xA011332C %long   0xE5B37AF6
data.set 0xA0113330 %long   0x0656830A
data.set 0xA0113334 %long   0x69CCB18D
data.set 0xA0113338 %long   0xFF194759
data.set 0xA011333C %long   0x7E6B420E
data.set 0xA0113340 %long   0x3AA6B444
data.set 0xA0113344 %long   0xEB4256F2
data.set 0xA0113348 %long   0xB4C12E14
data.set 0xA011334C %long   0xF11ADD7C
data.set 0xA0113350 %long   0xFCA7926F
data.set 0xA0113354 %long   0xDBE9F928
data.set 0xA0113358 %long   0x0B940EC6
data.set 0xA011335C %long   0x9D30A050
data.set 0xA0113360 %long   0x4B41F5E4
data.set 0xA0113364 %long   0xCCEC7B62
data.set 0xA0113368 %long   0xC14F3887
data.set 0xA011336C %long   0x6A365BF2
data.set 0xA0113370 %long   0xA0727FCD
data.set 0xA0113374 %long   0xE34CC6FD
data.set 0xA0113378 %long   0x05F106EF
data.set 0xA011337C %long   0xF9A24640
data.set 0xA0113380 %long   0x45506AA8
data.set 0xA0113384 %long   0x335947B2
data.set 0xA0113388 %long   0x41F976A6
data.set 0xA011338C %long   0x257111FB
data.set 0xA0113390 %long   0xEC0C31AD
data.set 0xA0113394 %long   0x71D3CBB9
data.set 0xA0113398 %long   0xF1D888B2
data.set 0xA011339C %long   0xC6FE7D82
data.set 0xA01133A0 %long   0x3E91979A
data.set 0xA01133A4 %long   0x92FEE7DC
data.set 0xA01133A8 %long   0x3A68848C
data.set 0xA01133AC %long   0xB461ED42
data.set 0xA01133B0 %long   0x559CFD97
data.set 0xA01133B4 %long   0xF46AB487
data.set 0xA01133B8 %long   0xEC22E7FF
data.set 0xA01133BC %long   0xB631E689
data.set 0xA01133C0 %long   0x8CBC68AD
data.set 0xA01133C4 %long   0xDDEAE32E
data.set 0xA01133C8 %long   0xF275E193
data.set 0xA01133CC %long   0x88D73CCE
data.set 0xA01133D0 %long   0x9BD69F43
data.set 0xA01133D4 %long   0x7CFA7054
data.set 0xA01133D8 %long   0x323E6489
data.set 0xA01133DC %long   0x46A622EC
data.set 0xA01133E0 %long   0x2153439A
data.set 0xA01133E4 %long   0x80B5AA5E
data.set 0xA01133E8 %long   0xAB3AFD79
data.set 0xA01133EC %long   0xA0D91BD7
data.set 0xA01133F0 %long   0xB4807A56
data.set 0xA01133F4 %long   0x41F6C373
data.set 0xA01133F8 %long   0x87A1B47E
data.set 0xA01133FC %long   0x76B35E15
data.set 0xA0113400 %long   0x5218B59B
data.set 0xA0113404 %long   0xC399751A
data.set 0xA0113408 %long   0x2DCBF9F6
data.set 0xA011340C %long   0xFB0E718F
data.set 0xA0113410 %long   0x7CBA2813
data.set 0xA0113414 %long   0x2D7E8B00
data.set 0xA0113418 %long   0xF94E5EA1
data.set 0xA011341C %long   0x6368403C
data.set 0xA0113420 %long   0x44A74159
data.set 0xA0113424 %long   0x9FFEF86F
data.set 0xA0113428 %long   0x1C59E54D
data.set 0xA011342C %long   0x459943C7
data.set 0xA0113430 %long   0x6683E21C
data.set 0xA0113434 %long   0x3D2A772A
data.set 0xA0113438 %long   0x0ED4E9FB
data.set 0xA011343C %long   0xD6680CA2
data.set 0xA0113440 %long   0xB1FD9A1E
data.set 0xA0113444 %long   0xFF0EDC22
data.set 0xA0113448 %long   0x4C67E5E5
data.set 0xA011344C %long   0x5BCE0368
data.set 0xA0113450 %long   0xECDB8600
data.set 0xA0113454 %long   0x8790A631
data.set 0xA0113458 %long   0x6DD69E68
data.set 0xA011345C %long   0xE4F40E82
data.set 0xA0113460 %long   0x533FDC2C
data.set 0xA0113464 %long   0x98FC2C59
data.set 0xA0113468 %long   0xA41966F4
data.set 0xA011346C %long   0x0B7114B7
data.set 0xA0113470 %long   0xFF39393B
data.set 0xA0113474 %long   0xB670502C
data.set 0xA0113478 %long   0x8E5AE348
data.set 0xA011347C %long   0x5334286B
data.set 0xA0113480 %long   0x54EDA9D4
data.set 0xA0113484 %long   0xB15BA733
data.set 0xA0113488 %long   0xC3EEA37A
data.set 0xA011348C %long   0x473A88F9
data.set 0xA0113490 %long   0x5397A2B4
data.set 0xA0113494 %long   0x88DD4E46
data.set 0xA0113498 %long   0x823187D2
data.set 0xA011349C %long   0x41EC835E
data.set 0xA01134A0 %long   0x8629A74A
data.set 0xA01134A4 %long   0xE61233FA
data.set 0xA01134A8 %long   0xDAD9A1A6
data.set 0xA01134AC %long   0xD42E5F66
data.set 0xA01134B0 %long   0xC5B74BFE
data.set 0xA01134B4 %long   0xAB950C51
data.set 0xA01134B8 %long   0x89544A1F
data.set 0xA01134BC %long   0x1A6F4B60
data.set 0xA01134C0 %long   0x97FB42E5
data.set 0xA01134C4 %long   0x6B440630
data.set 0xA01134C8 %long   0xB06B3766
data.set 0xA01134CC %long   0x996C87FF
data.set 0xA01134D0 %long   0x2539A33F
data.set 0xA01134D4 %long   0x7305FAFB
data.set 0xA01134D8 %long   0x8743FB0F
data.set 0xA01134DC %long   0x886E3E41
data.set 0xA01134E0 %long   0x8B66D614
data.set 0xA01134E4 %long   0xBBDE54A2
data.set 0xA01134E8 %long   0x28B5F2D9
data.set 0xA01134EC %long   0xEF8C5D15
data.set 0xA01134F0 %long   0x184CF16D
data.set 0xA01134F4 %long   0x5FA75325
data.set 0xA01134F8 %long   0x1CBF0D3E
data.set 0xA01134FC %long   0xFE014F2D
data.set 0xA0113500 %long   0x1A39E97D
data.set 0xA0113504 %long   0xAA4623A1
data.set 0xA0113508 %long   0x2C8E754B
data.set 0xA011350C %long   0x2F2A3E58
data.set 0xA0113510 %long   0x3988FB50
data.set 0xA0113514 %long   0x2BE304CE
data.set 0xA0113518 %long   0xBA961325
data.set 0xA011351C %long   0x3FD8CB2C
data.set 0xA0113520 %long   0x70B91C0C
data.set 0xA0113524 %long   0x952E447E
data.set 0xA0113528 %long   0xB09E0F53
data.set 0xA011352C %long   0xF44E083F
data.set 0xA0113530 %long   0x70802288
data.set 0xA0113534 %long   0x475F645D
data.set 0xA0113538 %long   0x02BA4C6A
data.set 0xA011353C %long   0x53C34340
data.set 0xA0113540 %long   0xD1E99F84
data.set 0xA0113544 %long   0x8527AEB8
data.set 0xA0113548 %long   0xE6256602
data.set 0xA011354C %long   0x4854224B
data.set 0xA0113550 %long   0x595D4BF3
data.set 0xA0113554 %long   0x8B72F957
data.set 0xA0113558 %long   0x85DD3BE5
data.set 0xA011355C %long   0xC2BB428E
data.set 0xA0113560 %long   0xD113C07F
data.set 0xA0113564 %long   0x060309F5
data.set 0xA0113568 %long   0x0EDBD13F
data.set 0xA011356C %long   0x465581D3
data.set 0xA0113570 %long   0x0CB8DCF8
data.set 0xA0113574 %long   0xF8558501
data.set 0xA0113578 %long   0x59BF6F55
data.set 0xA011357C %long   0x1D4985F1
data.set 0xA0113580 %long   0xDFDC33D1
data.set 0xA0113584 %long   0xCB0693B2
data.set 0xA0113588 %long   0x380E858B
data.set 0xA011358C %long   0x8CE3C91D
data.set 0xA0113590 %long   0xCB2FF138
data.set 0xA0113594 %long   0xE9ED369F
data.set 0xA0113598 %long   0x26C3A7A3
data.set 0xA011359C %long   0x17BAF82C
data.set 0xA01135A0 %long   0xCA293FEA
data.set 0xA01135A4 %long   0x2CF40C9E
data.set 0xA01135A8 %long   0xFD70EFC4
data.set 0xA01135AC %long   0xC5CD286A
data.set 0xA01135B0 %long   0x6438966D
data.set 0xA01135B4 %long   0x68520C55
data.set 0xA01135B8 %long   0x0CC76120
data.set 0xA01135BC %long   0xD049C088
data.set 0xA01135C0 %long   0xB4D01486
data.set 0xA01135C4 %long   0xB709CB7F
data.set 0xA01135C8 %long   0x4F0CABBA
data.set 0xA01135CC %long   0x616D5DFF
data.set 0xA01135D0 %long   0xC9E8D51D
data.set 0xA01135D4 %long   0x074E286A
data.set 0xA01135D8 %long   0x7D2D0E21
data.set 0xA01135DC %long   0x948D7C00
data.set 0xA01135E0 %long   0xDC51D9A3
data.set 0xA01135E4 %long   0x98D17452
data.set 0xA01135E8 %long   0x9D28FA96
data.set 0xA01135EC %long   0xE6C95DBC
data.set 0xA01135F0 %long   0x14213A33
data.set 0xA01135F4 %long   0x095439E0
data.set 0xA01135F8 %long   0xAC67BF51
data.set 0xA01135FC %long   0x754FA3C3
data.set 0xA0113600 %long   0xB5A0CA9A
data.set 0xA0113604 %long   0x31E1327C
data.set 0xA0113608 %long   0x0ABB2E57
data.set 0xA011360C %long   0x6850542C
data.set 0xA0113610 %long   0xCB544292
data.set 0xA0113614 %long   0xDC97E089
data.set 0xA0113618 %long   0x31DE8E5A
data.set 0xA011361C %long   0x0A6EFD09
data.set 0xA0113620 %long   0xC1A73AFA
data.set 0xA0113624 %long   0x669BE50B
data.set 0xA0113628 %long   0x3BDCDCB0
data.set 0xA011362C %long   0x18152391
data.set 0xA0113630 %long   0x80C7A22F
data.set 0xA0113634 %long   0x32BB56D8
data.set 0xA0113638 %long   0x0812B0D9
data.set 0xA011363C %long   0x5D920553
data.set 0xA0113640 %long   0x063D4435
data.set 0xA0113644 %long   0x530EE7A9
data.set 0xA0113648 %long   0x7BB790ED
data.set 0xA011364C %long   0x32AA8366
data.set 0xA0113650 %long   0xD38452F8
data.set 0xA0113654 %long   0xBE2AAA1C
data.set 0xA0113658 %long   0x0E01F8E4
data.set 0xA011365C %long   0xA5AC961D
data.set 0xA0113660 %long   0x2B7A6AB8
data.set 0xA0113664 %long   0xDE8D25BE
data.set 0xA0113668 %long   0x857AEE2C
data.set 0xA011366C %long   0x752A9E67
data.set 0xA0113670 %long   0x9E5A1864
data.set 0xA0113674 %long   0x40161BA9
data.set 0xA0113678 %long   0xB32F8915
data.set 0xA011367C %long   0x1C3A1A84
data.set 0xA0113680 %long   0x1DFABEF0
data.set 0xA0113684 %long   0x8E455AC2
data.set 0xA0113688 %long   0xB34B3431
data.set 0xA011368C %long   0x2210B119
data.set 0xA0113690 %long   0xD828D8D9
data.set 0xA0113694 %long   0x18066405
data.set 0xA0113698 %long   0xB455D31B
data.set 0xA011369C %long   0x9B97818E
data.set 0xA01136A0 %long   0x8D3C18E4
data.set 0xA01136A4 %long   0xB1F2B599
data.set 0xA01136A8 %long   0x2D5AE9BC
data.set 0xA01136AC %long   0xE5AC67C2
data.set 0xA01136B0 %long   0xAFDC5D86
data.set 0xA01136B4 %long   0xC6A23E2D
data.set 0xA01136B8 %long   0x1C035AE6
data.set 0xA01136BC %long   0x6DED331F
data.set 0xA01136C0 %long   0x7B8EA775
data.set 0xA01136C4 %long   0x2C038AC1
data.set 0xA01136C8 %long   0x4BD7547B
data.set 0xA01136CC %long   0x774DF67A
data.set 0xA01136D0 %long   0x04FBE2DA
data.set 0xA01136D4 %long   0xDB984533
data.set 0xA01136D8 %long   0x9BE141E3
data.set 0xA01136DC %long   0x568F8D26
data.set 0xA01136E0 %long   0x331B06DE
data.set 0xA01136E4 %long   0x48A8E772
data.set 0xA01136E8 %long   0xA3E37553
data.set 0xA01136EC %long   0xB30EF5AD
data.set 0xA01136F0 %long   0x97D958F5
data.set 0xA01136F4 %long   0xCF428CEF
data.set 0xA01136F8 %long   0xBEC1C7A5
data.set 0xA01136FC %long   0xC7342892
data.set 0xA0113700 %long   0xFF271C49
data.set 0xA0113704 %long   0xB0CA091F
data.set 0xA0113708 %long   0xD05D8589
data.set 0xA011370C %long   0xBE44D997
data.set 0xA0113710 %long   0xB5D77790
data.set 0xA0113714 %long   0x02A996F9
data.set 0xA0113718 %long   0xB84BA1ED
data.set 0xA011371C %long   0x70C059CC
data.set 0xA0113720 %long   0xCE61625B
data.set 0xA0113724 %long   0x6BF74F26
data.set 0xA0113728 %long   0x1784D353
data.set 0xA011372C %long   0x1F287176
data.set 0xA0113730 %long   0x63656C53
data.set 0xA0113734 %long   0x1403E22A
data.set 0xA0113738 %long   0x3FCB21DC
data.set 0xA011373C %long   0x4139BCDE
data.set 0xA0113740 %long   0x6FAAB0B1
data.set 0xA0113744 %long   0x1B8F80D8
data.set 0xA0113748 %long   0x67B35480
data.set 0xA011374C %long   0xF1D21337
data.set 0xA0113750 %long   0x1F6FF49C
data.set 0xA0113754 %long   0x14B8A362
data.set 0xA0113758 %long   0xB032F436
data.set 0xA011375C %long   0x096DBC5E
data.set 0xA0113760 %long   0x119DE748
data.set 0xA0113764 %long   0x1801CCAB
data.set 0xA0113768 %long   0xD1BA7472
data.set 0xA011376C %long   0xBCF5B2CF
data.set 0xA0113770 %long   0x267B63BB
data.set 0xA0113774 %long   0xFE7C741C
data.set 0xA0113778 %long   0x7DEC7C48
data.set 0xA011377C %long   0x3211989A
data.set 0xA0113780 %long   0xBA329D16
data.set 0xA0113784 %long   0x646BE22C
data.set 0xA0113788 %long   0x501F3C51
data.set 0xA011378C %long   0xA5CE7B82
data.set 0xA0113790 %long   0x40983423
data.set 0xA0113794 %long   0xC8BBD44F
data.set 0xA0113798 %long   0xC17ABE9C
data.set 0xA011379C %long   0xE11FF215
data.set 0xA01137A0 %long   0x35FC8631
data.set 0xA01137A4 %long   0x3915BE13
data.set 0xA01137A8 %long   0xF19FAD97
data.set 0xA01137AC %long   0x5940C3D9
data.set 0xA01137B0 %long   0x4B6A32A0
data.set 0xA01137B4 %long   0x19366937
data.set 0xA01137B8 %long   0x6E9846DD
data.set 0xA01137BC %long   0xA475B892
data.set 0xA01137C0 %long   0xE1F4ED2A
data.set 0xA01137C4 %long   0x61D265AE
data.set 0xA01137C8 %long   0x5E004108
data.set 0xA01137CC %long   0xAF57120C
data.set 0xA01137D0 %long   0x3A097644
data.set 0xA01137D4 %long   0x10AF25AA
data.set 0xA01137D8 %long   0x5715AC4F
data.set 0xA01137DC %long   0x95EAC54B
data.set 0xA01137E0 %long   0x6A00D85C
data.set 0xA01137E4 %long   0x0FD79F1F
data.set 0xA01137E8 %long   0x895F6044
data.set 0xA01137EC %long   0xBA1FF409
data.set 0xA01137F0 %long   0xDBBD251B
data.set 0xA01137F4 %long   0xAD4932A8
data.set 0xA01137F8 %long   0x49D149F2
data.set 0xA01137FC %long   0x085D8434
data.set 0xA0113800 %long   0xA52C2603
data.set 0xA0113804 %long   0x72BE6821
data.set 0xA0113808 %long   0x796A3796
data.set 0xA011380C %long   0x0BC70171
data.set 0xA0113810 %long   0x0F7EB5CF
data.set 0xA0113814 %long   0xF868052D
data.set 0xA0113818 %long   0xDE228DD8
data.set 0xA011381C %long   0x04906554
data.set 0xA0113820 %long   0x75DE7AD4
data.set 0xA0113824 %long   0xFDC74A0D
data.set 0xA0113828 %long   0x4E9DBF61
data.set 0xA011382C %long   0x8EA850CC
data.set 0xA0113830 %long   0x4FD88E37
data.set 0xA0113834 %long   0x4EC996E3
data.set 0xA0113838 %long   0x8D8B82F1
data.set 0xA011383C %long   0x6A9254A6
data.set 0xA0113840 %long   0xE727B212
data.set 0xA0113844 %long   0x54EBFEB3
data.set 0xA0113848 %long   0xEC37BF03
data.set 0xA011384C %long   0xCE240D69
data.set 0xA0113850 %long   0xE40F1079
data.set 0xA0113854 %long   0x0EA96EE6
data.set 0xA0113858 %long   0x7A2D8A7D
data.set 0xA011385C %long   0x7CBBC98F
data.set 0xA0113860 %long   0x32C8578A
data.set 0xA0113864 %long   0x25E570BD
data.set 0xA0113868 %long   0xB25A7BB3
data.set 0xA011386C %long   0x9AE6B179
data.set 0xA0113870 %long   0x23C58654
data.set 0xA0113874 %long   0x1C9C13B6
data.set 0xA0113878 %long   0x2B6B5514
data.set 0xA011387C %long   0xA07FF1C5
data.set 0xA0113880 %long   0xC0FD2306
data.set 0xA0113884 %long   0x35D8E133
data.set 0xA0113888 %long   0xDDD11114
data.set 0xA011388C %long   0x6E377DB5
data.set 0xA0113890 %long   0xEFCE15FB
data.set 0xA0113894 %long   0x542D71EB
data.set 0xA0113898 %long   0xA5510939
data.set 0xA011389C %long   0x002DA308
data.set 0xA01138A0 %long   0xDE2813A9
data.set 0xA01138A4 %long   0x8F7B9B9B
data.set 0xA01138A8 %long   0xD76E4357
data.set 0xA01138AC %long   0xEDDD8144
data.set 0xA01138B0 %long   0xC3ED96EB
data.set 0xA01138B4 %long   0x009334D9
data.set 0xA01138B8 %long   0x3AB045EA
data.set 0xA01138BC %long   0xD8193ECE
data.set 0xA01138C0 %long   0xAF3AC823
data.set 0xA01138C4 %long   0xA91217DA
data.set 0xA01138C8 %long   0xF6B62BB6
data.set 0xA01138CC %long   0x742D38F1
data.set 0xA01138D0 %long   0xD180908E
data.set 0xA01138D4 %long   0x18EC2CEB
data.set 0xA01138D8 %long   0xF408D983
data.set 0xA01138DC %long   0x7DDC54FB
data.set 0xA01138E0 %long   0x8599A703
data.set 0xA01138E4 %long   0xDD68AE18
data.set 0xA01138E8 %long   0x3D27D276
data.set 0xA01138EC %long   0x39A7CC7C
data.set 0xA01138F0 %long   0x77AD35B0
data.set 0xA01138F4 %long   0xFBFF1D53
data.set 0xA01138F8 %long   0x6898848B
data.set 0xA01138FC %long   0xE8F9ABC7
data.set 0xA0113900 %long   0xDBA0DAEF
data.set 0xA0113904 %long   0xF16754DF
data.set 0xA0113908 %long   0xB20E32B2
data.set 0xA011390C %long   0x8F1B1A4C
data.set 0xA0113910 %long   0xDCF71B66
data.set 0xA0113914 %long   0x90D6FCD9
data.set 0xA0113918 %long   0xDAC07798
data.set 0xA011391C %long   0x65DD80C6
data.set 0xA0113920 %long   0x23A765FB
data.set 0xA0113924 %long   0x896CFC85
data.set 0xA0113928 %long   0x80A4602B
data.set 0xA011392C %long   0x86C67D71
data.set 0xA0113930 %long   0x2A4FF972
data.set 0xA0113934 %long   0xA3E3F482
data.set 0xA0113938 %long   0xD4EA8628
data.set 0xA011393C %long   0x9A4FA72E
data.set 0xA0113940 %long   0xBFAA80E2
data.set 0xA0113944 %long   0x88DEFC1C
data.set 0xA0113948 %long   0x242A2A18
data.set 0xA011394C %long   0x308ECF31
data.set 0xA0113950 %long   0x97CFD4BF
data.set 0xA0113954 %long   0x6CE5549B
data.set 0xA0113958 %long   0x002D30EB
data.set 0xA011395C %long   0xAA1C9BB0
data.set 0xA0113960 %long   0xF9ABEC78
data.set 0xA0113964 %long   0x6023DDD2
data.set 0xA0113968 %long   0x42DAA20C
data.set 0xA011396C %long   0x6847BDAF
data.set 0xA0113970 %long   0x2631097B
data.set 0xA0113974 %long   0x7CFD2794
data.set 0xA0113978 %long   0x9AB907A7
data.set 0xA011397C %long   0x7966ECA6
data.set 0xA0113980 %long   0xCCD9A317
data.set 0xA0113984 %long   0x804F0731
data.set 0xA0113988 %long   0x605E4E2C
data.set 0xA011398C %long   0xC436DBB9
data.set 0xA0113990 %long   0xE643C23E
data.set 0xA0113994 %long   0x0AAFE826
data.set 0xA0113998 %long   0x587CA830
data.set 0xA011399C %long   0x2AB6DEA2
data.set 0xA01139A0 %long   0xD6FAD888
data.set 0xA01139A4 %long   0xE4D7B97A
data.set 0xA01139A8 %long   0xE9200FA0
data.set 0xA01139AC %long   0x8FA84EB1
data.set 0xA01139B0 %long   0xC8041241
data.set 0xA01139B4 %long   0x1B4F7A0F
data.set 0xA01139B8 %long   0xD3BEE5FB
data.set 0xA01139BC %long   0x49106913
data.set 0xA01139C0 %long   0x9E3161D7
data.set 0xA01139C4 %long   0x9A7F9696
data.set 0xA01139C8 %long   0x87C39B6B
data.set 0xA01139CC %long   0x2A42536B
data.set 0xA01139D0 %long   0x8B46EA7A
data.set 0xA01139D4 %long   0x0F9A325B
data.set 0xA01139D8 %long   0x025451AA
data.set 0xA01139DC %long   0x7BACB0C1
data.set 0xA01139E0 %long   0xEC7C098D
data.set 0xA01139E4 %long   0xC83CEEB4
data.set 0xA01139E8 %long   0x1B20F119
data.set 0xA01139EC %long   0x9F89711C
data.set 0xA01139F0 %long   0x9C345DDC
data.set 0xA01139F4 %long   0x9C2DE913
data.set 0xA01139F8 %long   0x5E9AEDF6
data.set 0xA01139FC %long   0x75E97300
data.set 0xA0113A00 %long   0x35519AAA
data.set 0xA0113A04 %long   0x45F50E37
data.set 0xA0113A08 %long   0x0DA12E1F
data.set 0xA0113A0C %long   0x437A4CE6
data.set 0xA0113A10 %long   0x82FBF0B0
data.set 0xA0113A14 %long   0x234C0AF4
data.set 0xA0113A18 %long   0xFBB71909
data.set 0xA0113A1C %long   0xD5E074FF
data.set 0xA0113A20 %long   0xE6175B8A
data.set 0xA0113A24 %long   0xDBF2DAFD
data.set 0xA0113A28 %long   0xCDD3CD49
data.set 0xA0113A2C %long   0xF3059F75
data.set 0xA0113A30 %long   0x3DF39D9E
data.set 0xA0113A34 %long   0x1519E742
data.set 0xA0113A38 %long   0x0CCC8067
data.set 0xA0113A3C %long   0xF56476C2
data.set 0xA0113A40 %long   0x6D95B044
data.set 0xA0113A44 %long   0x2E23FC53
data.set 0xA0113A48 %long   0xBCD828A3
data.set 0xA0113A4C %long   0x3F25FAD4
data.set 0xA0113A50 %long   0x785542A8
data.set 0xA0113A54 %long   0x0F6457B7
data.set 0xA0113A58 %long   0x3EA166FE
data.set 0xA0113A5C %long   0xE9D9DD61
data.set 0xA0113A60 %long   0x25EF0426
data.set 0xA0113A64 %long   0x98416671
data.set 0xA0113A68 %long   0xE4DBCE4B
data.set 0xA0113A6C %long   0xE7F9FDCD
data.set 0xA0113A70 %long   0x3ACFC1BE
data.set 0xA0113A74 %long   0x11AA31DD
data.set 0xA0113A78 %long   0xAA2328B8
data.set 0xA0113A7C %long   0x66A5B597
data.set 0xA0113A80 %long   0x81E66339
data.set 0xA0113A84 %long   0x47D13DE0
data.set 0xA0113A88 %long   0x5C25BEE4
data.set 0xA0113A8C %long   0x6FFDB1F1
data.set 0xA0113A90 %long   0x5071AA58
data.set 0xA0113A94 %long   0xD19F7FBA
data.set 0xA0113A98 %long   0xEAC9DF3D
data.set 0xA0113A9C %long   0x06736209
data.set 0xA0113AA0 %long   0xE77A1CCC
data.set 0xA0113AA4 %long   0x4074BBF9
data.set 0xA0113AA8 %long   0xEB0DF855
data.set 0xA0113AAC %long   0x2F483FC7
data.set 0xA0113AB0 %long   0xB1AB75F3
data.set 0xA0113AB4 %long   0x316BCAB2
data.set 0xA0113AB8 %long   0x8119A113
data.set 0xA0113ABC %long   0x4BC7ACA3
data.set 0xA0113AC0 %long   0x8C8F9AA1
data.set 0xA0113AC4 %long   0x3CE2C895
data.set 0xA0113AC8 %long   0x383D58D2
data.set 0xA0113ACC %long   0xACD720CB
data.set 0xA0113AD0 %long   0xA4370539
data.set 0xA0113AD4 %long   0x268B189F
data.set 0xA0113AD8 %long   0x52EA4491
data.set 0xA0113ADC %long   0x1BBA144F
data.set 0xA0113AE0 %long   0xF918A678
data.set 0xA0113AE4 %long   0xA9C3BE26
data.set 0xA0113AE8 %long   0xFB77CEF9
data.set 0xA0113AEC %long   0x205B8423
data.set 0xA0113AF0 %long   0x734F761E
data.set 0xA0113AF4 %long   0x06E934D3
data.set 0xA0113AF8 %long   0xF6DD42B5
data.set 0xA0113AFC %long   0x472E2D88
data.set 0xA0113B00 %long   0x618CEFE5
data.set 0xA0113B04 %long   0x426DE2F2
data.set 0xA0113B08 %long   0x980DE545
data.set 0xA0113B0C %long   0x8A36A331
data.set 0xA0113B10 %long   0x96F3D9BC
data.set 0xA0113B14 %long   0xC69FD219
data.set 0xA0113B18 %long   0xAEF3351F
data.set 0xA0113B1C %long   0xB3171F46
data.set 0xA0113B20 %long   0x6AE395A3
data.set 0xA0113B24 %long   0x2D24AA9E
data.set 0xA0113B28 %long   0xBF1CFE0D
data.set 0xA0113B2C %long   0xF5B69761
data.set 0xA0113B30 %long   0x17B609BB
data.set 0xA0113B34 %long   0x927916EF
data.set 0xA0113B38 %long   0xCB4FA649
data.set 0xA0113B3C %long   0x2C40FB05
data.set 0xA0113B40 %long   0x430FEA6A
data.set 0xA0113B44 %long   0xC138FCBF
data.set 0xA0113B48 %long   0x64978470
data.set 0xA0113B4C %long   0x4A03EBAF
data.set 0xA0113B50 %long   0xC1DCF959
data.set 0xA0113B54 %long   0x5347BF82
data.set 0xA0113B58 %long   0x373F3C47
data.set 0xA0113B5C %long   0x7514F4F3
data.set 0xA0113B60 %long   0x254F3CE8
data.set 0xA0113B64 %long   0x59BD0E27
data.set 0xA0113B68 %long   0x0FD324B9
data.set 0xA0113B6C %long   0x8C2399E3
data.set 0xA0113B70 %long   0xE809C94A
data.set 0xA0113B74 %long   0xB60C92B3
data.set 0xA0113B78 %long   0xAB491F74
data.set 0xA0113B7C %long   0x63432EB5
data.set 0xA0113B80 %long   0x55663C5D
data.set 0xA0113B84 %long   0xAE4B1A68
data.set 0xA0113B88 %long   0x041F1AFD
data.set 0xA0113B8C %long   0xC7C148E6
data.set 0xA0113B90 %long   0x56B9E62C
data.set 0xA0113B94 %long   0xDCB428BE
data.set 0xA0113B98 %long   0x5D52458B
data.set 0xA0113B9C %long   0x3FF336B5
data.set 0xA0113BA0 %long   0x0DF853CE
data.set 0xA0113BA4 %long   0xC3573550
data.set 0xA0113BA8 %long   0x86F41192
data.set 0xA0113BAC %long   0xE9D5D1DF
data.set 0xA0113BB0 %long   0x8E5D276C
data.set 0xA0113BB4 %long   0xB7A91C01
data.set 0xA0113BB8 %long   0x8708F413
data.set 0xA0113BBC %long   0x5A628A46
data.set 0xA0113BC0 %long   0x39CDC758
data.set 0xA0113BC4 %long   0x5882F421
data.set 0xA0113BC8 %long   0xE9DDBD36
data.set 0xA0113BCC %long   0xA888A756
data.set 0xA0113BD0 %long   0xBF44563C
data.set 0xA0113BD4 %long   0xDADB99EB
data.set 0xA0113BD8 %long   0xB9F0AD30
data.set 0xA0113BDC %long   0xDA82ED93
data.set 0xA0113BE0 %long   0x0DDA4A71
data.set 0xA0113BE4 %long   0x74BE058A
data.set 0xA0113BE8 %long   0xBDD27772
data.set 0xA0113BEC %long   0x9F8F6F17
data.set 0xA0113BF0 %long   0x3327894B
data.set 0xA0113BF4 %long   0xC5D6ADA7
data.set 0xA0113BF8 %long   0x6DD8824F
data.set 0xA0113BFC %long   0xB51450F1
data.set 0xA0113C00 %long   0xD4F07297
data.set 0xA0113C04 %long   0x72830328
data.set 0xA0113C08 %long   0xE374BC5C
data.set 0xA0113C0C %long   0xDC5973A0
data.set 0xA0113C10 %long   0xA4159F5E
data.set 0xA0113C14 %long   0xB21B13FB
data.set 0xA0113C18 %long   0x03B9D539
data.set 0xA0113C1C %long   0xAC1B69EE
data.set 0xA0113C20 %long   0x33D71D29
data.set 0xA0113C24 %long   0x9F541100
data.set 0xA0113C28 %long   0xD7B534AA
data.set 0xA0113C2C %long   0x589CE02E
data.set 0xA0113C30 %long   0xBEE8E5BE
data.set 0xA0113C34 %long   0x33EA1752
data.set 0xA0113C38 %long   0xC0A1660C
data.set 0xA0113C3C %long   0xBF342447
data.set 0xA0113C40 %long   0x0ABF25DD
data.set 0xA0113C44 %long   0xA13A7C72
data.set 0xA0113C48 %long   0x04578FCD
data.set 0xA0113C4C %long   0x356EB43E
data.set 0xA0113C50 %long   0x5F64CC83
data.set 0xA0113C54 %long   0x949F4A15
data.set 0xA0113C58 %long   0x516222BA
data.set 0xA0113C5C %long   0x59596258
data.set 0xA0113C60 %long   0x361BA97E
data.set 0xA0113C64 %long   0x04753B6A
data.set 0xA0113C68 %long   0x15D56097
data.set 0xA0113C6C %long   0x738A2E68
data.set 0xA0113C70 %long   0xD26830DD
data.set 0xA0113C74 %long   0x3EBC31C9
data.set 0xA0113C78 %long   0xA8652F83
data.set 0xA0113C7C %long   0xECF5DD45
data.set 0xA0113C80 %long   0xFE1FAF43
data.set 0xA0113C84 %long   0xE75B8D72
data.set 0xA0113C88 %long   0xF901FD12
data.set 0xA0113C8C %long   0x2F14DB53
data.set 0xA0113C90 %long   0xA885ABD7
data.set 0xA0113C94 %long   0x63E55B76
data.set 0xA0113C98 %long   0x2111C59D
data.set 0xA0113C9C %long   0x23696FE7
data.set 0xA0113CA0 %long   0x82CE4DDF
data.set 0xA0113CA4 %long   0xD29B6ECC
data.set 0xA0113CA8 %long   0x2925D69B
data.set 0xA0113CAC %long   0xDCD9F75C
data.set 0xA0113CB0 %long   0xBD8311E5
data.set 0xA0113CB4 %long   0x85E87D3C
data.set 0xA0113CB8 %long   0x60F2083B
data.set 0xA0113CBC %long   0xDC4BAF6F
data.set 0xA0113CC0 %long   0x7FDA016F
data.set 0xA0113CC4 %long   0x47721E00
data.set 0xA0113CC8 %long   0xCF21CECA
data.set 0xA0113CCC %long   0x25AE906A
data.set 0xA0113CD0 %long   0x93BEF582
data.set 0xA0113CD4 %long   0xB34AEF30
data.set 0xA0113CD8 %long   0xE961A0FE
data.set 0xA0113CDC %long   0x7B4E0A3B
data.set 0xA0113CE0 %long   0x8D7797EB
data.set 0xA0113CE4 %long   0xAE2625F5
data.set 0xA0113CE8 %long   0x8A24F30E
data.set 0xA0113CEC %long   0x64DF0B74
data.set 0xA0113CF0 %long   0x1B254C9B
data.set 0xA0113CF4 %long   0x2A120627
data.set 0xA0113CF8 %long   0x24EB3A93
data.set 0xA0113CFC %long   0x250FE26F
data.set 0xA0113D00 %long   0x68325C9C
data.set 0xA0113D04 %long   0x0807E5AF
data.set 0xA0113D08 %long   0xD96CCD95
data.set 0xA0113D0C %long   0x2FA36DA7
data.set 0xA0113D10 %long   0x5E986679
data.set 0xA0113D14 %long   0xA5762E12
data.set 0xA0113D18 %long   0x2533F88C
data.set 0xA0113D1C %long   0x04C9DBA5
data.set 0xA0113D20 %long   0xD82D7C0E
data.set 0xA0113D24 %long   0xFC9AFE29
data.set 0xA0113D28 %long   0xAFDC3CB5
data.set 0xA0113D2C %long   0xE07682CC
data.set 0xA0113D30 %long   0xC6FEA15D
data.set 0xA0113D34 %long   0xD1B6E33F
data.set 0xA0113D38 %long   0x9CF991BA
data.set 0xA0113D3C %long   0x68472CDF
data.set 0xA0113D40 %long   0xABFFCF72
data.set 0xA0113D44 %long   0xE477D838
data.set 0xA0113D48 %long   0xCC530054
data.set 0xA0113D4C %long   0x59D45353
data.set 0xA0113D50 %long   0x13B46DD7
data.set 0xA0113D54 %long   0xDC74B341
data.set 0xA0113D58 %long   0x61EA3E34
data.set 0xA0113D5C %long   0x5CDCA8E5
data.set 0xA0113D60 %long   0x46D2CB83
data.set 0xA0113D64 %long   0x5EEE26E0
data.set 0xA0113D68 %long   0x6D16728D
data.set 0xA0113D6C %long   0xD4E10E1C
data.set 0xA0113D70 %long   0xD4DCE62C
data.set 0xA0113D74 %long   0xD921E134
data.set 0xA0113D78 %long   0xB115D597
data.set 0xA0113D7C %long   0x8BCD9021
data.set 0xA0113D80 %long   0x06D90BA0
data.set 0xA0113D84 %long   0xD4CB38D8
data.set 0xA0113D88 %long   0xD1C25C83
data.set 0xA0113D8C %long   0x7BB283D1
data.set 0xA0113D90 %long   0x019540A0
data.set 0xA0113D94 %long   0x74D41167
data.set 0xA0113D98 %long   0xFAE2F5AC
data.set 0xA0113D9C %long   0xD2B405F6
data.set 0xA0113DA0 %long   0x2A35EFAB
data.set 0xA0113DA4 %long   0xDB501056
data.set 0xA0113DA8 %long   0x7DF9A8CF
data.set 0xA0113DAC %long   0x13D8B86F
data.set 0xA0113DB0 %long   0x174630F1
data.set 0xA0113DB4 %long   0x4F66A817
data.set 0xA0113DB8 %long   0x71C0CB41
data.set 0xA0113DBC %long   0xB8AD4233
data.set 0xA0113DC0 %long   0xB3291FFE
data.set 0xA0113DC4 %long   0x623C304C
data.set 0xA0113DC8 %long   0x12A24A56
data.set 0xA0113DCC %long   0x99D94FA3
data.set 0xA0113DD0 %long   0xEC4FB650
data.set 0xA0113DD4 %long   0xDAA540BB
data.set 0xA0113DD8 %long   0x2DF0C055
data.set 0xA0113DDC %long   0x57F6FE49
data.set 0xA0113DE0 %long   0x37ABBA84
data.set 0xA0113DE4 %long   0x21FD786B
data.set 0xA0113DE8 %long   0x4125DD6B
data.set 0xA0113DEC %long   0x74412D90
data.set 0xA0113DF0 %long   0xDFC92CA2
data.set 0xA0113DF4 %long   0xDC28B55A
data.set 0xA0113DF8 %long   0xE67470C0
data.set 0xA0113DFC %long   0xE132F997
data.set 0xA0113E00 %long   0x98C9D34D
data.set 0xA0113E04 %long   0x11EE9330
data.set 0xA0113E08 %long   0xBAB25E82
data.set 0xA0113E0C %long   0xA294B30D
data.set 0xA0113E10 %long   0xE824063E
data.set 0xA0113E14 %long   0xA1C445CC
data.set 0xA0113E18 %long   0x28B0A776
data.set 0xA0113E1C %long   0xFC3D0ADC
data.set 0xA0113E20 %long   0x4162731A
data.set 0xA0113E24 %long   0x7FD71FC7
data.set 0xA0113E28 %long   0x071134D5
data.set 0xA0113E2C %long   0x822E3870
data.set 0xA0113E30 %long   0x86CAC3D2
data.set 0xA0113E34 %long   0x0365E59E
data.set 0xA0113E38 %long   0xBFB54C64
data.set 0xA0113E3C %long   0x1D8D213F
data.set 0xA0113E40 %long   0xC3CD5843
data.set 0xA0113E44 %long   0xC999BE5F
data.set 0xA0113E48 %long   0x765071ED
data.set 0xA0113E4C %long   0xC5D44871
data.set 0xA0113E50 %long   0xCF526B8E
data.set 0xA0113E54 %long   0xE653A45D
data.set 0xA0113E58 %long   0x1A2E2383
data.set 0xA0113E5C %long   0x08B5CDBE
data.set 0xA0113E60 %long   0xB478FF41
data.set 0xA0113E64 %long   0x2D023348
data.set 0xA0113E68 %long   0x5886AEDC
data.set 0xA0113E6C %long   0x078CB118
data.set 0xA0113E70 %long   0x6DBA8CE1
data.set 0xA0113E74 %long   0xC117BC8A
data.set 0xA0113E78 %long   0x88BAAF3E
data.set 0xA0113E7C %long   0x81868F0E
data.set 0xA0113E80 %long   0x00A67DA2
data.set 0xA0113E84 %long   0xDA336754
data.set 0xA0113E88 %long   0x9F146C06
data.set 0xA0113E8C %long   0x34B2AE00
data.set 0xA0113E90 %long   0x67B61670
data.set 0xA0113E94 %long   0x366E330F
data.set 0xA0113E98 %long   0xE2A3CCA7
data.set 0xA0113E9C %long   0x6F9CE554
data.set 0xA0113EA0 %long   0x5BFA0FC1
data.set 0xA0113EA4 %long   0xADCFB827
data.set 0xA0113EA8 %long   0x71A435A2
data.set 0xA0113EAC %long   0x705BE29F
data.set 0xA0113EB0 %long   0x352CB066
data.set 0xA0113EB4 %long   0x7CA21154
data.set 0xA0113EB8 %long   0x75296843
data.set 0xA0113EBC %long   0x63183E96
data.set 0xA0113EC0 %long   0xAB57189E
data.set 0xA0113EC4 %long   0x3467BF77
data.set 0xA0113EC8 %long   0xFC51DC73
data.set 0xA0113ECC %long   0xEEC61411
data.set 0xA0113ED0 %long   0x620B524C
data.set 0xA0113ED4 %long   0x083A8A2E
data.set 0xA0113ED8 %long   0xE0CEF31C
data.set 0xA0113EDC %long   0xBC7D8EA0
data.set 0xA0113EE0 %long   0x11DF85DE
data.set 0xA0113EE4 %long   0xB6FD9F25
data.set 0xA0113EE8 %long   0xDCC28106
data.set 0xA0113EEC %long   0xB2826DBF
data.set 0xA0113EF0 %long   0xDC052D68
data.set 0xA0113EF4 %long   0x4C234C1F
data.set 0xA0113EF8 %long   0xEDFCEA2C
data.set 0xA0113EFC %long   0x332CD5C9
data.set 0xA0113F00 %long   0x44E2B56F
data.set 0xA0113F04 %long   0x470BE784
data.set 0xA0113F08 %long   0x6BD65F76
data.set 0xA0113F0C %long   0xAF396B8F
data.set 0xA0113F10 %long   0xFDF68660
data.set 0xA0113F14 %long   0x34B6FD8B
data.set 0xA0113F18 %long   0x8A37B081
data.set 0xA0113F1C %long   0x5AED3E06
data.set 0xA0113F20 %long   0x5F9D04E8
data.set 0xA0113F24 %long   0x903FACFC
data.set 0xA0113F28 %long   0xFE51F228
data.set 0xA0113F2C %long   0x3603BA65
data.set 0xA0113F30 %long   0xC302B330
data.set 0xA0113F34 %long   0xB5C00096
data.set 0xA0113F38 %long   0xED5CB432
data.set 0xA0113F3C %long   0x8827E9F9
data.set 0xA0113F40 %long   0x977DBA5E
data.set 0xA0113F44 %long   0x829E8F4C
data.set 0xA0113F48 %long   0xC9F78810
data.set 0xA0113F4C %long   0xE74B1A08
data.set 0xA0113F50 %long   0x240DB04A
data.set 0xA0113F54 %long   0x6CB3AEFD
data.set 0xA0113F58 %long   0xCEA950C5
data.set 0xA0113F5C %long   0xACE67AEF
data.set 0xA0113F60 %long   0x52793A96
data.set 0xA0113F64 %long   0xB1CD3591
data.set 0xA0113F68 %long   0x8936899A
data.set 0xA0113F6C %long   0x178DBF3B
data.set 0xA0113F70 %long   0x18C0E7C1
data.set 0xA0113F74 %long   0x9451E902
data.set 0xA0113F78 %long   0x96F02ED5
data.set 0xA0113F7C %long   0xA868467B
data.set 0xA0113F80 %long   0x2AE41A95
data.set 0xA0113F84 %long   0xB2976691
data.set 0xA0113F88 %long   0x18F910BB
data.set 0xA0113F8C %long   0x02F9C2B7
data.set 0xA0113F90 %long   0x3914F245
data.set 0xA0113F94 %long   0xED6992A7
data.set 0xA0113F98 %long   0x341508D3
data.set 0xA0113F9C %long   0xA7B3246C
data.set 0xA0113FA0 %long   0xA30FE3C5
data.set 0xA0113FA4 %long   0x6B205BED
data.set 0xA0113FA8 %long   0x01CF55EC
data.set 0xA0113FAC %long   0xF13073B3
data.set 0xA0113FB0 %long   0xA93C14C4
data.set 0xA0113FB4 %long   0x2003EF83
data.set 0xA0113FB8 %long   0xC22A6383
data.set 0xA0113FBC %long   0x87190EDF
data.set 0xA0113FC0 %long   0xD6115D0F
data.set 0xA0113FC4 %long   0x9815FA9F
data.set 0xA0113FC8 %long   0x0B6BF805
data.set 0xA0113FCC %long   0x881DF9D5
data.set 0xA0113FD0 %long   0x2FCCB7B7
data.set 0xA0113FD4 %long   0x1FC7921F
data.set 0xA0113FD8 %long   0xFE294033
data.set 0xA0113FDC %long   0xDFE2E7AB
data.set 0xA0113FE0 %long   0x95724EEA
data.set 0xA0113FE4 %long   0xEF3B2B3D
data.set 0xA0113FE8 %long   0x6454FB8C
data.set 0xA0113FEC %long   0x3FFDF232
data.set 0xA0113FF0 %long   0x2F555C0A
data.set 0xA0113FF4 %long   0xBA51FF79
data.set 0xA0113FF8 %long   0xE76C01AC
data.set 0xA0113FFC %long   0x4D6F921A
data.set 0xA0114000 %long   0x30C99DB4
data.set 0xA0114004 %long   0xC1B8802F
data.set 0xA0114008 %long   0x135144FE
data.set 0xA011400C %long   0x719CD3A7
data.set 0xA0114010 %long   0x1DC4CBD0
data.set 0xA0114014 %long   0x35B0C8E1
data.set 0xA0114018 %long   0x796DA96A
data.set 0xA011401C %long   0x1E2E2CA4
data.set 0xA0114020 %long   0xBBCACA9F
data.set 0xA0114024 %long   0x818D7903
data.set 0xA0114028 %long   0x77949F52
data.set 0xA011402C %long   0xC871E188
data.set 0xA0114030 %long   0x4B1AD09C
data.set 0xA0114034 %long   0xC31FE847
data.set 0xA0114038 %long   0x4BA348A1
data.set 0xA011403C %long   0x19E54297
data.set 0xA0114040 %long   0xA0E0DC55
data.set 0xA0114044 %long   0x2C560B7A
data.set 0xA0114048 %long   0x35FBCB8D
data.set 0xA011404C %long   0x40676802
data.set 0xA0114050 %long   0x93274944
data.set 0xA0114054 %long   0xA2690C3D
data.set 0xA0114058 %long   0x7CFAA5FB
data.set 0xA011405C %long   0xE2A8D372
data.set 0xA0114060 %long   0x6787F5E8
data.set 0xA0114064 %long   0xF5C157AD
data.set 0xA0114068 %long   0x907E3F9C
data.set 0xA011406C %long   0x4B9C4421
data.set 0xA0114070 %long   0xF619292B
data.set 0xA0114074 %long   0x429900E0
data.set 0xA0114078 %long   0xF0CABB89
data.set 0xA011407C %long   0xB89BF276
data.set 0xA0114080 %long   0x61C2B63B
data.set 0xA0114084 %long   0x5BB58FDF
data.set 0xA0114088 %long   0x2DBEF19D
data.set 0xA011408C %long   0x0659BFE6
data.set 0xA0114090 %long   0xFE2D1AB1
data.set 0xA0114094 %long   0x3485B92F
data.set 0xA0114098 %long   0xB3648FAF
data.set 0xA011409C %long   0x9C4B3CE7
data.set 0xA01140A0 %long   0x471EF86C
data.set 0xA01140A4 %long   0x2C543F4E
data.set 0xA01140A8 %long   0x182B1FBC
data.set 0xA01140AC %long   0x98411E7B
data.set 0xA01140B0 %long   0x27810FE3
data.set 0xA01140B4 %long   0xBC03D44F
data.set 0xA01140B8 %long   0xAAE5FF5A
data.set 0xA01140BC %long   0xA6012D55
data.set 0xA01140C0 %long   0xA1B6F910
data.set 0xA01140C4 %long   0xF56A4CFF
data.set 0xA01140C8 %long   0x85E62CD9
data.set 0xA01140CC %long   0x3C6C4A35
data.set 0xA01140D0 %long   0xBE2E1598
data.set 0xA01140D4 %long   0xB4933DA9
data.set 0xA01140D8 %long   0x46F51201
data.set 0xA01140DC %long   0x4887E3EC
data.set 0xA01140E0 %long   0xC17090D9
data.set 0xA01140E4 %long   0x5C8035D8
data.set 0xA01140E8 %long   0x44CAA66A
data.set 0xA01140EC %long   0xB748FE8F
data.set 0xA01140F0 %long   0x87C3C064
data.set 0xA01140F4 %long   0x57AD6650
data.set 0xA01140F8 %long   0xCAB34EB3
data.set 0xA01140FC %long   0x961899CB
data.set 0xA0114100 %long   0x0995703B
data.set 0xA0114104 %long   0x71162677
data.set 0xA0114108 %long   0x01E0AD99
data.set 0xA011410C %long   0x98F13BDD
data.set 0xA0114110 %long   0x45398237
data.set 0xA0114114 %long   0x9170E76E
data.set 0xA0114118 %long   0x73ADE71C
data.set 0xA011411C %long   0x6080ED59
data.set 0xA0114120 %long   0x858BE013
data.set 0xA0114124 %long   0x1B6EA534
data.set 0xA0114128 %long   0x535516BB
data.set 0xA011412C %long   0x78E4AB71
data.set 0xA0114130 %long   0x9C3DBF78
data.set 0xA0114134 %long   0x3BE5D23F
data.set 0xA0114138 %long   0x8E22675A
data.set 0xA011413C %long   0x5F7BD9E3
data.set 0xA0114140 %long   0xB0DCF9CE
data.set 0xA0114144 %long   0x9E867D26
data.set 0xA0114148 %long   0x38159AF9
data.set 0xA011414C %long   0x5227BF3B
data.set 0xA0114150 %long   0x12DA225B
data.set 0xA0114154 %long   0x82767A76
data.set 0xA0114158 %long   0xF400D519
data.set 0xA011415C %long   0xB71DAAE0
data.set 0xA0114160 %long   0xDF7BB588
data.set 0xA0114164 %long   0x36595D5C
data.set 0xA0114168 %long   0xC3E3A7B2
data.set 0xA011416C %long   0xA2CB9121
data.set 0xA0114170 %long   0x875482A1
data.set 0xA0114174 %long   0x121F8007
data.set 0xA0114178 %long   0x14571CE9
data.set 0xA011417C %long   0xF50C06ED
data.set 0xA0114180 %long   0xF86D46CD
data.set 0xA0114184 %long   0xB9FF8F3F
data.set 0xA0114188 %long   0x6C9329CB
data.set 0xA011418C %long   0xA516E9F8
data.set 0xA0114190 %long   0x61DD2D62
data.set 0xA0114194 %long   0xF551976E
data.set 0xA0114198 %long   0x6D02379D
data.set 0xA011419C %long   0xF98B8185
data.set 0xA01141A0 %long   0xF422ED96
data.set 0xA01141A4 %long   0xAEF98676
data.set 0xA01141A8 %long   0xB51F9D48
data.set 0xA01141AC %long   0xF9E946C1
data.set 0xA01141B0 %long   0x1727B335
data.set 0xA01141B4 %long   0x9064669E
data.set 0xA01141B8 %long   0xD5108FCA
data.set 0xA01141BC %long   0x1A12203D
data.set 0xA01141C0 %long   0x60A09310
data.set 0xA01141C4 %long   0x6E4D2391
data.set 0xA01141C8 %long   0x213DD987
data.set 0xA01141CC %long   0x5CCFD875
data.set 0xA01141D0 %long   0x5C774F6B
data.set 0xA01141D4 %long   0x1CE006F0
data.set 0xA01141D8 %long   0x977A841B
data.set 0xA01141DC %long   0xFE482CBA
data.set 0xA01141E0 %long   0xB950D1FA
data.set 0xA01141E4 %long   0xBB384A84
data.set 0xA01141E8 %long   0xF6E84540
data.set 0xA01141EC %long   0x45C57FC3
data.set 0xA01141F0 %long   0x85D92278
data.set 0xA01141F4 %long   0xDADD9AC0
data.set 0xA01141F8 %long   0x3D79BA44
data.set 0xA01141FC %long   0x08D00FC7
data.set 0xA0114200 %long   0x30DA38AA
data.set 0xA0114204 %long   0x53D0DDA5
data.set 0xA0114208 %long   0x26D2D2C4
data.set 0xA011420C %long   0x322B9700
data.set 0xA0114210 %long   0x34EB63BA
data.set 0xA0114214 %long   0x8E239CB1
data.set 0xA0114218 %long   0xAED203E8
data.set 0xA011421C %long   0xA737F53A
data.set 0xA0114220 %long   0xC8EC86EF
data.set 0xA0114224 %long   0xBDE41438
data.set 0xA0114228 %long   0xA01FD69D
data.set 0xA011422C %long   0x7A1F6524
data.set 0xA0114230 %long   0x6C3FFAE9
data.set 0xA0114234 %long   0xDB13B713
data.set 0xA0114238 %long   0x1C7BAA96
data.set 0xA011423C %long   0x5F0389B2
data.set 0xA0114240 %long   0x23770B44
data.set 0xA0114244 %long   0x50E4A721
data.set 0xA0114248 %long   0xBB7DB316
data.set 0xA011424C %long   0xBA6BAF9D
data.set 0xA0114250 %long   0x816E2A01
data.set 0xA0114254 %long   0xA8C986D9
data.set 0xA0114258 %long   0x5FE162DD
data.set 0xA011425C %long   0xBF2A86DD
data.set 0xA0114260 %long   0xB78455AD
data.set 0xA0114264 %long   0xA8DA543D
data.set 0xA0114268 %long   0xDAD38548
data.set 0xA011426C %long   0xC98512A7
data.set 0xA0114270 %long   0x12B4421E
data.set 0xA0114274 %long   0xF74A2DB2
data.set 0xA0114278 %long   0x454564E4
data.set 0xA011427C %long   0x50A95FAF
data.set 0xA0114280 %long   0x2003AED3
data.set 0xA0114284 %long   0x13EBBF80
data.set 0xA0114288 %long   0x572B50D5
data.set 0xA011428C %long   0xB836FB15
data.set 0xA0114290 %long   0xDDA757A0
data.set 0xA0114294 %long   0x6B1BE8F3
data.set 0xA0114298 %long   0xE2702D05
data.set 0xA011429C %long   0xC1398393
data.set 0xA01142A0 %long   0xE0F2589E
data.set 0xA01142A4 %long   0x2CD04D07
data.set 0xA01142A8 %long   0x55C0147E
data.set 0xA01142AC %long   0x6F129B03
data.set 0xA01142B0 %long   0xCB35E88C
data.set 0xA01142B4 %long   0x4AFBD1EC
data.set 0xA01142B8 %long   0x07A09829
data.set 0xA01142BC %long   0xB7C9EEF3
data.set 0xA01142C0 %long   0x9BE89976
data.set 0xA01142C4 %long   0x5B5B2DA0
data.set 0xA01142C8 %long   0x9B242A6F
data.set 0xA01142CC %long   0xE6017096
data.set 0xA01142D0 %long   0xCD3BE009
data.set 0xA01142D4 %long   0x121FAC4C
data.set 0xA01142D8 %long   0xFFA92BCA
data.set 0xA01142DC %long   0x095642F9
data.set 0xA01142E0 %long   0xF10788E4
data.set 0xA01142E4 %long   0xE9B64B58
data.set 0xA01142E8 %long   0x29896F9B
data.set 0xA01142EC %long   0x3FC5D95D
data.set 0xA01142F0 %long   0x9CFE9EAD
data.set 0xA01142F4 %long   0x657ABFFC
data.set 0xA01142F8 %long   0x5D888BD2
data.set 0xA01142FC %long   0xE8966302
data.set 0xA0114300 %long   0x3B8C0F59
data.set 0xA0114304 %long   0x70B824AC
data.set 0xA0114308 %long   0x91DDDB55
data.set 0xA011430C %long   0x0B111FFE
data.set 0xA0114310 %long   0x802A64D0
data.set 0xA0114314 %long   0x8A0378F2
data.set 0xA0114318 %long   0x50617E74
data.set 0xA011431C %long   0xBF1632C9
data.set 0xA0114320 %long   0x11CC9CBF
data.set 0xA0114324 %long   0x555F9942
data.set 0xA0114328 %long   0x80FF5E28
data.set 0xA011432C %long   0xD020025C
data.set 0xA0114330 %long   0xA4A95D23
data.set 0xA0114334 %long   0x5DC601B5
data.set 0xA0114338 %long   0x3DAB2E95
data.set 0xA011433C %long   0xB4E723CD
data.set 0xA0114340 %long   0x9B62C3F2
data.set 0xA0114344 %long   0xB80DCE1C
data.set 0xA0114348 %long   0xF4DD0443
data.set 0xA011434C %long   0x5B1D762A
data.set 0xA0114350 %long   0x57239D7F
data.set 0xA0114354 %long   0xC404A456
data.set 0xA0114358 %long   0x1DAA8830
data.set 0xA011435C %long   0x1C742364
data.set 0xA0114360 %long   0xBAABB8B0
data.set 0xA0114364 %long   0x98B8D2FF
data.set 0xA0114368 %long   0x07802D38
data.set 0xA011436C %long   0x6553583A
data.set 0xA0114370 %long   0xFABC582C
data.set 0xA0114374 %long   0x532DA652
data.set 0xA0114378 %long   0x3D848607
data.set 0xA011437C %long   0xE6E2F55E
data.set 0xA0114380 %long   0x082B1F60
data.set 0xA0114384 %long   0x3070A2B5
data.set 0xA0114388 %long   0x9D27373C
data.set 0xA011438C %long   0xC7BE5EF7
data.set 0xA0114390 %long   0x65AF6C62
data.set 0xA0114394 %long   0xAD97EC03
data.set 0xA0114398 %long   0x7BE08516
data.set 0xA011439C %long   0xA48EB386
data.set 0xA01143A0 %long   0xCEB15F68
data.set 0xA01143A4 %long   0xDA3031D4
data.set 0xA01143A8 %long   0x0DE3D879
data.set 0xA01143AC %long   0x2499E09B
data.set 0xA01143B0 %long   0x5AAFD2E8
data.set 0xA01143B4 %long   0xFD3339F5
data.set 0xA01143B8 %long   0xABDED659
data.set 0xA01143BC %long   0xB4B2E00F
data.set 0xA01143C0 %long   0x2354B66D
data.set 0xA01143C4 %long   0x24E65A99
data.set 0xA01143C8 %long   0x3D9C09BB
data.set 0xA01143CC %long   0xD7D3A16B
data.set 0xA01143D0 %long   0x45A54E1F
data.set 0xA01143D4 %long   0x50545C74
data.set 0xA01143D8 %long   0x3D415ACB
data.set 0xA01143DC %long   0xE87E48E9
data.set 0xA01143E0 %long   0xC64EF98D
data.set 0xA01143E4 %long   0x74693DD1
data.set 0xA01143E8 %long   0x2111DB51
data.set 0xA01143EC %long   0x841DE268
data.set 0xA01143F0 %long   0xD5F503F9
data.set 0xA01143F4 %long   0xB50AA09F
data.set 0xA01143F8 %long   0x80147372
data.set 0xA01143FC %long   0x535F492B
data.set 0xA0114400 %long   0x0401016A
data.set 0xA0114404 %long   0xEFEDDAF1
data.set 0xA0114408 %long   0xBCC324D4
data.set 0xA011440C %long   0xFDFB7F67
data.set 0xA0114410 %long   0x0BCE2DD1
data.set 0xA0114414 %long   0x95CF7260
data.set 0xA0114418 %long   0x53E7E55F
data.set 0xA011441C %long   0xBB55B819
data.set 0xA0114420 %long   0xF0F63CCC
data.set 0xA0114424 %long   0xA792E46C
data.set 0xA0114428 %long   0x9B3811BE
data.set 0xA011442C %long   0x21CE280A
data.set 0xA0114430 %long   0x41CF6C18
data.set 0xA0114434 %long   0x36CBCC7B
data.set 0xA0114438 %long   0xF356EA5C
data.set 0xA011443C %long   0x0E5EB8C9
data.set 0xA0114440 %long   0xFC7645C9
data.set 0xA0114444 %long   0xDABEA686
data.set 0xA0114448 %long   0xB0EAFA29
data.set 0xA011444C %long   0x655518CF
data.set 0xA0114450 %long   0xEA3C1518
data.set 0xA0114454 %long   0x72BC362D
data.set 0xA0114458 %long   0x540A879A
data.set 0xA011445C %long   0xE70B4277
data.set 0xA0114460 %long   0x0FA1C83D
data.set 0xA0114464 %long   0xD0411848
data.set 0xA0114468 %long   0x7268ADA5
data.set 0xA011446C %long   0x028FEAED
data.set 0xA0114470 %long   0x801EED06
data.set 0xA0114474 %long   0x636A5153
data.set 0xA0114478 %long   0xB63443C3
data.set 0xA011447C %long   0x3B3CA99C
data.set 0xA0114480 %long   0x6D43B94E
data.set 0xA0114484 %long   0x8D97D84A
data.set 0xA0114488 %long   0x5A02F770
data.set 0xA011448C %long   0x53C0F6EF
data.set 0xA0114490 %long   0x8A9FC260
data.set 0xA0114494 %long   0x46DA7367
data.set 0xA0114498 %long   0x5508475A
data.set 0xA011449C %long   0x2B514EFF
data.set 0xA01144A0 %long   0x8F02FF6E
data.set 0xA01144A4 %long   0x50D9F514
data.set 0xA01144A8 %long   0x4B8D8F08
data.set 0xA01144AC %long   0x942A6A70
data.set 0xA01144B0 %long   0xE28FD09F
data.set 0xA01144B4 %long   0xDD60B077
data.set 0xA01144B8 %long   0xB3E34EE5
data.set 0xA01144BC %long   0xDBC95B5C
data.set 0xA01144C0 %long   0x6F752057
data.set 0xA01144C4 %long   0xBE6D4EBB
data.set 0xA01144C8 %long   0x0125834D
data.set 0xA01144CC %long   0xEA66A8D2
data.set 0xA01144D0 %long   0x75938449
data.set 0xA01144D4 %long   0x53D7041F
data.set 0xA01144D8 %long   0xC7855B10
data.set 0xA01144DC %long   0x42AF68C6
data.set 0xA01144E0 %long   0x454965E8
data.set 0xA01144E4 %long   0x067AEB6C
data.set 0xA01144E8 %long   0xD890295F
data.set 0xA01144EC %long   0xAD4913ED
data.set 0xA01144F0 %long   0xE097FAF7
data.set 0xA01144F4 %long   0x65DD16C6
data.set 0xA01144F8 %long   0xEEBE2218
data.set 0xA01144FC %long   0xFD7FCB51
data.set 0xA0114500 %long   0x04B08FFF
data.set 0xA0114504 %long   0xD678AF04
data.set 0xA0114508 %long   0xE496B224
data.set 0xA011450C %long   0x597B8B10
data.set 0xA0114510 %long   0xE6509824
data.set 0xA0114514 %long   0x627998D6
data.set 0xA0114518 %long   0xEF4D586B
data.set 0xA011451C %long   0x33CD7F01
data.set 0xA0114520 %long   0x9ACF67DC
data.set 0xA0114524 %long   0x5270A390
data.set 0xA0114528 %long   0x1F3CF565
data.set 0xA011452C %long   0xF4B09035
data.set 0xA0114530 %long   0x8FE5DD31
data.set 0xA0114534 %long   0xFE434DCE
data.set 0xA0114538 %long   0x5BEB8D55
data.set 0xA011453C %long   0xD932596F
data.set 0xA0114540 %long   0x27F03553
data.set 0xA0114544 %long   0x215442F4
data.set 0xA0114548 %long   0x0E9B4FA4
data.set 0xA011454C %long   0xF452FF88
data.set 0xA0114550 %long   0x68C229A5
data.set 0xA0114554 %long   0x8C50DBE1
data.set 0xA0114558 %long   0xC93D953B
data.set 0xA011455C %long   0x5E7A4380
data.set 0xA0114560 %long   0x1CA0364C
data.set 0xA0114564 %long   0x03CA08B0
data.set 0xA0114568 %long   0x930613CF
data.set 0xA011456C %long   0x8BC832A3
data.set 0xA0114570 %long   0x85DCE603
data.set 0xA0114574 %long   0x494C8678
data.set 0xA0114578 %long   0x3C5E97D2
data.set 0xA011457C %long   0x0121DCE5
data.set 0xA0114580 %long   0x532C2F29
data.set 0xA0114584 %long   0xBFD42BF7
data.set 0xA0114588 %long   0x0C3898D6
data.set 0xA011458C %long   0x03CB0AA3
data.set 0xA0114590 %long   0x40C39A00
data.set 0xA0114594 %long   0xD006E218
data.set 0xA0114598 %long   0x272B4AB4
data.set 0xA011459C %long   0x94C5FF89
data.set 0xA01145A0 %long   0x5120FE2B
data.set 0xA01145A4 %long   0xC89A2634
data.set 0xA01145A8 %long   0xD4661092
data.set 0xA01145AC %long   0xC381AC05
data.set 0xA01145B0 %long   0x425F5FF3
data.set 0xA01145B4 %long   0x1C861C8B
data.set 0xA01145B8 %long   0x9AB1944B
data.set 0xA01145BC %long   0x815405D4
data.set 0xA01145C0 %long   0xB6CFE49E
data.set 0xA01145C4 %long   0xA9104AC6
data.set 0xA01145C8 %long   0xC9D95DC7
data.set 0xA01145CC %long   0xD2CB84C1
data.set 0xA01145D0 %long   0x2B7CF712
data.set 0xA01145D4 %long   0x251ED3F4
data.set 0xA01145D8 %long   0xE5166F00
data.set 0xA01145DC %long   0x352BC10E
data.set 0xA01145E0 %long   0x7058B446
data.set 0xA01145E4 %long   0x7EF19B6B
data.set 0xA01145E8 %long   0x6B2F3D7A
data.set 0xA01145EC %long   0x5B7500D4
data.set 0xA01145F0 %long   0x248507F4
data.set 0xA01145F4 %long   0x139F862D
data.set 0xA01145F8 %long   0x1BF7D568
data.set 0xA01145FC %long   0x94261AC5
data.set 0xA0114600 %long   0x556D12C2
data.set 0xA0114604 %long   0x3B240568
data.set 0xA0114608 %long   0xAF890265
data.set 0xA011460C %long   0xD106E569
data.set 0xA0114610 %long   0xE70D77C4
data.set 0xA0114614 %long   0x73E0394B
data.set 0xA0114618 %long   0x5751FF97
data.set 0xA011461C %long   0x5A3433C6
data.set 0xA0114620 %long   0x949FF889
data.set 0xA0114624 %long   0x23051EDC
data.set 0xA0114628 %long   0xC37BD6B8
data.set 0xA011462C %long   0x8EF7E64C
data.set 0xA0114630 %long   0x3F859C51
data.set 0xA0114634 %long   0x6710689D
data.set 0xA0114638 %long   0xE3513653
data.set 0xA011463C %long   0xA2800DF8
data.set 0xA0114640 %long   0x8BB37AEB
data.set 0xA0114644 %long   0x0258D32D
data.set 0xA0114648 %long   0x152D5D20
data.set 0xA011464C %long   0xD3AE624A
data.set 0xA0114650 %long   0x6541C9AD
data.set 0xA0114654 %long   0x1174C899
data.set 0xA0114658 %long   0x6DD02E6B
data.set 0xA011465C %long   0xA6C7E25F
data.set 0xA0114660 %long   0x136AD1A6
data.set 0xA0114664 %long   0xA2AA3227
data.set 0xA0114668 %long   0x2587A293
data.set 0xA011466C %long   0xFFD692F3
data.set 0xA0114670 %long   0xE69C23AD
data.set 0xA0114674 %long   0xACE6D665
data.set 0xA0114678 %long   0x39F4E22F
data.set 0xA011467C %long   0xF9706E39
data.set 0xA0114680 %long   0x45DB1F3A
data.set 0xA0114684 %long   0xF76FA31D
data.set 0xA0114688 %long   0xA6092110
data.set 0xA011468C %long   0x60889115
data.set 0xA0114690 %long   0x21D47360
data.set 0xA0114694 %long   0xF3B2BAF7
data.set 0xA0114698 %long   0x2E39E308
data.set 0xA011469C %long   0xCFA58EAA
data.set 0xA01146A0 %long   0x218A3B3A
data.set 0xA01146A4 %long   0x430C8575
data.set 0xA01146A8 %long   0x4EE94B26
data.set 0xA01146AC %long   0x122A7308
data.set 0xA01146B0 %long   0x5E2B127B
data.set 0xA01146B4 %long   0xC538CC20
data.set 0xA01146B8 %long   0x4B961528
data.set 0xA01146BC %long   0xF18F3BE6
data.set 0xA01146C0 %long   0xCA94167E
data.set 0xA01146C4 %long   0x27D9E6D4
data.set 0xA01146C8 %long   0x415A5CBE
data.set 0xA01146CC %long   0xD68968A6
data.set 0xA01146D0 %long   0x8B3A016F
data.set 0xA01146D4 %long   0x07FEDEC1
data.set 0xA01146D8 %long   0x9C0BCD5F
data.set 0xA01146DC %long   0x0515404B
data.set 0xA01146E0 %long   0x35AE96EE
data.set 0xA01146E4 %long   0x8BDB952E
data.set 0xA01146E8 %long   0x61A6EE7A
data.set 0xA01146EC %long   0x98531A76
data.set 0xA01146F0 %long   0xF14F01BF
data.set 0xA01146F4 %long   0xC9A0C2ED
data.set 0xA01146F8 %long   0x312AD464
data.set 0xA01146FC %long   0x4BBF4A8E
data.set 0xA0114700 %long   0xB4D4AF47
data.set 0xA0114704 %long   0xC4CF65A5
data.set 0xA0114708 %long   0x18B325CD
data.set 0xA011470C %long   0x1075A164
data.set 0xA0114710 %long   0x10E648FA
data.set 0xA0114714 %long   0xF99BC0AA
data.set 0xA0114718 %long   0xD9817B69
data.set 0xA011471C %long   0xDC6E2173
data.set 0xA0114720 %long   0x9BC34A4E
data.set 0xA0114724 %long   0x3CAEE230
data.set 0xA0114728 %long   0x7945164B
data.set 0xA011472C %long   0x1DC3C414
data.set 0xA0114730 %long   0x43F772EA
data.set 0xA0114734 %long   0x3A095B05
data.set 0xA0114738 %long   0x9B1BB2EA
data.set 0xA011473C %long   0x4A167E48
data.set 0xA0114740 %long   0xAFA6415A
data.set 0xA0114744 %long   0x879C0232
data.set 0xA0114748 %long   0x70ABEBB3
data.set 0xA011474C %long   0x0F9F4850
data.set 0xA0114750 %long   0xEC030744
data.set 0xA0114754 %long   0xEDF5D584
data.set 0xA0114758 %long   0xDE6926B9
data.set 0xA011475C %long   0x6E395D84
data.set 0xA0114760 %long   0x31A03319
data.set 0xA0114764 %long   0x048BE07F
data.set 0xA0114768 %long   0xAD109E9B
data.set 0xA011476C %long   0x1DDDC3C7
data.set 0xA0114770 %long   0xC5D750AB
data.set 0xA0114774 %long   0x127ACD80
data.set 0xA0114778 %long   0x3EDC766B
data.set 0xA011477C %long   0x09203564
data.set 0xA0114780 %long   0x133DE98B
data.set 0xA0114784 %long   0xD963A330
data.set 0xA0114788 %long   0xDB4B84A8
data.set 0xA011478C %long   0x01CADECB
data.set 0xA0114790 %long   0x27237AF1
data.set 0xA0114794 %long   0x0833F07D
data.set 0xA0114798 %long   0x4A58395D
data.set 0xA011479C %long   0xDC0180B3
data.set 0xA01147A0 %long   0xA94F9596
data.set 0xA01147A4 %long   0x7D39CA90
data.set 0xA01147A8 %long   0xE460D231
data.set 0xA01147AC %long   0x9D4AAD7E
data.set 0xA01147B0 %long   0xF027A510
data.set 0xA01147B4 %long   0x6395E47A
data.set 0xA01147B8 %long   0x33A2120F
data.set 0xA01147BC %long   0x8D0532DC
data.set 0xA01147C0 %long   0x1F9AA5EC
data.set 0xA01147C4 %long   0xF9CBC984
data.set 0xA01147C8 %long   0xC5C64501
data.set 0xA01147CC %long   0xBC23C48C
data.set 0xA01147D0 %long   0x525757D9
data.set 0xA01147D4 %long   0x01BC72C1
data.set 0xA01147D8 %long   0x7110C5EE
data.set 0xA01147DC %long   0xBC624CEB
data.set 0xA01147E0 %long   0x39A92322
data.set 0xA01147E4 %long   0x1F0BE1F7
data.set 0xA01147E8 %long   0x366C7B21
data.set 0xA01147EC %long   0x0A9F5A30
data.set 0xA01147F0 %long   0x6C858B51
data.set 0xA01147F4 %long   0x3BC35B8A
data.set 0xA01147F8 %long   0x61936E48
data.set 0xA01147FC %long   0xB31C85AE
data.set 0xA0114800 %long   0x21E2D9BB
data.set 0xA0114804 %long   0xB508993E
data.set 0xA0114808 %long   0x741AB627
data.set 0xA011480C %long   0xDD4577B9
data.set 0xA0114810 %long   0x93381957
data.set 0xA0114814 %long   0x6789A68A
data.set 0xA0114818 %long   0x9A687EAE
data.set 0xA011481C %long   0x530A3681
data.set 0xA0114820 %long   0x6A5EBBA9
data.set 0xA0114824 %long   0x0AE4E1C8
data.set 0xA0114828 %long   0xE66A3277
data.set 0xA011482C %long   0xF123DB13
data.set 0xA0114830 %long   0xB0E4329C
data.set 0xA0114834 %long   0xDFC574EE
data.set 0xA0114838 %long   0xB4FE3628
data.set 0xA011483C %long   0x70566AD9
data.set 0xA0114840 %long   0xDE927EBD
data.set 0xA0114844 %long   0x3B9DD95E
data.set 0xA0114848 %long   0xC6B2598E
data.set 0xA011484C %long   0x7E6E3123
data.set 0xA0114850 %long   0x32DCA52B
data.set 0xA0114854 %long   0xB802BC41
data.set 0xA0114858 %long   0x550A19EE
data.set 0xA011485C %long   0x7E813ECF
data.set 0xA0114860 %long   0x3F4B128E
data.set 0xA0114864 %long   0x3B8AC061
data.set 0xA0114868 %long   0xBD658136
data.set 0xA011486C %long   0x96096749
data.set 0xA0114870 %long   0xC82EEE2A
data.set 0xA0114874 %long   0xB169744F
data.set 0xA0114878 %long   0x5E1BE096
data.set 0xA011487C %long   0x3026D830
data.set 0xA0114880 %long   0x582D9D2D
data.set 0xA0114884 %long   0xF79650F4
data.set 0xA0114888 %long   0x711E32D1
data.set 0xA011488C %long   0x1DF65714
data.set 0xA0114890 %long   0xE3AE6AC6
data.set 0xA0114894 %long   0xC27581EC
data.set 0xA0114898 %long   0x9C3FE9E1
data.set 0xA011489C %long   0xCF396E73
data.set 0xA01148A0 %long   0x5AB47906
data.set 0xA01148A4 %long   0xE45AACA4
data.set 0xA01148A8 %long   0x2D5B4B57
data.set 0xA01148AC %long   0xAB19CF86
data.set 0xA01148B0 %long   0x554415BF
data.set 0xA01148B4 %long   0x907E0A53
data.set 0xA01148B8 %long   0x8B5F4763
data.set 0xA01148BC %long   0x7859F36C
data.set 0xA01148C0 %long   0xC5CAE755
data.set 0xA01148C4 %long   0xB7AD7EB6
data.set 0xA01148C8 %long   0xA3BF9EB9
data.set 0xA01148CC %long   0x32933049
data.set 0xA01148D0 %long   0xAA9221B0
data.set 0xA01148D4 %long   0x2EB1D644
data.set 0xA01148D8 %long   0xF71A5239
data.set 0xA01148DC %long   0xD6FFF5D8
data.set 0xA01148E0 %long   0x86C27299
data.set 0xA01148E4 %long   0x2F1C479B
data.set 0xA01148E8 %long   0xA058F74D
data.set 0xA01148EC %long   0xE4D9CC4C
data.set 0xA01148F0 %long   0xF21A3F6C
data.set 0xA01148F4 %long   0x202E9FA1
data.set 0xA01148F8 %long   0x226EB676
data.set 0xA01148FC %long   0x5774B747
data.set 0xA0114900 %long   0x97C30171
data.set 0xA0114904 %long   0x658C3F8B
data.set 0xA0114908 %long   0x1AC77A96
data.set 0xA011490C %long   0x7B36EA36
data.set 0xA0114910 %long   0x7AFDC317
data.set 0xA0114914 %long   0x82775EAC
data.set 0xA0114918 %long   0x135EB82F
data.set 0xA011491C %long   0xAD606650
data.set 0xA0114920 %long   0xF3D0E38B
data.set 0xA0114924 %long   0x20616242
data.set 0xA0114928 %long   0x23238BA4
data.set 0xA011492C %long   0x7BE7CB1C
data.set 0xA0114930 %long   0xEDADADDF
data.set 0xA0114934 %long   0xADA050D3
data.set 0xA0114938 %long   0x89A2EE35
data.set 0xA011493C %long   0x3E6BF818
data.set 0xA0114940 %long   0x2A3EC2B7
data.set 0xA0114944 %long   0x2484AC8D
data.set 0xA0114948 %long   0xBA836EAB
data.set 0xA011494C %long   0x798A0A55
data.set 0xA0114950 %long   0xC3842B9B
data.set 0xA0114954 %long   0x3DF2FFFB
data.set 0xA0114958 %long   0x63E3A3F4
data.set 0xA011495C %long   0xF304AEAB
data.set 0xA0114960 %long   0x578DE398
data.set 0xA0114964 %long   0xAA268DD5
data.set 0xA0114968 %long   0xF1B20202
data.set 0xA011496C %long   0xB8A75F3A
data.set 0xA0114970 %long   0x47FD3B52
data.set 0xA0114974 %long   0x3928C329
data.set 0xA0114978 %long   0x04BCFB5C
data.set 0xA011497C %long   0xCCAD8594
data.set 0xA0114980 %long   0xAEFEFFBB
data.set 0xA0114984 %long   0x66D84895
data.set 0xA0114988 %long   0x389CFE5F
data.set 0xA011498C %long   0x784C0354
data.set 0xA0114990 %long   0x45819C78
data.set 0xA0114994 %long   0xD1B799DF
data.set 0xA0114998 %long   0x9E4C55E5
data.set 0xA011499C %long   0x77CF1F84
data.set 0xA01149A0 %long   0xDFD8C012
data.set 0xA01149A4 %long   0x6F514828
data.set 0xA01149A8 %long   0x8C9BB68F
data.set 0xA01149AC %long   0xD8A81932
data.set 0xA01149B0 %long   0x967717C9
data.set 0xA01149B4 %long   0x58065F0F
data.set 0xA01149B8 %long   0xD1018CEB
data.set 0xA01149BC %long   0xB55AA4B9
data.set 0xA01149C0 %long   0x7DA7ECFF
data.set 0xA01149C4 %long   0x8DE23A2B
data.set 0xA01149C8 %long   0xB65FF0FE
data.set 0xA01149CC %long   0x27D70CC1
data.set 0xA01149D0 %long   0x1CA76CC7
data.set 0xA01149D4 %long   0x251A00BA
data.set 0xA01149D8 %long   0x525A1FDC
data.set 0xA01149DC %long   0x8A6CBD23
data.set 0xA01149E0 %long   0x913018B9
data.set 0xA01149E4 %long   0x6D0279E1
data.set 0xA01149E8 %long   0xBD36F16D
data.set 0xA01149EC %long   0x84C8A7E3
data.set 0xA01149F0 %long   0x64F372F2
data.set 0xA01149F4 %long   0x4D5B652F
data.set 0xA01149F8 %long   0x90630A75
data.set 0xA01149FC %long   0xBDA30F85
data.set 0xA0114A00 %long   0x74EED5A4
data.set 0xA0114A04 %long   0x52A6925A
data.set 0xA0114A08 %long   0x3BDE4EC2
data.set 0xA0114A0C %long   0x9B5B41BC
data.set 0xA0114A10 %long   0x4ACB6CC2
data.set 0xA0114A14 %long   0x53349CA4
data.set 0xA0114A18 %long   0x2250FD28
data.set 0xA0114A1C %long   0x50E8D891
data.set 0xA0114A20 %long   0x1F3F2504
data.set 0xA0114A24 %long   0x1E897059
data.set 0xA0114A28 %long   0xFC5FB208
data.set 0xA0114A2C %long   0x25C8FD26
data.set 0xA0114A30 %long   0xD37EF822
data.set 0xA0114A34 %long   0x68EC5AAE
data.set 0xA0114A38 %long   0x79640324
data.set 0xA0114A3C %long   0xEB35F4C8
data.set 0xA0114A40 %long   0x2C262DEC
data.set 0xA0114A44 %long   0x8F14A776
data.set 0xA0114A48 %long   0xD0E50B26
data.set 0xA0114A4C %long   0x2448745A
data.set 0xA0114A50 %long   0xA8778A4F
data.set 0xA0114A54 %long   0x7A80F5A8
data.set 0xA0114A58 %long   0x8F3DF5FD
data.set 0xA0114A5C %long   0x1DE7EAE8
data.set 0xA0114A60 %long   0xFDE8F8F1
data.set 0xA0114A64 %long   0xF0A89689
data.set 0xA0114A68 %long   0xE739641E
data.set 0xA0114A6C %long   0x38DA3E5C
data.set 0xA0114A70 %long   0x374BFBA3
data.set 0xA0114A74 %long   0x44B9898A
data.set 0xA0114A78 %long   0xD6226E16
data.set 0xA0114A7C %long   0xF77E55EA
data.set 0xA0114A80 %long   0x8BB1A6B8
data.set 0xA0114A84 %long   0x287728AE
data.set 0xA0114A88 %long   0x3DF41D2A
data.set 0xA0114A8C %long   0x075542C2
data.set 0xA0114A90 %long   0xF8AAF6F9
data.set 0xA0114A94 %long   0x647FC72C
data.set 0xA0114A98 %long   0x00B64FED
data.set 0xA0114A9C %long   0xCB555A5C
data.set 0xA0114AA0 %long   0xB21A564E
data.set 0xA0114AA4 %long   0x8F618E83
data.set 0xA0114AA8 %long   0x9364A160
data.set 0xA0114AAC %long   0x9ED64DAF
data.set 0xA0114AB0 %long   0x9D2D3A0E
data.set 0xA0114AB4 %long   0x62A243A1
data.set 0xA0114AB8 %long   0xE294A027
data.set 0xA0114ABC %long   0xD20F6C69
data.set 0xA0114AC0 %long   0x6D32CDD7
data.set 0xA0114AC4 %long   0x949CA79D
data.set 0xA0114AC8 %long   0xB780B034
data.set 0xA0114ACC %long   0x1EF813A9
data.set 0xA0114AD0 %long   0x451C03AA
data.set 0xA0114AD4 %long   0xA3163276
data.set 0xA0114AD8 %long   0x4F74FA45
data.set 0xA0114ADC %long   0xBA778530
data.set 0xA0114AE0 %long   0xBD07796A
data.set 0xA0114AE4 %long   0x7D4015EC
data.set 0xA0114AE8 %long   0x51B6718C
data.set 0xA0114AEC %long   0x3110031A
data.set 0xA0114AF0 %long   0xC0D5379F
data.set 0xA0114AF4 %long   0x1F9D064E
data.set 0xA0114AF8 %long   0xB097F47C
data.set 0xA0114AFC %long   0x98680A0C
data.set 0xA0114B00 %long   0xB5BACA81
data.set 0xA0114B04 %long   0xCAD5CAF3
data.set 0xA0114B08 %long   0x816DA3CD
data.set 0xA0114B0C %long   0x3A0AF6DE
data.set 0xA0114B10 %long   0x4D5352A7
data.set 0xA0114B14 %long   0xCA332A5A
data.set 0xA0114B18 %long   0xAEA67B9F
data.set 0xA0114B1C %long   0xC40CBAAC
data.set 0xA0114B20 %long   0x9F8D4C7E
data.set 0xA0114B24 %long   0x2AA8C833
data.set 0xA0114B28 %long   0xC7193801
data.set 0xA0114B2C %long   0xDF782132
data.set 0xA0114B30 %long   0x6CD79740
data.set 0xA0114B34 %long   0xB55CA8EA
data.set 0xA0114B38 %long   0xFDFF8C64
data.set 0xA0114B3C %long   0xC825A349
data.set 0xA0114B40 %long   0x9A4B96A4
data.set 0xA0114B44 %long   0xCFB8FA83
data.set 0xA0114B48 %long   0xF11E9A3B
data.set 0xA0114B4C %long   0xBC849C17
data.set 0xA0114B50 %long   0xA982533A
data.set 0xA0114B54 %long   0x3419FF6A
data.set 0xA0114B58 %long   0xFC2930DE
data.set 0xA0114B5C %long   0x5AAFA866
data.set 0xA0114B60 %long   0x5A8304D3
data.set 0xA0114B64 %long   0x986CFCB4
data.set 0xA0114B68 %long   0x90AAB9EE
data.set 0xA0114B6C %long   0x4543C9A6
data.set 0xA0114B70 %long   0xB243876F
data.set 0xA0114B74 %long   0xECED4FDE
data.set 0xA0114B78 %long   0x244DEEBA
data.set 0xA0114B7C %long   0xEE42B56B
data.set 0xA0114B80 %long   0xFD4AFF0B
data.set 0xA0114B84 %long   0xA1FBF6EB
data.set 0xA0114B88 %long   0x186B0B40
data.set 0xA0114B8C %long   0xA6222B69
data.set 0xA0114B90 %long   0xE6E6A114
data.set 0xA0114B94 %long   0x24C46D5B
data.set 0xA0114B98 %long   0x4CF8A523
data.set 0xA0114B9C %long   0x571DB6E5
data.set 0xA0114BA0 %long   0x6F5C787E
data.set 0xA0114BA4 %long   0x1B33A1E4
data.set 0xA0114BA8 %long   0x4FE41BB6
data.set 0xA0114BAC %long   0xFDD6DEDD
data.set 0xA0114BB0 %long   0x8540FA71
data.set 0xA0114BB4 %long   0xEAC83E26
data.set 0xA0114BB8 %long   0x247A4E55
data.set 0xA0114BBC %long   0x37C28B37
data.set 0xA0114BC0 %long   0x1ADB541A
data.set 0xA0114BC4 %long   0x954BC3D3
data.set 0xA0114BC8 %long   0x5E6BD524
data.set 0xA0114BCC %long   0xDE3695A0
data.set 0xA0114BD0 %long   0x75501A72
data.set 0xA0114BD4 %long   0x81936EB3
data.set 0xA0114BD8 %long   0xF43E41D6
data.set 0xA0114BDC %long   0x87521B79
data.set 0xA0114BE0 %long   0xEC22614C
data.set 0xA0114BE4 %long   0xF4E148A6
data.set 0xA0114BE8 %long   0x9B648C83
data.set 0xA0114BEC %long   0x69CC948E
data.set 0xA0114BF0 %long   0x503A6097
data.set 0xA0114BF4 %long   0x7C994156
data.set 0xA0114BF8 %long   0xF871BCD2
data.set 0xA0114BFC %long   0x95891BD1
data.set 0xA0114C00 %long   0xF230D8E3
data.set 0xA0114C04 %long   0x5E06EFEA
data.set 0xA0114C08 %long   0x4C2A93D6
data.set 0xA0114C0C %long   0x1684FEBE
data.set 0xA0114C10 %long   0x342611BF
data.set 0xA0114C14 %long   0xCDBDC060
data.set 0xA0114C18 %long   0xC13691C9
data.set 0xA0114C1C %long   0xB02C272E
data.set 0xA0114C20 %long   0x2DFEFFE8
data.set 0xA0114C24 %long   0x15C856EB
data.set 0xA0114C28 %long   0xE8870176
data.set 0xA0114C2C %long   0x487E35FF
data.set 0xA0114C30 %long   0x6732E590
data.set 0xA0114C34 %long   0xF57A7F27
data.set 0xA0114C38 %long   0x4E5E4426
data.set 0xA0114C3C %long   0x9B4F656A
data.set 0xA0114C40 %long   0x696FB6C7
data.set 0xA0114C44 %long   0x7E85AC8E
data.set 0xA0114C48 %long   0xF4AC124A
data.set 0xA0114C4C %long   0x9BAB1E75
data.set 0xA0114C50 %long   0x3E67D09B
data.set 0xA0114C54 %long   0xAEFAD0FC
data.set 0xA0114C58 %long   0x1AB8D880
data.set 0xA0114C5C %long   0xE1E9D726
data.set 0xA0114C60 %long   0x153132B9
data.set 0xA0114C64 %long   0x8B3924BA
data.set 0xA0114C68 %long   0xFE4F3ACA
data.set 0xA0114C6C %long   0xB2B42C1B
data.set 0xA0114C70 %long   0xA2CDCF3A
data.set 0xA0114C74 %long   0xC9E04BD5
data.set 0xA0114C78 %long   0xE6A09753
data.set 0xA0114C7C %long   0x6211F662
data.set 0xA0114C80 %long   0x873A65A1
data.set 0xA0114C84 %long   0x7DE480EA
data.set 0xA0114C88 %long   0xB38EF894
data.set 0xA0114C8C %long   0x57D0F399
data.set 0xA0114C90 %long   0x8A04D745
data.set 0xA0114C94 %long   0x651D862A
data.set 0xA0114C98 %long   0xAF7556D2
data.set 0xA0114C9C %long   0xE3E24C4E
data.set 0xA0114CA0 %long   0x2360287D
data.set 0xA0114CA4 %long   0xFAB23A15
data.set 0xA0114CA8 %long   0x0A786E73
data.set 0xA0114CAC %long   0x39D66EF8
data.set 0xA0114CB0 %long   0x69225C26
data.set 0xA0114CB4 %long   0xB8682074
data.set 0xA0114CB8 %long   0x21305D1B
data.set 0xA0114CBC %long   0x34E8616D
data.set 0xA0114CC0 %long   0xB4A02E01
data.set 0xA0114CC4 %long   0x8B0F8C89
data.set 0xA0114CC8 %long   0x83AA5B1E
data.set 0xA0114CCC %long   0xBD5AA4FE
data.set 0xA0114CD0 %long   0x480C0DF0
data.set 0xA0114CD4 %long   0xED4BC184
data.set 0xA0114CD8 %long   0xFAF74159
data.set 0xA0114CDC %long   0xED4D93CF
data.set 0xA0114CE0 %long   0xC9B829F1
data.set 0xA0114CE4 %long   0x13546ACE
data.set 0xA0114CE8 %long   0x5676ABD5
data.set 0xA0114CEC %long   0xF03A2DE6
data.set 0xA0114CF0 %long   0xACA715D0
data.set 0xA0114CF4 %long   0xDD99CB5F
data.set 0xA0114CF8 %long   0x31A5B5F2
data.set 0xA0114CFC %long   0xD7666045
data.set 0xA0114D00 %long   0xFA4C3885
data.set 0xA0114D04 %long   0x24484BA9
data.set 0xA0114D08 %long   0x415E1D8E
data.set 0xA0114D0C %long   0x7193A017
data.set 0xA0114D10 %long   0x6DFD7637
data.set 0xA0114D14 %long   0x13802ACA
data.set 0xA0114D18 %long   0x8F44059F
data.set 0xA0114D1C %long   0xF2B9046B
data.set 0xA0114D20 %long   0x1960887A
data.set 0xA0114D24 %long   0x878A332C
data.set 0xA0114D28 %long   0x07F48A07
data.set 0xA0114D2C %long   0xEA211935
data.set 0xA0114D30 %long   0x1225A9EA
data.set 0xA0114D34 %long   0x77266C16
data.set 0xA0114D38 %long   0x68C5D3AA
data.set 0xA0114D3C %long   0xAAECAA88
data.set 0xA0114D40 %long   0x14F3088A
data.set 0xA0114D44 %long   0x077E538C
data.set 0xA0114D48 %long   0x8D607D57
data.set 0xA0114D4C %long   0x4CFFB18E
data.set 0xA0114D50 %long   0xE12370A7
data.set 0xA0114D54 %long   0x2CFF367A
data.set 0xA0114D58 %long   0xD5A18344
data.set 0xA0114D5C %long   0xDD5FBEC5
data.set 0xA0114D60 %long   0x14032176
data.set 0xA0114D64 %long   0x2099B207
data.set 0xA0114D68 %long   0x06B297B8
data.set 0xA0114D6C %long   0x6AB571CB
data.set 0xA0114D70 %long   0xAE31E61A
data.set 0xA0114D74 %long   0xCD7CA8F6
data.set 0xA0114D78 %long   0x39C0D022
data.set 0xA0114D7C %long   0xF69C6E38
data.set 0xA0114D80 %long   0xE0A607E4
data.set 0xA0114D84 %long   0xFA332FF5
data.set 0xA0114D88 %long   0xCE61976D
data.set 0xA0114D8C %long   0x69D0C55F
data.set 0xA0114D90 %long   0x10224C3F
data.set 0xA0114D94 %long   0x6D748ABC
data.set 0xA0114D98 %long   0x71C00606
data.set 0xA0114D9C %long   0x6B773687
data.set 0xA0114DA0 %long   0xC77C5E28
data.set 0xA0114DA4 %long   0x9FE80361
data.set 0xA0114DA8 %long   0x978D8254
data.set 0xA0114DAC %long   0x5399F1BD
data.set 0xA0114DB0 %long   0x79DF4EB2
data.set 0xA0114DB4 %long   0x8718564A
data.set 0xA0114DB8 %long   0xA7E50EF5
data.set 0xA0114DBC %long   0x268DF149
data.set 0xA0114DC0 %long   0xD1807DE0
data.set 0xA0114DC4 %long   0x1016FC46
data.set 0xA0114DC8 %long   0x396778FB
data.set 0xA0114DCC %long   0x69E5694A
data.set 0xA0114DD0 %long   0x531A6398
data.set 0xA0114DD4 %long   0x50C68E3F
data.set 0xA0114DD8 %long   0xA4709EC5
data.set 0xA0114DDC %long   0x4F663E62
data.set 0xA0114DE0 %long   0xB14C4AA5
data.set 0xA0114DE4 %long   0x6A36F2FC
data.set 0xA0114DE8 %long   0x83E10119
data.set 0xA0114DEC %long   0x9CCCF0E9
data.set 0xA0114DF0 %long   0x2512FAB9
data.set 0xA0114DF4 %long   0x7BBAFB6B
data.set 0xA0114DF8 %long   0xB8C256A7
data.set 0xA0114DFC %long   0x9F4801EA
data.set 0xA0114E00 %long   0x5C25CE0E
data.set 0xA0114E04 %long   0x516F7F6E
data.set 0xA0114E08 %long   0x6CCC7E33
data.set 0xA0114E0C %long   0xF4D31C16
data.set 0xA0114E10 %long   0x81E59F33
data.set 0xA0114E14 %long   0x808574BA
data.set 0xA0114E18 %long   0xA633BDBC
data.set 0xA0114E1C %long   0xE3A42800
data.set 0xA0114E20 %long   0x7197E58D
data.set 0xA0114E24 %long   0xAC7EA938
data.set 0xA0114E28 %long   0xF4F6384D
data.set 0xA0114E2C %long   0xBD43BF6F
data.set 0xA0114E30 %long   0xDB86FE40
data.set 0xA0114E34 %long   0x6C1984AF
data.set 0xA0114E38 %long   0x1C33F12E
data.set 0xA0114E3C %long   0x09398D5A
data.set 0xA0114E40 %long   0x3663F952
data.set 0xA0114E44 %long   0x09D06487
data.set 0xA0114E48 %long   0xE24DF167
data.set 0xA0114E4C %long   0x41F3426B
data.set 0xA0114E50 %long   0x2AC1B7BD
data.set 0xA0114E54 %long   0xD0B1A29B
data.set 0xA0114E58 %long   0xD779661C
data.set 0xA0114E5C %long   0xB19B94CE
data.set 0xA0114E60 %long   0xF1E1488D
data.set 0xA0114E64 %long   0xEE500B99
data.set 0xA0114E68 %long   0xBEE98B82
data.set 0xA0114E6C %long   0xD9EF2959
data.set 0xA0114E70 %long   0xCC35AEDE
data.set 0xA0114E74 %long   0xA2FBAE73
data.set 0xA0114E78 %long   0x5048560D
data.set 0xA0114E7C %long   0xD15A892F
data.set 0xA0114E80 %long   0x8EF8022C
data.set 0xA0114E84 %long   0x78C98530
data.set 0xA0114E88 %long   0x06E16260
data.set 0xA0114E8C %long   0x555C184B
data.set 0xA0114E90 %long   0x0C25321C
data.set 0xA0114E94 %long   0xB2BB0792
data.set 0xA0114E98 %long   0xDDFE46B2
data.set 0xA0114E9C %long   0xA3430F08
data.set 0xA0114EA0 %long   0xF9AB3EC9
data.set 0xA0114EA4 %long   0x4C67DCDE
data.set 0xA0114EA8 %long   0x01388434
data.set 0xA0114EAC %long   0xFCC769C7
data.set 0xA0114EB0 %long   0xBEC077CE
data.set 0xA0114EB4 %long   0x09E2293F
data.set 0xA0114EB8 %long   0xCEF73F55
data.set 0xA0114EBC %long   0x3620C8B9
data.set 0xA0114EC0 %long   0x388A9495
data.set 0xA0114EC4 %long   0x22906791
data.set 0xA0114EC8 %long   0xE5A8CC7D
data.set 0xA0114ECC %long   0x04114E4D
data.set 0xA0114ED0 %long   0x52722581
data.set 0xA0114ED4 %long   0xF0732226
data.set 0xA0114ED8 %long   0x3F259409
data.set 0xA0114EDC %long   0xFAE7582A
data.set 0xA0114EE0 %long   0xBDACB33E
data.set 0xA0114EE4 %long   0x4F29A8F5
data.set 0xA0114EE8 %long   0x22A1B95C
data.set 0xA0114EEC %long   0xFFB65337
data.set 0xA0114EF0 %long   0xE026E2A0
data.set 0xA0114EF4 %long   0x079A8EE0
data.set 0xA0114EF8 %long   0x07BCFD5F
data.set 0xA0114EFC %long   0xEB5603F5
data.set 0xA0114F00 %long   0x832D62DA
data.set 0xA0114F04 %long   0x053052C6
data.set 0xA0114F08 %long   0xFB98E242
data.set 0xA0114F0C %long   0xD0C96A1C
data.set 0xA0114F10 %long   0x3A1369D1
data.set 0xA0114F14 %long   0x34F9781F
data.set 0xA0114F18 %long   0xFF8318B1
data.set 0xA0114F1C %long   0xE3AAA9B5
data.set 0xA0114F20 %long   0x76D89067
data.set 0xA0114F24 %long   0x3D448F37
data.set 0xA0114F28 %long   0x9EC437E0
data.set 0xA0114F2C %long   0xABDCA3EB
data.set 0xA0114F30 %long   0xF6F7EAA3
data.set 0xA0114F34 %long   0xE658CF9D
data.set 0xA0114F38 %long   0xC38FBAA7
data.set 0xA0114F3C %long   0x6E602E96
data.set 0xA0114F40 %long   0xD2024344
data.set 0xA0114F44 %long   0x3C6F90D0
data.set 0xA0114F48 %long   0xA703AEC6
data.set 0xA0114F4C %long   0xD911A23C
data.set 0xA0114F50 %long   0x7D1F6FF4
data.set 0xA0114F54 %long   0x742611B5
data.set 0xA0114F58 %long   0x98A088F8
data.set 0xA0114F5C %long   0x92117EEE
data.set 0xA0114F60 %long   0x5F37DEA1
data.set 0xA0114F64 %long   0x5548FB33
data.set 0xA0114F68 %long   0x15C586AE
data.set 0xA0114F6C %long   0x449608D2
data.set 0xA0114F70 %long   0x8E05D6E9
data.set 0xA0114F74 %long   0xFFA20475
data.set 0xA0114F78 %long   0x68189242
data.set 0xA0114F7C %long   0xFC00C3FB
data.set 0xA0114F80 %long   0xFA335863
data.set 0xA0114F84 %long   0x98700943
data.set 0xA0114F88 %long   0x83862E4D
data.set 0xA0114F8C %long   0x4D108FF1
data.set 0xA0114F90 %long   0x62231565
data.set 0xA0114F94 %long   0xD45534F3
data.set 0xA0114F98 %long   0x9DD72F30
data.set 0xA0114F9C %long   0x169563DC
data.set 0xA0114FA0 %long   0x5F66841F
data.set 0xA0114FA4 %long   0xFFA94897
data.set 0xA0114FA8 %long   0x30406B05
data.set 0xA0114FAC %long   0x3536DBF7
data.set 0xA0114FB0 %long   0x3ABBDDEA
data.set 0xA0114FB4 %long   0xF225A8AA
data.set 0xA0114FB8 %long   0x8B161ED2
data.set 0xA0114FBC %long   0x722252F5
data.set 0xA0114FC0 %long   0x1FFC30FD
data.set 0xA0114FC4 %long   0x8A91B415
data.set 0xA0114FC8 %long   0x318FB906
data.set 0xA0114FCC %long   0x6A8A9B20
data.set 0xA0114FD0 %long   0x425886B5
data.set 0xA0114FD4 %long   0xFC6D8B59
data.set 0xA0114FD8 %long   0xC286ADA1
data.set 0xA0114FDC %long   0x7FDDBB58
data.set 0xA0114FE0 %long   0x1DFEBB76
data.set 0xA0114FE4 %long   0xE4213852
data.set 0xA0114FE8 %long   0x29D574F0
data.set 0xA0114FEC %long   0xA8F6B26E
data.set 0xA0114FF0 %long   0xAD6F0509
data.set 0xA0114FF4 %long   0x2B322B5F
data.set 0xA0114FF8 %long   0x0E1C10D7
data.set 0xA0114FFC %long   0x8561CF0F
data.set 0xA0115000 %long   0x25D8D2D8
data.set 0xA0115004 %long   0x653F007E
data.set 0xA0115008 %long   0x7413DF2E
data.set 0xA011500C %long   0x2A6F8510
data.set 0xA0115010 %long   0xA8377549
data.set 0xA0115014 %long   0x23E0630A
data.set 0xA0115018 %long   0x84301F06
data.set 0xA011501C %long   0x6FF135D8
data.set 0xA0115020 %long   0xC2EC6031
data.set 0xA0115024 %long   0x92765152
data.set 0xA0115028 %long   0x5032CCE3
data.set 0xA011502C %long   0x8DA146EB
data.set 0xA0115030 %long   0x5C44DF5D
data.set 0xA0115034 %long   0xE362120B
data.set 0xA0115038 %long   0xB57F995A
data.set 0xA011503C %long   0xCE76D0C4
data.set 0xA0115040 %long   0x62622DA2
data.set 0xA0115044 %long   0x12C835F6
data.set 0xA0115048 %long   0x7EC5C464
data.set 0xA011504C %long   0xC5316A42
data.set 0xA0115050 %long   0xD145CEA3
data.set 0xA0115054 %long   0x7C64C50B
data.set 0xA0115058 %long   0xE1338AF1
data.set 0xA011505C %long   0xCB056449
data.set 0xA0115060 %long   0x00C9BD6A
data.set 0xA0115064 %long   0x61FF2A57
data.set 0xA0115068 %long   0x7497E49C
data.set 0xA011506C %long   0xDEF09DA6
data.set 0xA0115070 %long   0x0A924750
data.set 0xA0115074 %long   0x46699E94
data.set 0xA0115078 %long   0x74AB7DF0
data.set 0xA011507C %long   0xF8A6CCCB
data.set 0xA0115080 %long   0x0109C1E8
data.set 0xA0115084 %long   0x19E54FEB
data.set 0xA0115088 %long   0xB298D6B0
data.set 0xA011508C %long   0xCBF27076
data.set 0xA0115090 %long   0xFEEEB726
data.set 0xA0115094 %long   0xA0E9EDE3
data.set 0xA0115098 %long   0x3E59EB4B
data.set 0xA011509C %long   0x7B1A0BF5
data.set 0xA01150A0 %long   0xB0AF6130
data.set 0xA01150A4 %long   0x55B06BBB
data.set 0xA01150A8 %long   0xC965BC08
data.set 0xA01150AC %long   0x9CFDAB36
data.set 0xA01150B0 %long   0xF833A0DE
data.set 0xA01150B4 %long   0x438462E1
data.set 0xA01150B8 %long   0x6DFD3A11
data.set 0xA01150BC %long   0x225757F5
data.set 0xA01150C0 %long   0x3AD31692
data.set 0xA01150C4 %long   0xEE0F1708
data.set 0xA01150C8 %long   0x73CF1682
data.set 0xA01150CC %long   0x001E30A5
data.set 0xA01150D0 %long   0xC05F84AB
data.set 0xA01150D4 %long   0x509E5B61
data.set 0xA01150D8 %long   0x2AC5BAE0
data.set 0xA01150DC %long   0xE96B9EA8
data.set 0xA01150E0 %long   0x046EB28C
data.set 0xA01150E4 %long   0x3105D196
data.set 0xA01150E8 %long   0x6AB333CC
data.set 0xA01150EC %long   0x1844F588
data.set 0xA01150F0 %long   0xFA98E2CB
data.set 0xA01150F4 %long   0x25B72582
data.set 0xA01150F8 %long   0xA8ED682C
data.set 0xA01150FC %long   0xFDCF310F
data.set 0xA0115100 %long   0x08332AD0
data.set 0xA0115104 %long   0xFDF8A416
data.set 0xA0115108 %long   0x35C2FBEA
data.set 0xA011510C %long   0x9B26D531
data.set 0xA0115110 %long   0x6135A29B
data.set 0xA0115114 %long   0xDCBD6938
data.set 0xA0115118 %long   0x30B68E33
data.set 0xA011511C %long   0x5E448BEA
data.set 0xA0115120 %long   0xCFC39FB2
data.set 0xA0115124 %long   0xB04E5F1F
data.set 0xA0115128 %long   0xB4D5833E
data.set 0xA011512C %long   0xF2212E90
data.set 0xA0115130 %long   0x5D86185E
data.set 0xA0115134 %long   0x1239BE76
data.set 0xA0115138 %long   0x8D7FA72B
data.set 0xA011513C %long   0x1815A30B
data.set 0xA0115140 %long   0xC5D2EBF2
data.set 0xA0115144 %long   0x629CBE09
data.set 0xA0115148 %long   0xF95F3523
data.set 0xA011514C %long   0x612F74CA
data.set 0xA0115150 %long   0x6AF4FB3C
data.set 0xA0115154 %long   0x5093B71B
data.set 0xA0115158 %long   0x0B293332
data.set 0xA011515C %long   0x96602536
data.set 0xA0115160 %long   0xB1A77411
data.set 0xA0115164 %long   0xA1A20A0B
data.set 0xA0115168 %long   0xF5411309
data.set 0xA011516C %long   0x0130EEE3
data.set 0xA0115170 %long   0x0EDB696C
data.set 0xA0115174 %long   0x1E555023
data.set 0xA0115178 %long   0x76BACE08
data.set 0xA011517C %long   0xA3D39E1F
data.set 0xA0115180 %long   0x281E6368
data.set 0xA0115184 %long   0x9B6F1568
data.set 0xA0115188 %long   0x3FDCEAA3
data.set 0xA011518C %long   0x02F9448B
data.set 0xA0115190 %long   0xBE02375A
data.set 0xA0115194 %long   0x5D1151E5
data.set 0xA0115198 %long   0x42063E32
data.set 0xA011519C %long   0x29E6B66C
data.set 0xA01151A0 %long   0xC7654E65
data.set 0xA01151A4 %long   0x8423E830
data.set 0xA01151A8 %long   0xFD67E9E4
data.set 0xA01151AC %long   0xAFA5250C
data.set 0xA01151B0 %long   0x9F84ADCF
data.set 0xA01151B4 %long   0x0373C6FD
data.set 0xA01151B8 %long   0x25C1E9CF
data.set 0xA01151BC %long   0xCCAF585E
data.set 0xA01151C0 %long   0x5B06A453
data.set 0xA01151C4 %long   0x09B65600
data.set 0xA01151C8 %long   0xCF53E4B3
data.set 0xA01151CC %long   0xF5470E77
data.set 0xA01151D0 %long   0xC1F5EA2C
data.set 0xA01151D4 %long   0xE0EDC261
data.set 0xA01151D8 %long   0xCAF44E13
data.set 0xA01151DC %long   0x08637026
data.set 0xA01151E0 %long   0xB7AD1122
data.set 0xA01151E4 %long   0x48A38CEE
data.set 0xA01151E8 %long   0xF63203C4
data.set 0xA01151EC %long   0x31CA3673
data.set 0xA01151F0 %long   0xF40F09EE
data.set 0xA01151F4 %long   0xABC7B842
data.set 0xA01151F8 %long   0xE1072B86
data.set 0xA01151FC %long   0xD045C918
data.set 0xA0115200 %long   0xA9F28BCF
data.set 0xA0115204 %long   0x3CA6714B
data.set 0xA0115208 %long   0xC5E1ED6F
data.set 0xA011520C %long   0xAE4FA874
data.set 0xA0115210 %long   0x02979BEC
data.set 0xA0115214 %long   0xFE50CD88
data.set 0xA0115218 %long   0xD08C5D73
data.set 0xA011521C %long   0xFD6D6F29
data.set 0xA0115220 %long   0x033F1A78
data.set 0xA0115224 %long   0x9417C93B
data.set 0xA0115228 %long   0x8123104B
data.set 0xA011522C %long   0x4E58DA4C
data.set 0xA0115230 %long   0x02B148A6
data.set 0xA0115234 %long   0x1C417BDF
data.set 0xA0115238 %long   0xD43DE71A
data.set 0xA011523C %long   0x5D5201DA
data.set 0xA0115240 %long   0x168D289E
data.set 0xA0115244 %long   0x9B2AB793
data.set 0xA0115248 %long   0xE0E9ACD5
data.set 0xA011524C %long   0x9FDC4C0F
data.set 0xA0115250 %long   0x52F9B790
data.set 0xA0115254 %long   0xEF988705
data.set 0xA0115258 %long   0xE05184FA
data.set 0xA011525C %long   0x814B2896
data.set 0xA0115260 %long   0xDBB9F8FD
data.set 0xA0115264 %long   0x920EA3DC
data.set 0xA0115268 %long   0xB0FE1246
data.set 0xA011526C %long   0x70F69A4C
data.set 0xA0115270 %long   0xF13F1841
data.set 0xA0115274 %long   0x1357FF29
data.set 0xA0115278 %long   0x41A06406
data.set 0xA011527C %long   0x8D9D6EAF
data.set 0xA0115280 %long   0xF1767994
data.set 0xA0115284 %long   0x99AA4577
data.set 0xA0115288 %long   0xA2D58C6A
data.set 0xA011528C %long   0xF9CACED5
data.set 0xA0115290 %long   0x87D15100
data.set 0xA0115294 %long   0x1E889CC9
data.set 0xA0115298 %long   0x3A57F01E
data.set 0xA011529C %long   0x44387EC4
data.set 0xA01152A0 %long   0x5CEBBABE
data.set 0xA01152A4 %long   0xC30FD4B6
data.set 0xA01152A8 %long   0x0F20C6FB
data.set 0xA01152AC %long   0xBB52126A
data.set 0xA01152B0 %long   0xB678B62B
data.set 0xA01152B4 %long   0xED30D102
data.set 0xA01152B8 %long   0xC2E2AA92
data.set 0xA01152BC %long   0x6E701F8F
data.set 0xA01152C0 %long   0x8D2A6849
data.set 0xA01152C4 %long   0x3F5D591D
data.set 0xA01152C8 %long   0xB4B7596E
data.set 0xA01152CC %long   0xA3A05C3E
data.set 0xA01152D0 %long   0xDCA1D1B3
data.set 0xA01152D4 %long   0x0FE6A7A4
data.set 0xA01152D8 %long   0x213E9F42
data.set 0xA01152DC %long   0x063191A9
data.set 0xA01152E0 %long   0x5B88F315
data.set 0xA01152E4 %long   0x744284EA
data.set 0xA01152E8 %long   0x0E4E14F5
data.set 0xA01152EC %long   0xAB5741F6
data.set 0xA01152F0 %long   0x6E3B92BF
data.set 0xA01152F4 %long   0x1127EDEB
data.set 0xA01152F8 %long   0x467B6C3A
data.set 0xA01152FC %long   0xDEDE74ED
data.set 0xA0115300 %long   0x6A7AB914
data.set 0xA0115304 %long   0x2BA4DDE1
data.set 0xA0115308 %long   0xD227A3B3
data.set 0xA011530C %long   0xE8DD9153
data.set 0xA0115310 %long   0xF3313C06
data.set 0xA0115314 %long   0x35C95B8C
data.set 0xA0115318 %long   0x519EB3AB
data.set 0xA011531C %long   0x7B1DF950
data.set 0xA0115320 %long   0x5F4340F8
data.set 0xA0115324 %long   0xF4F04AAF
data.set 0xA0115328 %long   0xE0B07F94
data.set 0xA011532C %long   0xA0940EAF
data.set 0xA0115330 %long   0x03500FCB
data.set 0xA0115334 %long   0x80269019
data.set 0xA0115338 %long   0x7733A93A
data.set 0xA011533C %long   0x4D7FB14E
data.set 0xA0115340 %long   0xF877501A
data.set 0xA0115344 %long   0x07FB8A31
data.set 0xA0115348 %long   0x4972FBB7
data.set 0xA011534C %long   0x941259A3
data.set 0xA0115350 %long   0x35468E78
data.set 0xA0115354 %long   0xC1A72ED8
data.set 0xA0115358 %long   0x2426FC75
data.set 0xA011535C %long   0x3CC46F29
data.set 0xA0115360 %long   0x50D66E73
data.set 0xA0115364 %long   0x29E5C9D1
data.set 0xA0115368 %long   0xCFECF398
data.set 0xA011536C %long   0xCA57DA09
data.set 0xA0115370 %long   0xE3618491
data.set 0xA0115374 %long   0x47C37A62
data.set 0xA0115378 %long   0x91500860
data.set 0xA011537C %long   0x22517007
data.set 0xA0115380 %long   0x73579E84
data.set 0xA0115384 %long   0x8ECE9435
data.set 0xA0115388 %long   0xDB9C6A27
data.set 0xA011538C %long   0x085D02E9
data.set 0xA0115390 %long   0x367D40F8
data.set 0xA0115394 %long   0x4F6D026D
data.set 0xA0115398 %long   0xA7E85F74
data.set 0xA011539C %long   0xC1032230
data.set 0xA01153A0 %long   0xBC75B7A9
data.set 0xA01153A4 %long   0x602DF504
data.set 0xA01153A8 %long   0x1FC40529
data.set 0xA01153AC %long   0x220BDB2E
data.set 0xA01153B0 %long   0x964A94CB
data.set 0xA01153B4 %long   0xCC503D59
data.set 0xA01153B8 %long   0xCD9BD277
data.set 0xA01153BC %long   0x13CC23B9
data.set 0xA01153C0 %long   0xF651AB3E
data.set 0xA01153C4 %long   0xBD10BEC3
data.set 0xA01153C8 %long   0x74503169
data.set 0xA01153CC %long   0xAC50DFE7
data.set 0xA01153D0 %long   0x109A3079
data.set 0xA01153D4 %long   0x1CED9A10
data.set 0xA01153D8 %long   0xC257977C
data.set 0xA01153DC %long   0x46536D6A
data.set 0xA01153E0 %long   0xAA5D3E67
data.set 0xA01153E4 %long   0x57D0962C
data.set 0xA01153E8 %long   0xD397902E
data.set 0xA01153EC %long   0xEB03ED9E
data.set 0xA01153F0 %long   0x3EE93574
data.set 0xA01153F4 %long   0x2D4A5C9F
data.set 0xA01153F8 %long   0x7F831262
data.set 0xA01153FC %long   0xA1558F92
data.set 0xA0115400 %long   0x75F827FB
data.set 0xA0115404 %long   0x922A3F7F
data.set 0xA0115408 %long   0x0DEDB3BC
data.set 0xA011540C %long   0x4AD54B7C
data.set 0xA0115410 %long   0x6C3B8A58
data.set 0xA0115414 %long   0x6C76D2AE
data.set 0xA0115418 %long   0x46BA3E0A
data.set 0xA011541C %long   0x2C574532
data.set 0xA0115420 %long   0x8C9496FC
data.set 0xA0115424 %long   0xDE5E180C
data.set 0xA0115428 %long   0x99057D1B
data.set 0xA011542C %long   0xECEE3E68
data.set 0xA0115430 %long   0x9ED124D7
data.set 0xA0115434 %long   0x54C4EAB6
data.set 0xA0115438 %long   0x9F21FCF7
data.set 0xA011543C %long   0x76F25319
data.set 0xA0115440 %long   0x3433FB2D
data.set 0xA0115444 %long   0xCA08F855
data.set 0xA0115448 %long   0xC41F50EE
data.set 0xA011544C %long   0xFDE5AD5F
data.set 0xA0115450 %long   0xCD715E65
data.set 0xA0115454 %long   0x000EA7E1
data.set 0xA0115458 %long   0x7CA7FB82
data.set 0xA011545C %long   0x9519EDC1
data.set 0xA0115460 %long   0x6D959635
data.set 0xA0115464 %long   0x3780BC21
data.set 0xA0115468 %long   0xE7AD587A
data.set 0xA011546C %long   0x1AFA4074
data.set 0xA0115470 %long   0xF4F4DBB1
data.set 0xA0115474 %long   0x4727C909
data.set 0xA0115478 %long   0x8ECFE02A
data.set 0xA011547C %long   0x5A3E8C1F
data.set 0xA0115480 %long   0xB1AF2470
data.set 0xA0115484 %long   0x2BA6845D
data.set 0xA0115488 %long   0x84FD9FF4
data.set 0xA011548C %long   0x79FC62F7
data.set 0xA0115490 %long   0xA7E74649
data.set 0xA0115494 %long   0x53904FFB
data.set 0xA0115498 %long   0x287DA152
data.set 0xA011549C %long   0x5F3B246D
data.set 0xA01154A0 %long   0xED1858D8
data.set 0xA01154A4 %long   0xDE5DFBB2
data.set 0xA01154A8 %long   0x628C3E21
data.set 0xA01154AC %long   0x25ABF221
data.set 0xA01154B0 %long   0x1635EDF7
data.set 0xA01154B4 %long   0xA948609A
data.set 0xA01154B8 %long   0x6D8E8BA4
data.set 0xA01154BC %long   0xBB7CA5BE
data.set 0xA01154C0 %long   0xCAD03B0B
data.set 0xA01154C4 %long   0x18FE7122
data.set 0xA01154C8 %long   0xB2B072C5
data.set 0xA01154CC %long   0xE203E9F0
data.set 0xA01154D0 %long   0x47B7EE11
data.set 0xA01154D4 %long   0x188DB26A
data.set 0xA01154D8 %long   0x7ABE4F1D
data.set 0xA01154DC %long   0x18D87D30
data.set 0xA01154E0 %long   0x78015539
data.set 0xA01154E4 %long   0xA3D931EF
data.set 0xA01154E8 %long   0xDE4B5A34
data.set 0xA01154EC %long   0x4E65A9C4
data.set 0xA01154F0 %long   0x36E36335
data.set 0xA01154F4 %long   0x560B20E8
data.set 0xA01154F8 %long   0xFE566274
data.set 0xA01154FC %long   0x94FB42D4
data.set 0xA0115500 %long   0x07F16D0F
data.set 0xA0115504 %long   0x89F77CCC
data.set 0xA0115508 %long   0x699F09C3
data.set 0xA011550C %long   0x40AED0E8
data.set 0xA0115510 %long   0x33F93394
data.set 0xA0115514 %long   0x51FB6BC4
data.set 0xA0115518 %long   0xB93D41D1
data.set 0xA011551C %long   0x9BD11B73
data.set 0xA0115520 %long   0xAA4D7A14
data.set 0xA0115524 %long   0x14C37545
data.set 0xA0115528 %long   0x674D50BC
data.set 0xA011552C %long   0x9C045F77
data.set 0xA0115530 %long   0xC65874C1
data.set 0xA0115534 %long   0x55775C6C
data.set 0xA0115538 %long   0xEA82AA95
data.set 0xA011553C %long   0x9401113E
data.set 0xA0115540 %long   0xAA8DB13D
data.set 0xA0115544 %long   0x8D5CC740
data.set 0xA0115548 %long   0xB5A52BFA
data.set 0xA011554C %long   0xF47445AC
data.set 0xA0115550 %long   0x3C17DFEE
data.set 0xA0115554 %long   0x9A39E4EE
data.set 0xA0115558 %long   0x69DE87C6
data.set 0xA011555C %long   0x0E87C57B
data.set 0xA0115560 %long   0x037F968A
data.set 0xA0115564 %long   0x337AA3EF
data.set 0xA0115568 %long   0xF638B537
data.set 0xA011556C %long   0x0DBFEDB9
data.set 0xA0115570 %long   0x8D6C8C0E
data.set 0xA0115574 %long   0xCB047373
data.set 0xA0115578 %long   0xA307AE0B
data.set 0xA011557C %long   0x0FF070FF
data.set 0xA0115580 %long   0xAEABC84A
data.set 0xA0115584 %long   0xD167F441
data.set 0xA0115588 %long   0x2ED8FDFE
data.set 0xA011558C %long   0x44F040E8
data.set 0xA0115590 %long   0x5291E31C
data.set 0xA0115594 %long   0x1B15AA08
data.set 0xA0115598 %long   0xC8EB1C77
data.set 0xA011559C %long   0x579E5943
data.set 0xA01155A0 %long   0x568D8B8B
data.set 0xA01155A4 %long   0xD2033BCC
data.set 0xA01155A8 %long   0x8E1943CB
data.set 0xA01155AC %long   0x5CA27198
data.set 0xA01155B0 %long   0x22E341E7
data.set 0xA01155B4 %long   0x494CD495
data.set 0xA01155B8 %long   0xC9CC2757
data.set 0xA01155BC %long   0x8E80210A
data.set 0xA01155C0 %long   0x50DBE49C
data.set 0xA01155C4 %long   0xF0E0AC84
data.set 0xA01155C8 %long   0x13CC3DCD
data.set 0xA01155CC %long   0x8BBA3307
data.set 0xA01155D0 %long   0xFCE2FC93
data.set 0xA01155D4 %long   0x7D84A3F7
data.set 0xA01155D8 %long   0xDFA07771
data.set 0xA01155DC %long   0xC42571F7
data.set 0xA01155E0 %long   0xA9C8ACFE
data.set 0xA01155E4 %long   0x4C50C00F
data.set 0xA01155E8 %long   0x01751136
data.set 0xA01155EC %long   0x16621455
data.set 0xA01155F0 %long   0xFF24C8E5
data.set 0xA01155F4 %long   0x86A12ACA
data.set 0xA01155F8 %long   0xF85F31AF
data.set 0xA01155FC %long   0xC7EAE242
data.set 0xA0115600 %long   0x75A659B4
data.set 0xA0115604 %long   0xDDD9EB65
data.set 0xA0115608 %long   0x48557B9F
data.set 0xA011560C %long   0x26E73991
data.set 0xA0115610 %long   0x4088B93C
data.set 0xA0115614 %long   0x4B5F7DED
data.set 0xA0115618 %long   0x963D5A8E
data.set 0xA011561C %long   0x9846DD91
data.set 0xA0115620 %long   0xF5A50AE3
data.set 0xA0115624 %long   0x948FAAC0
data.set 0xA0115628 %long   0xAAEF82A7
data.set 0xA011562C %long   0x52CD0E15
data.set 0xA0115630 %long   0x741E6A66
data.set 0xA0115634 %long   0x8506E166
data.set 0xA0115638 %long   0x1331226C
data.set 0xA011563C %long   0xB4E4578B
data.set 0xA0115640 %long   0x3B75532A
data.set 0xA0115644 %long   0xBFD26564
data.set 0xA0115648 %long   0x9E1B536F
data.set 0xA011564C %long   0x29BB20B9
data.set 0xA0115650 %long   0xD925C305
data.set 0xA0115654 %long   0x85EA3A34
data.set 0xA0115658 %long   0xE1F56B6B
data.set 0xA011565C %long   0x6D795144
data.set 0xA0115660 %long   0x57BFB933
data.set 0xA0115664 %long   0x89EE240B
data.set 0xA0115668 %long   0x47F2A1DC
data.set 0xA011566C %long   0x26E9FCB5
data.set 0xA0115670 %long   0x597EB769
data.set 0xA0115674 %long   0x26F1CE62
data.set 0xA0115678 %long   0x6621440B
data.set 0xA011567C %long   0xB39E474F
data.set 0xA0115680 %long   0xA11C92FF
data.set 0xA0115684 %long   0xB60A9604
data.set 0xA0115688 %long   0xCFC02025
data.set 0xA011568C %long   0xE4688769
data.set 0xA0115690 %long   0xBE8270C6
data.set 0xA0115694 %long   0x20FB122C
data.set 0xA0115698 %long   0x7AA8DDAA
data.set 0xA011569C %long   0xE2F05ED5
data.set 0xA01156A0 %long   0x2B877E02
data.set 0xA01156A4 %long   0xA20B5C15
data.set 0xA01156A8 %long   0xE1719DAD
data.set 0xA01156AC %long   0x3D9A489B
data.set 0xA01156B0 %long   0x7CFF2E83
data.set 0xA01156B4 %long   0x6CBFFB17
data.set 0xA01156B8 %long   0xCAFF2CC4
data.set 0xA01156BC %long   0x2DF6F3CD
data.set 0xA01156C0 %long   0xD41C4CE9
data.set 0xA01156C4 %long   0xDF0894BB
data.set 0xA01156C8 %long   0x6D5AD75A
data.set 0xA01156CC %long   0xA7A274BB
data.set 0xA01156D0 %long   0x77301BFD
data.set 0xA01156D4 %long   0x91D704F2
data.set 0xA01156D8 %long   0x20170993
data.set 0xA01156DC %long   0xB4BF0480
data.set 0xA01156E0 %long   0xB60EC28A
data.set 0xA01156E4 %long   0xB2EAB807
data.set 0xA01156E8 %long   0xEF6D24A9
data.set 0xA01156EC %long   0x7BCCE4E5
data.set 0xA01156F0 %long   0x1B11302C
data.set 0xA01156F4 %long   0x8479CD28
data.set 0xA01156F8 %long   0x49AF9B85
data.set 0xA01156FC %long   0x2431D29A
data.set 0xA0115700 %long   0x9F81CE33
data.set 0xA0115704 %long   0x5EF6B581
data.set 0xA0115708 %long   0x24A8187B
data.set 0xA011570C %long   0xB4B0200F
data.set 0xA0115710 %long   0xBB31D620
data.set 0xA0115714 %long   0x0AABA3BB
data.set 0xA0115718 %long   0xB0D8EADA
data.set 0xA011571C %long   0x2729154F
data.set 0xA0115720 %long   0xBED9433A
data.set 0xA0115724 %long   0x9A9ABA73
data.set 0xA0115728 %long   0x80ABE2BF
data.set 0xA011572C %long   0x8B2E79FB
data.set 0xA0115730 %long   0x62A5724E
data.set 0xA0115734 %long   0x9A12B24D
data.set 0xA0115738 %long   0xCBD255A2
data.set 0xA011573C %long   0x3EC69FD9
data.set 0xA0115740 %long   0xC6EB168B
data.set 0xA0115744 %long   0xB0813FF5
data.set 0xA0115748 %long   0xE9B36522
data.set 0xA011574C %long   0x6F96DACF
data.set 0xA0115750 %long   0x809C31AB
data.set 0xA0115754 %long   0x0590FD39
data.set 0xA0115758 %long   0x146E78C5
data.set 0xA011575C %long   0x3C886AB0
data.set 0xA0115760 %long   0xB78C78C7
data.set 0xA0115764 %long   0x3FF27583
data.set 0xA0115768 %long   0xD8202EB3
data.set 0xA011576C %long   0x7B79AE5C
data.set 0xA0115770 %long   0xD1ED2DFC
data.set 0xA0115774 %long   0x9C2B66C7
data.set 0xA0115778 %long   0x8DD6EF2E
data.set 0xA011577C %long   0x1C195004
data.set 0xA0115780 %long   0xD956FEBB
data.set 0xA0115784 %long   0xD0C583EA
data.set 0xA0115788 %long   0x3ECFFBA6
data.set 0xA011578C %long   0xA5D44F9F
data.set 0xA0115790 %long   0x3CB109CE
data.set 0xA0115794 %long   0x23F0D90D
data.set 0xA0115798 %long   0x4FEBA6FE
data.set 0xA011579C %long   0x9F519FD0
data.set 0xA01157A0 %long   0x85E702E7
data.set 0xA01157A4 %long   0xEC11AF0E
data.set 0xA01157A8 %long   0xCE20426B
data.set 0xA01157AC %long   0xF4697E12
data.set 0xA01157B0 %long   0x175C2504
data.set 0xA01157B4 %long   0x02995FF8
data.set 0xA01157B8 %long   0x404B4C96
data.set 0xA01157BC %long   0xB7457123
data.set 0xA01157C0 %long   0xB6A97703
data.set 0xA01157C4 %long   0xE8E05D9D
data.set 0xA01157C8 %long   0x6498F3F8
data.set 0xA01157CC %long   0xA92E0F72
data.set 0xA01157D0 %long   0x09C11B21
data.set 0xA01157D4 %long   0xB52B7CAD
data.set 0xA01157D8 %long   0x7946B788
data.set 0xA01157DC %long   0x9AEF8933
data.set 0xA01157E0 %long   0xF96BD7F7
data.set 0xA01157E4 %long   0xD0E5CD71
data.set 0xA01157E8 %long   0x6F3642D1
data.set 0xA01157EC %long   0xB27F2F97
data.set 0xA01157F0 %long   0x42705BAE
data.set 0xA01157F4 %long   0xA548491A
data.set 0xA01157F8 %long   0x09E968C2
data.set 0xA01157FC %long   0x1312B893
data.set 0xA0115800 %long   0x10620F5F
data.set 0xA0115804 %long   0xE74DFA0D
data.set 0xA0115808 %long   0x332E40C1
data.set 0xA011580C %long   0xD63621B3
data.set 0xA0115810 %long   0xE5FC952E
data.set 0xA0115814 %long   0x03ED996D
data.set 0xA0115818 %long   0x5E0ECEC7
data.set 0xA011581C %long   0x8802786B
data.set 0xA0115820 %long   0x849B7A5F
data.set 0xA0115824 %long   0x3AE3CCE4
data.set 0xA0115828 %long   0x3F9445E8
data.set 0xA011582C %long   0xC24D98BE
data.set 0xA0115830 %long   0xE649A9F3
data.set 0xA0115834 %long   0x765FE9DD
data.set 0xA0115838 %long   0x8EBAB2CB
data.set 0xA011583C %long   0x5C3A0F37
data.set 0xA0115840 %long   0x70E9AAC7
data.set 0xA0115844 %long   0x3AFEAF65
data.set 0xA0115848 %long   0x4D3EAFEC
data.set 0xA011584C %long   0x6BA4DF97
data.set 0xA0115850 %long   0xE118D976
data.set 0xA0115854 %long   0xACDF6B4B
data.set 0xA0115858 %long   0x020DC350
data.set 0xA011585C %long   0xF1F99B8E
data.set 0xA0115860 %long   0x67312371
data.set 0xA0115864 %long   0xB6DFE2F4
data.set 0xA0115868 %long   0x8AD96E1F
data.set 0xA011586C %long   0x4E1503E6
data.set 0xA0115870 %long   0x4F90291D
data.set 0xA0115874 %long   0x966E86AD
data.set 0xA0115878 %long   0x6BE1D4B4
data.set 0xA011587C %long   0x26EABFEE
data.set 0xA0115880 %long   0x9A1A41BF
data.set 0xA0115884 %long   0x15A4644A
data.set 0xA0115888 %long   0x9F80CD48
data.set 0xA011588C %long   0x55F8F0E0
data.set 0xA0115890 %long   0xAE18C487
data.set 0xA0115894 %long   0x6ACAFADB
data.set 0xA0115898 %long   0x9C784340
data.set 0xA011589C %long   0x362FBD3E
data.set 0xA01158A0 %long   0xBB1F38F5
data.set 0xA01158A4 %long   0xA24C0869
data.set 0xA01158A8 %long   0xA1F23CAB
data.set 0xA01158AC %long   0x67BD62F9
data.set 0xA01158B0 %long   0x8AC1E986
data.set 0xA01158B4 %long   0xA1FBD46A
data.set 0xA01158B8 %long   0xB907CED6
data.set 0xA01158BC %long   0x19D06C66
data.set 0xA01158C0 %long   0xD6366016
data.set 0xA01158C4 %long   0x1323D4B9
data.set 0xA01158C8 %long   0x56A3A89A
data.set 0xA01158CC %long   0x9F1A48B8
data.set 0xA01158D0 %long   0x1D0178D7
data.set 0xA01158D4 %long   0xE15D3CDF
data.set 0xA01158D8 %long   0xA634F452
data.set 0xA01158DC %long   0x653E0DF8
data.set 0xA01158E0 %long   0x113DAABE
data.set 0xA01158E4 %long   0x4866DA44
data.set 0xA01158E8 %long   0x39B4E9AA
data.set 0xA01158EC %long   0x711278B9
data.set 0xA01158F0 %long   0x69568451
data.set 0xA01158F4 %long   0xE64AFF64
data.set 0xA01158F8 %long   0x2BADA34F
data.set 0xA01158FC %long   0xF6E10E40
data.set 0xA0115900 %long   0x895EBE23
data.set 0xA0115904 %long   0x27AF2921
data.set 0xA0115908 %long   0xD038BFC2
data.set 0xA011590C %long   0x7DF391B2
data.set 0xA0115910 %long   0x855BC249
data.set 0xA0115914 %long   0xAE4B66D6
data.set 0xA0115918 %long   0xB9349549
data.set 0xA011591C %long   0x1C57380D
data.set 0xA0115920 %long   0x8BF43511
data.set 0xA0115924 %long   0x80DE0484
data.set 0xA0115928 %long   0xB29262AD
data.set 0xA011592C %long   0x1669189A
data.set 0xA0115930 %long   0x55999933
data.set 0xA0115934 %long   0x946D2AD0
data.set 0xA0115938 %long   0x93F0B06F
data.set 0xA011593C %long   0x22CB13CD
data.set 0xA0115940 %long   0xDECA3D5C
data.set 0xA0115944 %long   0xB28301D4
data.set 0xA0115948 %long   0x9CFA4E4A
data.set 0xA011594C %long   0x64F3EB49
data.set 0xA0115950 %long   0xE88D0EA7
data.set 0xA0115954 %long   0x5F674645
data.set 0xA0115958 %long   0xB56CF465
data.set 0xA011595C %long   0x8FC3002C
data.set 0xA0115960 %long   0x3C011BE7
data.set 0xA0115964 %long   0x6B907D46
data.set 0xA0115968 %long   0x0017D60F
data.set 0xA011596C %long   0xB2945694
data.set 0xA0115970 %long   0xEE05747D
data.set 0xA0115974 %long   0xE5DE96B5
data.set 0xA0115978 %long   0x99C5F4ED
data.set 0xA011597C %long   0x9728F39E
data.set 0xA0115980 %long   0xA592D854
data.set 0xA0115984 %long   0xF2374D63
data.set 0xA0115988 %long   0x561B8036
data.set 0xA011598C %long   0x82C01005
data.set 0xA0115990 %long   0xDF541FA8
data.set 0xA0115994 %long   0x92E5FCD0
data.set 0xA0115998 %long   0x0589D8B1
data.set 0xA011599C %long   0x3BADD22D
data.set 0xA01159A0 %long   0x5CA350CD
data.set 0xA01159A4 %long   0x908FD6A8
data.set 0xA01159A8 %long   0xCBFF4706
data.set 0xA01159AC %long   0x1C1EE932
data.set 0xA01159B0 %long   0x35164236
data.set 0xA01159B4 %long   0xD5F724DF
data.set 0xA01159B8 %long   0x041077DD
data.set 0xA01159BC %long   0x7CEDBD48
data.set 0xA01159C0 %long   0x2AE8A57F
data.set 0xA01159C4 %long   0x517D457B
data.set 0xA01159C8 %long   0xBC3FA7B5
data.set 0xA01159CC %long   0xB5326D46
data.set 0xA01159D0 %long   0x23A24D5C
data.set 0xA01159D4 %long   0xA66E9429
data.set 0xA01159D8 %long   0xDD33DE71
data.set 0xA01159DC %long   0x9FD3920F
data.set 0xA01159E0 %long   0xE42CEEB0
data.set 0xA01159E4 %long   0x69042DCB
data.set 0xA01159E8 %long   0x1A91797B
data.set 0xA01159EC %long   0x63F372C1
data.set 0xA01159F0 %long   0xF44D5EFE
data.set 0xA01159F4 %long   0x11C68344
data.set 0xA01159F8 %long   0x827C657B
data.set 0xA01159FC %long   0x4ADE8796
data.set 0xA0115A00 %long   0xF4BC9ADC
data.set 0xA0115A04 %long   0xF7256AD4
data.set 0xA0115A08 %long   0x60CE9EA4
data.set 0xA0115A0C %long   0x83CD9ADB
data.set 0xA0115A10 %long   0x7477AC67
data.set 0xA0115A14 %long   0x9241D176
data.set 0xA0115A18 %long   0xEACEBE61
data.set 0xA0115A1C %long   0x8E5BEF30
data.set 0xA0115A20 %long   0x2477B4F1
data.set 0xA0115A24 %long   0x2655B4E7
data.set 0xA0115A28 %long   0x43F54067
data.set 0xA0115A2C %long   0x2007E380
data.set 0xA0115A30 %long   0x4B7E87ED
data.set 0xA0115A34 %long   0x5FF1E85B
data.set 0xA0115A38 %long   0x8C5FF21C
data.set 0xA0115A3C %long   0xF52E39A5
data.set 0xA0115A40 %long   0x1CBDE8C7
data.set 0xA0115A44 %long   0xE0CEB1B3
data.set 0xA0115A48 %long   0x0A4365AB
data.set 0xA0115A4C %long   0x8F123936
data.set 0xA0115A50 %long   0xB15A131E
data.set 0xA0115A54 %long   0x05FCBAED
data.set 0xA0115A58 %long   0x50A5ABCC
data.set 0xA0115A5C %long   0x625AE4AE
data.set 0xA0115A60 %long   0xC2C9243A
data.set 0xA0115A64 %long   0x19C30EF9
data.set 0xA0115A68 %long   0x599E7CD9
data.set 0xA0115A6C %long   0x9AD3A4CA
data.set 0xA0115A70 %long   0x96C5867A
data.set 0xA0115A74 %long   0x2E3CA342
data.set 0xA0115A78 %long   0x91B63AD9
data.set 0xA0115A7C %long   0xCC0AC031
data.set 0xA0115A80 %long   0x376235E2
data.set 0xA0115A84 %long   0xEF051532
data.set 0xA0115A88 %long   0xAA7E4640
data.set 0xA0115A8C %long   0x42B62519
data.set 0xA0115A90 %long   0x1E57A329
data.set 0xA0115A94 %long   0x783BAF78
data.set 0xA0115A98 %long   0x78FAFF2E
data.set 0xA0115A9C %long   0x4E5A847F
data.set 0xA0115AA0 %long   0x8BB3BC1E
data.set 0xA0115AA4 %long   0x4BE4C9FB
data.set 0xA0115AA8 %long   0x7DE00164
data.set 0xA0115AAC %long   0x28A6A758
data.set 0xA0115AB0 %long   0x994A1EAE
data.set 0xA0115AB4 %long   0xF04CD7F4
data.set 0xA0115AB8 %long   0x99EAF117
data.set 0xA0115ABC %long   0xE251BBFC
data.set 0xA0115AC0 %long   0x9A3064C6
data.set 0xA0115AC4 %long   0xAF9FFA8C
data.set 0xA0115AC8 %long   0x9A62EC4B
data.set 0xA0115ACC %long   0x41C11BBA
data.set 0xA0115AD0 %long   0x0EFCD9D4
data.set 0xA0115AD4 %long   0x9A04C689
data.set 0xA0115AD8 %long   0xFD898BF9
data.set 0xA0115ADC %long   0x9FA2F368
data.set 0xA0115AE0 %long   0x858E41B8
data.set 0xA0115AE4 %long   0x4CA2C12C
data.set 0xA0115AE8 %long   0x4464990F
data.set 0xA0115AEC %long   0x02D1B2E4
data.set 0xA0115AF0 %long   0x6A90C102
data.set 0xA0115AF4 %long   0xF69ABE57
data.set 0xA0115AF8 %long   0x9DF6193D
data.set 0xA0115AFC %long   0xAB8D2065
data.set 0xA0115B00 %long   0x2D1ADBD4
data.set 0xA0115B04 %long   0x8B09956E
data.set 0xA0115B08 %long   0xDB634E4F
data.set 0xA0115B0C %long   0x2B4DA6BE
data.set 0xA0115B10 %long   0x5073CB57
data.set 0xA0115B14 %long   0x6B3B5CFE
data.set 0xA0115B18 %long   0x3E9A3660
data.set 0xA0115B1C %long   0x1780787F
data.set 0xA0115B20 %long   0x4DB5B785
data.set 0xA0115B24 %long   0xC9BBDD76
data.set 0xA0115B28 %long   0x63D78CF3
data.set 0xA0115B2C %long   0x9BEB1390
data.set 0xA0115B30 %long   0x3A93D3A5
data.set 0xA0115B34 %long   0x3A58D274
data.set 0xA0115B38 %long   0x34E48CA6
data.set 0xA0115B3C %long   0x30DFEC22
data.set 0xA0115B40 %long   0xE25AC735
data.set 0xA0115B44 %long   0x860D4D79
data.set 0xA0115B48 %long   0x90CE9769
data.set 0xA0115B4C %long   0xAA1DDE17
data.set 0xA0115B50 %long   0xB745AFAB
data.set 0xA0115B54 %long   0x436CE22F
data.set 0xA0115B58 %long   0xB42FC849
data.set 0xA0115B5C %long   0x6F570B27
data.set 0xA0115B60 %long   0xC6CD0B11
data.set 0xA0115B64 %long   0x92CB3AD4
data.set 0xA0115B68 %long   0x19F048F1
data.set 0xA0115B6C %long   0x2EC88A52
data.set 0xA0115B70 %long   0xD885870D
data.set 0xA0115B74 %long   0xE53893C1
data.set 0xA0115B78 %long   0x44FF8F34
data.set 0xA0115B7C %long   0x5CF9C52F
data.set 0xA0115B80 %long   0x1B20EF64
data.set 0xA0115B84 %long   0x911ED8C6
data.set 0xA0115B88 %long   0xDD75A1AC
data.set 0xA0115B8C %long   0x56D9D2CF
data.set 0xA0115B90 %long   0xB9E5DAF0
data.set 0xA0115B94 %long   0x21A15B62
data.set 0xA0115B98 %long   0x5F1E412E
data.set 0xA0115B9C %long   0x1664F644
data.set 0xA0115BA0 %long   0xC5CEB9B7
data.set 0xA0115BA4 %long   0xFFD7CB10
data.set 0xA0115BA8 %long   0x586D4270
data.set 0xA0115BAC %long   0xCAE99DC5
data.set 0xA0115BB0 %long   0xFA46DD15
data.set 0xA0115BB4 %long   0xEBBB774D
data.set 0xA0115BB8 %long   0xB63DD87A
data.set 0xA0115BBC %long   0xBE32BD3E
data.set 0xA0115BC0 %long   0x9119D0F8
data.set 0xA0115BC4 %long   0x21C88366
data.set 0xA0115BC8 %long   0xABB6070E
data.set 0xA0115BCC %long   0x135337DB
data.set 0xA0115BD0 %long   0x9CBD5528
data.set 0xA0115BD4 %long   0xA11BA7DE
data.set 0xA0115BD8 %long   0xDD60DF5C
data.set 0xA0115BDC %long   0x6A59E534
data.set 0xA0115BE0 %long   0xDCB97771
data.set 0xA0115BE4 %long   0x2E19A2B4
data.set 0xA0115BE8 %long   0x7C0A072F
data.set 0xA0115BEC %long   0x29DB783E
data.set 0xA0115BF0 %long   0x673ACE9E
data.set 0xA0115BF4 %long   0x38310539
data.set 0xA0115BF8 %long   0x781DF0E3
data.set 0xA0115BFC %long   0x9D1B02F7
data.set 0xA0115C00 %long   0x832524BB
data.set 0xA0115C04 %long   0x56661461
data.set 0xA0115C08 %long   0xE51E4DA5
data.set 0xA0115C0C %long   0x2E25DEDE
data.set 0xA0115C10 %long   0xB006F445
data.set 0xA0115C14 %long   0x6C42886B
data.set 0xA0115C18 %long   0xD41EEF2D
data.set 0xA0115C1C %long   0x245B89CB
data.set 0xA0115C20 %long   0x12DA088C
data.set 0xA0115C24 %long   0x303B74B4
data.set 0xA0115C28 %long   0x7F59112B
data.set 0xA0115C2C %long   0xC5ACB338
data.set 0xA0115C30 %long   0xDF35E663
data.set 0xA0115C34 %long   0xCFEB2CF0
data.set 0xA0115C38 %long   0x17F5B24E
data.set 0xA0115C3C %long   0xEB500FBE
data.set 0xA0115C40 %long   0xADC2A721
data.set 0xA0115C44 %long   0x3496E9B1
data.set 0xA0115C48 %long   0xBF264F12
data.set 0xA0115C4C %long   0x105309E8
data.set 0xA0115C50 %long   0x0E330C74
data.set 0xA0115C54 %long   0xCBC1AD37
data.set 0xA0115C58 %long   0x08806EBC
data.set 0xA0115C5C %long   0x1442845D
data.set 0xA0115C60 %long   0xA1B3DC3F
data.set 0xA0115C64 %long   0x50119FDA
data.set 0xA0115C68 %long   0x0298AF3A
data.set 0xA0115C6C %long   0xEFEE7E6A
data.set 0xA0115C70 %long   0xF35C68BE
data.set 0xA0115C74 %long   0x5F4DDB61
data.set 0xA0115C78 %long   0x65F2FB35
data.set 0xA0115C7C %long   0x4146B58B
data.set 0xA0115C80 %long   0x9CBE7167
data.set 0xA0115C84 %long   0x7E889DB2
data.set 0xA0115C88 %long   0x98843136
data.set 0xA0115C8C %long   0x19ED35DC
data.set 0xA0115C90 %long   0xC5944226
data.set 0xA0115C94 %long   0xBA9688FA
data.set 0xA0115C98 %long   0xC049F0AF
data.set 0xA0115C9C %long   0xD747A889
data.set 0xA0115CA0 %long   0x0272BA22
data.set 0xA0115CA4 %long   0x621D599A
data.set 0xA0115CA8 %long   0x9D15ACC7
data.set 0xA0115CAC %long   0x99A66D30
data.set 0xA0115CB0 %long   0x427A173A
data.set 0xA0115CB4 %long   0xBD879237
data.set 0xA0115CB8 %long   0xD671D078
data.set 0xA0115CBC %long   0x76523292
data.set 0xA0115CC0 %long   0xE9FD803F
data.set 0xA0115CC4 %long   0x982F0057
data.set 0xA0115CC8 %long   0xFB0EAA64
data.set 0xA0115CCC %long   0xB7ECA032
data.set 0xA0115CD0 %long   0xA4AA614C
data.set 0xA0115CD4 %long   0x36672B56
data.set 0xA0115CD8 %long   0x622459DB
data.set 0xA0115CDC %long   0x12780907
data.set 0xA0115CE0 %long   0x4478A5C8
data.set 0xA0115CE4 %long   0xEB488122
data.set 0xA0115CE8 %long   0x7254F584
data.set 0xA0115CEC %long   0x6045162F
data.set 0xA0115CF0 %long   0x632A271E
data.set 0xA0115CF4 %long   0xE024CFA8
data.set 0xA0115CF8 %long   0x03EC2677
data.set 0xA0115CFC %long   0x59600B06
data.set 0xA0115D00 %long   0x0E17DD80
data.set 0xA0115D04 %long   0xC415F0C5
data.set 0xA0115D08 %long   0x5B434F88
data.set 0xA0115D0C %long   0x06D6E42C
data.set 0xA0115D10 %long   0xE618DE2D
data.set 0xA0115D14 %long   0x19C9322B
data.set 0xA0115D18 %long   0x2A29F3CF
data.set 0xA0115D1C %long   0x6CEEA508
data.set 0xA0115D20 %long   0x32D59B59
data.set 0xA0115D24 %long   0xC77A8297
data.set 0xA0115D28 %long   0xCB9A9044
data.set 0xA0115D2C %long   0x08C4DCC0
data.set 0xA0115D30 %long   0x53B31303
data.set 0xA0115D34 %long   0x205D5D0B
data.set 0xA0115D38 %long   0xA911E443
data.set 0xA0115D3C %long   0xED6EB38F
data.set 0xA0115D40 %long   0x08B2795C
data.set 0xA0115D44 %long   0xEC6E9B9E
data.set 0xA0115D48 %long   0x3098D624
data.set 0xA0115D4C %long   0x7C5A49F5
data.set 0xA0115D50 %long   0xA45D37EF
data.set 0xA0115D54 %long   0x8B480D1F
data.set 0xA0115D58 %long   0x6E8AE15C
data.set 0xA0115D5C %long   0x9AA480A8
data.set 0xA0115D60 %long   0x8F89B238
data.set 0xA0115D64 %long   0x1C06D561
data.set 0xA0115D68 %long   0x02821950
data.set 0xA0115D6C %long   0xD0EA98FD
data.set 0xA0115D70 %long   0xD0F11357
data.set 0xA0115D74 %long   0xD45A04E7
data.set 0xA0115D78 %long   0x4644DAEC
data.set 0xA0115D7C %long   0x8B8569DA
data.set 0xA0115D80 %long   0x1E7029D8
data.set 0xA0115D84 %long   0xF92F8EB0
data.set 0xA0115D88 %long   0xEE361B46
data.set 0xA0115D8C %long   0xDBA8A604
data.set 0xA0115D90 %long   0x042AAE41
data.set 0xA0115D94 %long   0x40449D75
data.set 0xA0115D98 %long   0x46B2F593
data.set 0xA0115D9C %long   0xA5451167
data.set 0xA0115DA0 %long   0xE3EC6565
data.set 0xA0115DA4 %long   0x905021AF
data.set 0xA0115DA8 %long   0xCA0CE0D6
data.set 0xA0115DAC %long   0x4AD4B99C
data.set 0xA0115DB0 %long   0x4B97F8CD
data.set 0xA0115DB4 %long   0x8AEBCCD4
data.set 0xA0115DB8 %long   0x0DBB5CA3
data.set 0xA0115DBC %long   0x4AE39A5F
data.set 0xA0115DC0 %long   0xCA65D1B1
data.set 0xA0115DC4 %long   0xEADD6B98
data.set 0xA0115DC8 %long   0x30371A79
data.set 0xA0115DCC %long   0xE1BF86AD
data.set 0xA0115DD0 %long   0xECB2D466
data.set 0xA0115DD4 %long   0x9459F327
data.set 0xA0115DD8 %long   0xF5353BC5
data.set 0xA0115DDC %long   0x08F7CA39
data.set 0xA0115DE0 %long   0xE60BCC6B
data.set 0xA0115DE4 %long   0x3F47B7C1
data.set 0xA0115DE8 %long   0x8047179B
data.set 0xA0115DEC %long   0x21014FA7
data.set 0xA0115DF0 %long   0xE7D4BA63
data.set 0xA0115DF4 %long   0xD4A78557
data.set 0xA0115DF8 %long   0xF9EA5931
data.set 0xA0115DFC %long   0xAAFA86B0
data.set 0xA0115E00 %long   0xCFB5F265
data.set 0xA0115E04 %long   0xB57A1800
data.set 0xA0115E08 %long   0x3740EF06
data.set 0xA0115E0C %long   0xE34E3008
data.set 0xA0115E10 %long   0x7DDB6139
data.set 0xA0115E14 %long   0xBEFE0915
data.set 0xA0115E18 %long   0xB1B50533
data.set 0xA0115E1C %long   0xB1AA33DD
data.set 0xA0115E20 %long   0xFA17F85B
data.set 0xA0115E24 %long   0x17B11FA6
data.set 0xA0115E28 %long   0x04AA2A55
data.set 0xA0115E2C %long   0x21E98410
data.set 0xA0115E30 %long   0x465CFE61
data.set 0xA0115E34 %long   0xF5F097F5
data.set 0xA0115E38 %long   0x6B89FBF4
data.set 0xA0115E3C %long   0x58CFC5FE
data.set 0xA0115E40 %long   0xC293BF7F
data.set 0xA0115E44 %long   0xC707E60B
data.set 0xA0115E48 %long   0x927896EC
data.set 0xA0115E4C %long   0xBAB1AB31
data.set 0xA0115E50 %long   0xDBE32C6C
data.set 0xA0115E54 %long   0x9D004909
data.set 0xA0115E58 %long   0xF836B232
data.set 0xA0115E5C %long   0xAEC02E76
data.set 0xA0115E60 %long   0x12B54487
data.set 0xA0115E64 %long   0xB272D174
data.set 0xA0115E68 %long   0xB0C91073
data.set 0xA0115E6C %long   0x5BC6287B
data.set 0xA0115E70 %long   0xF84B0C61
data.set 0xA0115E74 %long   0xBD70D0CC
data.set 0xA0115E78 %long   0xEE515D0C
data.set 0xA0115E7C %long   0x51C37256
data.set 0xA0115E80 %long   0x3149E194
data.set 0xA0115E84 %long   0xF34F8E7C
data.set 0xA0115E88 %long   0xF048273A
data.set 0xA0115E8C %long   0x8CCAE024
data.set 0xA0115E90 %long   0xA54A5C1D
data.set 0xA0115E94 %long   0x74AA153C
data.set 0xA0115E98 %long   0x996A1E73
data.set 0xA0115E9C %long   0xD027FC07
data.set 0xA0115EA0 %long   0x7E3EF279
data.set 0xA0115EA4 %long   0xE36AE028
data.set 0xA0115EA8 %long   0xD81408D1
data.set 0xA0115EAC %long   0xD553683E
data.set 0xA0115EB0 %long   0xEAF88C75
data.set 0xA0115EB4 %long   0xFD36FE43
data.set 0xA0115EB8 %long   0xA32AB6B5
data.set 0xA0115EBC %long   0xB8C4A30D
data.set 0xA0115EC0 %long   0x9B7DFC3B
data.set 0xA0115EC4 %long   0xA76CAB3F
data.set 0xA0115EC8 %long   0xB9145946
data.set 0xA0115ECC %long   0x90929BF5
data.set 0xA0115ED0 %long   0x2A6BB3E4
data.set 0xA0115ED4 %long   0xFAE1B091
data.set 0xA0115ED8 %long   0xCD800A31
data.set 0xA0115EDC %long   0xAB3DD95C
data.set 0xA0115EE0 %long   0x1CB37249
data.set 0xA0115EE4 %long   0xC74119EC
data.set 0xA0115EE8 %long   0x9E910D16
data.set 0xA0115EEC %long   0xBF30C58A
data.set 0xA0115EF0 %long   0xC5A5CAC7
data.set 0xA0115EF4 %long   0x3F59955E
data.set 0xA0115EF8 %long   0x2864B891
data.set 0xA0115EFC %long   0x1A6A89EC
data.set 0xA0115F00 %long   0x1AC6148B
data.set 0xA0115F04 %long   0x7E1EDD37
data.set 0xA0115F08 %long   0x6D195A43
data.set 0xA0115F0C %long   0xF6AAAAD5
data.set 0xA0115F10 %long   0x73867D99
data.set 0xA0115F14 %long   0xC3AA4478
data.set 0xA0115F18 %long   0xBCDC7F86
data.set 0xA0115F1C %long   0xDDB5804A
data.set 0xA0115F20 %long   0xADED51CB
data.set 0xA0115F24 %long   0x5E17CA0D
data.set 0xA0115F28 %long   0xF8EC5568
data.set 0xA0115F2C %long   0xF611E4C8
data.set 0xA0115F30 %long   0xBC8CB101
data.set 0xA0115F34 %long   0x84839108
data.set 0xA0115F38 %long   0x501EB104
data.set 0xA0115F3C %long   0x8469C56A
data.set 0xA0115F40 %long   0x4756D598
data.set 0xA0115F44 %long   0xE788447B
data.set 0xA0115F48 %long   0x7E9CB8AF
data.set 0xA0115F4C %long   0x42D4F484
data.set 0xA0115F50 %long   0xA9945BD2
data.set 0xA0115F54 %long   0x94DA070E
data.set 0xA0115F58 %long   0xA67BB774
data.set 0xA0115F5C %long   0x15EC9115
data.set 0xA0115F60 %long   0x15ABF6C0
data.set 0xA0115F64 %long   0x49A174D3
data.set 0xA0115F68 %long   0x9DDD49C0
data.set 0xA0115F6C %long   0xD18084E2
data.set 0xA0115F70 %long   0xC424DB63
data.set 0xA0115F74 %long   0x8FCD0449
data.set 0xA0115F78 %long   0xD74C04E1
data.set 0xA0115F7C %long   0x809CFE6E
data.set 0xA0115F80 %long   0xF1B929F8
data.set 0xA0115F84 %long   0xBA9E5120
data.set 0xA0115F88 %long   0xFB22A055
data.set 0xA0115F8C %long   0xD49F3CC9
data.set 0xA0115F90 %long   0x4550E84C
data.set 0xA0115F94 %long   0xBFA46740
data.set 0xA0115F98 %long   0xBCB82C94
data.set 0xA0115F9C %long   0x638A2E9E
data.set 0xA0115FA0 %long   0x9FD62529
data.set 0xA0115FA4 %long   0xC36E9E20
data.set 0xA0115FA8 %long   0x479CED0F
data.set 0xA0115FAC %long   0x8C8C3E58
data.set 0xA0115FB0 %long   0x4D56143B
data.set 0xA0115FB4 %long   0xC5B6307B
data.set 0xA0115FB8 %long   0xE3FE77F0
data.set 0xA0115FBC %long   0x4EEE1201
data.set 0xA0115FC0 %long   0xA8EFAB2D
data.set 0xA0115FC4 %long   0x601F4EF2
data.set 0xA0115FC8 %long   0x5586071F
data.set 0xA0115FCC %long   0xFA5FC042
data.set 0xA0115FD0 %long   0xD57951C3
data.set 0xA0115FD4 %long   0x351E653E
data.set 0xA0115FD8 %long   0xC08FB689
data.set 0xA0115FDC %long   0xF861F223
data.set 0xA0115FE0 %long   0xD4F349D5
data.set 0xA0115FE4 %long   0x2EA421EF
data.set 0xA0115FE8 %long   0x0F86757D
data.set 0xA0115FEC %long   0xDC21338A
data.set 0xA0115FF0 %long   0x4F9C1925
data.set 0xA0115FF4 %long   0x6F27AFEA
data.set 0xA0115FF8 %long   0xC6CC2C62
data.set 0xA0115FFC %long   0xF5A81F0E
data.set 0xA0116000 %long   0xEC71BB2B
data.set 0xA0116004 %long   0xAB2A6873
data.set 0xA0116008 %long   0x6E29183F
data.set 0xA011600C %long   0x3B10C63B
data.set 0xA0116010 %long   0xB7C38998
data.set 0xA0116014 %long   0x9FD85CC8
data.set 0xA0116018 %long   0x5B3B2172
data.set 0xA011601C %long   0xC53F1D87
data.set 0xA0116020 %long   0x0E0F9469
data.set 0xA0116024 %long   0x89019CDF
data.set 0xA0116028 %long   0x2D47A231
data.set 0xA011602C %long   0x70D496A6
data.set 0xA0116030 %long   0xC8AE92D4
data.set 0xA0116034 %long   0x3E96F442
data.set 0xA0116038 %long   0xC19AF898
data.set 0xA011603C %long   0xA3267D34
data.set 0xA0116040 %long   0x5389EC29
data.set 0xA0116044 %long   0xB72BF28E
data.set 0xA0116048 %long   0x0032D89F
data.set 0xA011604C %long   0x6D65C148
data.set 0xA0116050 %long   0x6B837175
data.set 0xA0116054 %long   0xD7E7B5BB
data.set 0xA0116058 %long   0xED48BABE
data.set 0xA011605C %long   0x2F66D3AE
data.set 0xA0116060 %long   0x23B69B65
data.set 0xA0116064 %long   0x10CE82AA
data.set 0xA0116068 %long   0x43B88D3D
data.set 0xA011606C %long   0xBD9278C3
data.set 0xA0116070 %long   0xB49DAAEC
data.set 0xA0116074 %long   0xC3276AD0
data.set 0xA0116078 %long   0xEFF9D9E9
data.set 0xA011607C %long   0x94608510
data.set 0xA0116080 %long   0x05C872F3
data.set 0xA0116084 %long   0x0898AB38
data.set 0xA0116088 %long   0x56F6330B
data.set 0xA011608C %long   0xC31D28EF
data.set 0xA0116090 %long   0xFD5B490A
data.set 0xA0116094 %long   0x31C36535
data.set 0xA0116098 %long   0x409D9B2C
data.set 0xA011609C %long   0x06F60DA6
data.set 0xA01160A0 %long   0xC2F9B69F
data.set 0xA01160A4 %long   0xDCD308F3
data.set 0xA01160A8 %long   0x9FE71E8E
data.set 0xA01160AC %long   0x8802C48E
data.set 0xA01160B0 %long   0xD942A115
data.set 0xA01160B4 %long   0x3FC64D50
data.set 0xA01160B8 %long   0xAAB19693
data.set 0xA01160BC %long   0x8BA9F225
data.set 0xA01160C0 %long   0x1D9B6EBF
data.set 0xA01160C4 %long   0x9FD2E397
data.set 0xA01160C8 %long   0xFA976B88
data.set 0xA01160CC %long   0x314A8364
data.set 0xA01160D0 %long   0x3007EEA5
data.set 0xA01160D4 %long   0x5B168856
data.set 0xA01160D8 %long   0x4FAD6E4F
data.set 0xA01160DC %long   0x69571974
data.set 0xA01160E0 %long   0x2EDA79CF
data.set 0xA01160E4 %long   0x981E7F95
data.set 0xA01160E8 %long   0x32F52026
data.set 0xA01160EC %long   0x49BD840A
data.set 0xA01160F0 %long   0x0B91D303
data.set 0xA01160F4 %long   0xB2BC7C2B
data.set 0xA01160F8 %long   0xD4AF8D96
data.set 0xA01160FC %long   0xC7085BB2
data.set 0xA0116100 %long   0x6699DCAC
data.set 0xA0116104 %long   0xE7530A3C
data.set 0xA0116108 %long   0xF8E1ACFC
data.set 0xA011610C %long   0xA0A13DD6
data.set 0xA0116110 %long   0xBB153D74
data.set 0xA0116114 %long   0x7F9CFFED
data.set 0xA0116118 %long   0xAE3CE6EF
data.set 0xA011611C %long   0xDA771930
data.set 0xA0116120 %long   0xCFEC5A8C
data.set 0xA0116124 %long   0x5FD84A5B
data.set 0xA0116128 %long   0xFF78B650
data.set 0xA011612C %long   0x9574FCC0
data.set 0xA0116130 %long   0x0869D8FA
data.set 0xA0116134 %long   0x8071B6D1
data.set 0xA0116138 %long   0x3B1B17CA
data.set 0xA011613C %long   0x2D4CD137
data.set 0xA0116140 %long   0xBDAA7CBE
data.set 0xA0116144 %long   0xAFA516B4
data.set 0xA0116148 %long   0x0F47535E
data.set 0xA011614C %long   0x4E2F614E
data.set 0xA0116150 %long   0x7546A60E
data.set 0xA0116154 %long   0x476A1FED
data.set 0xA0116158 %long   0xB9B7836D
data.set 0xA011615C %long   0xA4DFA879
data.set 0xA0116160 %long   0xAE21E7F1
data.set 0xA0116164 %long   0xF57E3A62
data.set 0xA0116168 %long   0x89CDD002
data.set 0xA011616C %long   0x78FA2FBC
data.set 0xA0116170 %long   0xF41513DA
data.set 0xA0116174 %long   0x3A26CA2A
data.set 0xA0116178 %long   0x219D0649
data.set 0xA011617C %long   0xFA3E9ED4
data.set 0xA0116180 %long   0x9E323C99
data.set 0xA0116184 %long   0x25DD2E5D
data.set 0xA0116188 %long   0xABA1852D
data.set 0xA011618C %long   0xB44E8CAC
data.set 0xA0116190 %long   0x6B87F1A7
data.set 0xA0116194 %long   0x1F79A580
data.set 0xA0116198 %long   0x239F187F
data.set 0xA011619C %long   0x301EC371
data.set 0xA01161A0 %long   0x09EAEEC6
data.set 0xA01161A4 %long   0x88CEB559
data.set 0xA01161A8 %long   0x6402D094
data.set 0xA01161AC %long   0xAC4AE404
data.set 0xA01161B0 %long   0x2F47FCA2
data.set 0xA01161B4 %long   0xCCC2FB74
data.set 0xA01161B8 %long   0x13676E63
data.set 0xA01161BC %long   0xF810A661
data.set 0xA01161C0 %long   0x6DBCC1CF
data.set 0xA01161C4 %long   0x0384F648
data.set 0xA01161C8 %long   0xE39562D0
data.set 0xA01161CC %long   0x6BFC641A
data.set 0xA01161D0 %long   0x849FFAB0
data.set 0xA01161D4 %long   0xC1D93844
data.set 0xA01161D8 %long   0xC7E8859C
data.set 0xA01161DC %long   0xABB2F464
data.set 0xA01161E0 %long   0xCDDE0685
data.set 0xA01161E4 %long   0x86AAEC1B
data.set 0xA01161E8 %long   0x639E6B8F
data.set 0xA01161EC %long   0x0059ADE0
data.set 0xA01161F0 %long   0x3521118D
data.set 0xA01161F4 %long   0x49883677
data.set 0xA01161F8 %long   0x1D3B1F97
data.set 0xA01161FC %long   0xE5DAD929
data.set 0xA0116200 %long   0x56612638
data.set 0xA0116204 %long   0xE1C1B541
data.set 0xA0116208 %long   0x6BD773FA
data.set 0xA011620C %long   0x957D9E89
data.set 0xA0116210 %long   0x5A226D7E
data.set 0xA0116214 %long   0x2E05A1E6
data.set 0xA0116218 %long   0x7919B14D
data.set 0xA011621C %long   0x84C891BD
data.set 0xA0116220 %long   0xBE343806
data.set 0xA0116224 %long   0xADF8FAFF
data.set 0xA0116228 %long   0x7B88A2F2
data.set 0xA011622C %long   0x7BD2DF76
data.set 0xA0116230 %long   0x50198B61
data.set 0xA0116234 %long   0xCF7B0CC6
data.set 0xA0116238 %long   0xF92F3A8C
data.set 0xA011623C %long   0x1D5CCF99
data.set 0xA0116240 %long   0x970DA761
data.set 0xA0116244 %long   0xFC565E22
data.set 0xA0116248 %long   0x954E3B72
data.set 0xA011624C %long   0x1FA24160
data.set 0xA0116250 %long   0x0683684C
data.set 0xA0116254 %long   0x6F3A04C8
data.set 0xA0116258 %long   0xD393EA8D
data.set 0xA011625C %long   0x377B023D
data.set 0xA0116260 %long   0xD8D41867
data.set 0xA0116264 %long   0x5CC252CB
data.set 0xA0116268 %long   0x1E81DD4C
data.set 0xA011626C %long   0xE481940C
data.set 0xA0116270 %long   0x826E6FF2
data.set 0xA0116274 %long   0x83A56B1C
data.set 0xA0116278 %long   0xB80F4DD4
data.set 0xA011627C %long   0x92D1E657
data.set 0xA0116280 %long   0xA2D79026
data.set 0xA0116284 %long   0x9FE86059
data.set 0xA0116288 %long   0xECA9A037
data.set 0xA011628C %long   0xEB2923D9
data.set 0xA0116290 %long   0x0E146B10
data.set 0xA0116294 %long   0x014A07E1
data.set 0xA0116298 %long   0x6E616CF2
data.set 0xA011629C %long   0x45BD9D9E
data.set 0xA01162A0 %long   0x2C8BBFE3
data.set 0xA01162A4 %long   0x6117A314
data.set 0xA01162A8 %long   0x1C609934
data.set 0xA01162AC %long   0x58CA83E7
data.set 0xA01162B0 %long   0x671C08B2
data.set 0xA01162B4 %long   0x16A5AE29
data.set 0xA01162B8 %long   0x4239CEAF
data.set 0xA01162BC %long   0x957B414A
data.set 0xA01162C0 %long   0x27A2B559
data.set 0xA01162C4 %long   0x4733201D
data.set 0xA01162C8 %long   0x4EE12AD4
data.set 0xA01162CC %long   0x6674A7BE
data.set 0xA01162D0 %long   0x7287BD55
data.set 0xA01162D4 %long   0x97EA19FB
data.set 0xA01162D8 %long   0x72DA98C5
data.set 0xA01162DC %long   0x5FE8A533
data.set 0xA01162E0 %long   0xBFEFA82C
data.set 0xA01162E4 %long   0x73EB00E0
data.set 0xA01162E8 %long   0x287EE2E8
data.set 0xA01162EC %long   0xA4C3BDE3
data.set 0xA01162F0 %long   0x30F80C1B
data.set 0xA01162F4 %long   0x41E19FA3
data.set 0xA01162F8 %long   0xEB276D70
data.set 0xA01162FC %long   0x49D56FF5
data.set 0xA0116300 %long   0xE01CFA8D
data.set 0xA0116304 %long   0x389C7909
data.set 0xA0116308 %long   0x30EE418E
data.set 0xA011630C %long   0x580BD3B7
data.set 0xA0116310 %long   0x3F3C582B
data.set 0xA0116314 %long   0xDA6992FE
data.set 0xA0116318 %long   0x529E12A7
data.set 0xA011631C %long   0xDD4200AE
data.set 0xA0116320 %long   0xD5978D89
data.set 0xA0116324 %long   0x39C2FB7C
data.set 0xA0116328 %long   0x5AF8A514
data.set 0xA011632C %long   0x36CE519B
data.set 0xA0116330 %long   0x9357F19B
data.set 0xA0116334 %long   0x88D3AA13
data.set 0xA0116338 %long   0x1535B303
data.set 0xA011633C %long   0x9FBD6EEE
data.set 0xA0116340 %long   0x7417C263
data.set 0xA0116344 %long   0xAE4C9DC5
data.set 0xA0116348 %long   0xC52291B9
data.set 0xA011634C %long   0x8ACE793A
data.set 0xA0116350 %long   0x71B59CA9
data.set 0xA0116354 %long   0x5A13CD36
data.set 0xA0116358 %long   0x2C2BC9F6
data.set 0xA011635C %long   0xBF155800
data.set 0xA0116360 %long   0xD7D28FEF
data.set 0xA0116364 %long   0xDFBC4139
data.set 0xA0116368 %long   0x01384A56
data.set 0xA011636C %long   0xF82EF1BB
data.set 0xA0116370 %long   0x75C0F3B9
data.set 0xA0116374 %long   0x0B9952A5
data.set 0xA0116378 %long   0x8E9ABE1A
data.set 0xA011637C %long   0x377EA5ED
data.set 0xA0116380 %long   0x89ACEA48
data.set 0xA0116384 %long   0x98005586
data.set 0xA0116388 %long   0x39061F3F
data.set 0xA011638C %long   0x1C95E648
data.set 0xA0116390 %long   0xD093ABA0
data.set 0xA0116394 %long   0xE9176126
data.set 0xA0116398 %long   0x07853FEA
data.set 0xA011639C %long   0xE5792F46
data.set 0xA01163A0 %long   0xAC6368A3
data.set 0xA01163A4 %long   0xFCB9F937
data.set 0xA01163A8 %long   0xC3A3A4D3
data.set 0xA01163AC %long   0xCBED54D5
data.set 0xA01163B0 %long   0xF7D00DCF
data.set 0xA01163B4 %long   0xCE0019E5
data.set 0xA01163B8 %long   0xD945DFEA
data.set 0xA01163BC %long   0x19C7A6ED
data.set 0xA01163C0 %long   0x8DB19A91
data.set 0xA01163C4 %long   0xD5FFD9F3
data.set 0xA01163C8 %long   0x82F2CF58
data.set 0xA01163CC %long   0x5A66A3AB
data.set 0xA01163D0 %long   0xC723AD96
data.set 0xA01163D4 %long   0xD49D59C3
data.set 0xA01163D8 %long   0x46F56D35
data.set 0xA01163DC %long   0x2B8E7385
data.set 0xA01163E0 %long   0xD6376349
data.set 0xA01163E4 %long   0x63D10197
data.set 0xA01163E8 %long   0xEAEACA18
data.set 0xA01163EC %long   0x1D1C17E0
data.set 0xA01163F0 %long   0x7EF19289
data.set 0xA01163F4 %long   0x674C109B
data.set 0xA01163F8 %long   0x34167206
data.set 0xA01163FC %long   0x4B53E350
data.set 0xA0116400 %long   0x23AF37D5
data.set 0xA0116404 %long   0x415EBC78
data.set 0xA0116408 %long   0x710F4A5A
data.set 0xA011640C %long   0xE0DD8904
data.set 0xA0116410 %long   0xA860825D
data.set 0xA0116414 %long   0xE7DBB775
data.set 0xA0116418 %long   0x67435460
data.set 0xA011641C %long   0x7C24EB7E
data.set 0xA0116420 %long   0xDFFAAD0A
data.set 0xA0116424 %long   0x0D7441BA
data.set 0xA0116428 %long   0x8D4A50B9
data.set 0xA011642C %long   0xECFC7911
data.set 0xA0116430 %long   0x020E07C6
data.set 0xA0116434 %long   0x4CD121BB
data.set 0xA0116438 %long   0x8217278C
data.set 0xA011643C %long   0x298C827B
data.set 0xA0116440 %long   0xFE4E2CE8
data.set 0xA0116444 %long   0x716F0959
data.set 0xA0116448 %long   0x955E26F7
data.set 0xA011644C %long   0xAC0451BD
data.set 0xA0116450 %long   0xB54D05C7
data.set 0xA0116454 %long   0x697C771E
data.set 0xA0116458 %long   0xDDDC5D8A
data.set 0xA011645C %long   0xC33BC067
data.set 0xA0116460 %long   0x148F18C5
data.set 0xA0116464 %long   0x680E7BF3
data.set 0xA0116468 %long   0x9E46C42D
data.set 0xA011646C %long   0x7FA76DF2
data.set 0xA0116470 %long   0x9494728A
data.set 0xA0116474 %long   0x5DB3BEB6
data.set 0xA0116478 %long   0xBA7D4EB5
data.set 0xA011647C %long   0xCCD813AA
data.set 0xA0116480 %long   0xB4D4A840
data.set 0xA0116484 %long   0xE427A4CB
data.set 0xA0116488 %long   0xD414553C
data.set 0xA011648C %long   0x6119D998
data.set 0xA0116490 %long   0x38F895D1
data.set 0xA0116494 %long   0xFE042041
data.set 0xA0116498 %long   0xCC5A8330
data.set 0xA011649C %long   0x953EA2C9
data.set 0xA01164A0 %long   0x946EF78E
data.set 0xA01164A4 %long   0xF55CF6C0
data.set 0xA01164A8 %long   0x41F03504
data.set 0xA01164AC %long   0x49F95E52
data.set 0xA01164B0 %long   0x0AAE266C
data.set 0xA01164B4 %long   0x61B27743
data.set 0xA01164B8 %long   0x20577402
data.set 0xA01164BC %long   0x0D820477
data.set 0xA01164C0 %long   0xEF59DBDB
data.set 0xA01164C4 %long   0xFE28179D
data.set 0xA01164C8 %long   0x2AF3A6AF
data.set 0xA01164CC %long   0xDE036A1B
data.set 0xA01164D0 %long   0xC00197D6
data.set 0xA01164D4 %long   0x800CDAEA
data.set 0xA01164D8 %long   0x194EC472
data.set 0xA01164DC %long   0x79510C79
data.set 0xA01164E0 %long   0x75075EC5
data.set 0xA01164E4 %long   0xD7DB6C55
data.set 0xA01164E8 %long   0x7E610AF5
data.set 0xA01164EC %long   0x0E716859
data.set 0xA01164F0 %long   0x9DA186C7
data.set 0xA01164F4 %long   0x8F228291
data.set 0xA01164F8 %long   0xF30E2C91
data.set 0xA01164FC %long   0xEF792893
data.set 0xA0116500 %long   0x81D1FF5C
data.set 0xA0116504 %long   0xBEA34FD2
data.set 0xA0116508 %long   0x6D1E2DFC
data.set 0xA011650C %long   0x96123909
data.set 0xA0116510 %long   0xD0EB7627
data.set 0xA0116514 %long   0x7D02385E
data.set 0xA0116518 %long   0xEFE19A5C
data.set 0xA011651C %long   0xCA65D494
data.set 0xA0116520 %long   0x9F1CD5EA
data.set 0xA0116524 %long   0x0C034EAE
data.set 0xA0116528 %long   0xB78B697C
data.set 0xA011652C %long   0x520C6821
data.set 0xA0116530 %long   0xF9A61C45
data.set 0xA0116534 %long   0xFA752285
data.set 0xA0116538 %long   0xD8A30596
data.set 0xA011653C %long   0xEC398B03
data.set 0xA0116540 %long   0x20A3BC5C
data.set 0xA0116544 %long   0x55E71159
data.set 0xA0116548 %long   0x86A8776B
data.set 0xA011654C %long   0xBE80C5B8
data.set 0xA0116550 %long   0x0A0F5B9E
data.set 0xA0116554 %long   0x260D84DF
data.set 0xA0116558 %long   0xC618D0A6
data.set 0xA011655C %long   0x3B876B38
data.set 0xA0116560 %long   0x7F1D8207
data.set 0xA0116564 %long   0x91FCDE56
data.set 0xA0116568 %long   0xDB459227
data.set 0xA011656C %long   0xC9742FA0
data.set 0xA0116570 %long   0xBF996AAE
data.set 0xA0116574 %long   0x94133AA1
data.set 0xA0116578 %long   0x81B35F15
data.set 0xA011657C %long   0x28FEFB37
data.set 0xA0116580 %long   0x4904F44C
data.set 0xA0116584 %long   0x64CE933B
data.set 0xA0116588 %long   0x8A9799BD
data.set 0xA011658C %long   0xBBEE2DDE
data.set 0xA0116590 %long   0xABB7F012
data.set 0xA0116594 %long   0xB98E694B
data.set 0xA0116598 %long   0xE17FF9C5
data.set 0xA011659C %long   0x1B6C2D76
data.set 0xA01165A0 %long   0x5EB0ED8D
data.set 0xA01165A4 %long   0xF7998775
data.set 0xA01165A8 %long   0x8DB7DD8F
data.set 0xA01165AC %long   0xB208C664
data.set 0xA01165B0 %long   0xB09CBE0C
data.set 0xA01165B4 %long   0xC891AFF3
data.set 0xA01165B8 %long   0xFEA4EE0B
data.set 0xA01165BC %long   0x9B227899
data.set 0xA01165C0 %long   0x57F0C6C8
data.set 0xA01165C4 %long   0x0FA7205F
data.set 0xA01165C8 %long   0xCD440CBA
data.set 0xA01165CC %long   0xF1185E35
data.set 0xA01165D0 %long   0xA2EC01FC
data.set 0xA01165D4 %long   0xB6BA9CDF
data.set 0xA01165D8 %long   0x3D92777A
data.set 0xA01165DC %long   0xC4632520
data.set 0xA01165E0 %long   0xED8C56C4
data.set 0xA01165E4 %long   0x4FE65B16
data.set 0xA01165E8 %long   0xA17107E9
data.set 0xA01165EC %long   0xB9E477E2
data.set 0xA01165F0 %long   0xE9B33CA5
data.set 0xA01165F4 %long   0xDC759F18
data.set 0xA01165F8 %long   0x15F20795
data.set 0xA01165FC %long   0xD65DF068
data.set 0xA0116600 %long   0x5BDDAF02
data.set 0xA0116604 %long   0x87984DE0
data.set 0xA0116608 %long   0x05F9AB29
data.set 0xA011660C %long   0x52027944
data.set 0xA0116610 %long   0x9F33950A
data.set 0xA0116614 %long   0xF8FC5738
data.set 0xA0116618 %long   0x0D8D8F37
data.set 0xA011661C %long   0x65432EDE
data.set 0xA0116620 %long   0xF9AB8B12
data.set 0xA0116624 %long   0x51675689
data.set 0xA0116628 %long   0x790E1901
data.set 0xA011662C %long   0x6AF27360
data.set 0xA0116630 %long   0x8CC308CE
data.set 0xA0116634 %long   0x93E8DBDA
data.set 0xA0116638 %long   0xA53F81BC
data.set 0xA011663C %long   0x06EFCF5E
data.set 0xA0116640 %long   0xBA590702
data.set 0xA0116644 %long   0x2EC0A296
data.set 0xA0116648 %long   0x25BE448E
data.set 0xA011664C %long   0xEAB25D13
data.set 0xA0116650 %long   0xB165A122
data.set 0xA0116654 %long   0x7FD6D191
data.set 0xA0116658 %long   0x0DEB0E0C
data.set 0xA011665C %long   0xAA16DDBA
data.set 0xA0116660 %long   0xD774A4E8
data.set 0xA0116664 %long   0x379F1A7D
data.set 0xA0116668 %long   0x7D554920
data.set 0xA011666C %long   0xCF96F752
data.set 0xA0116670 %long   0x172F99ED
data.set 0xA0116674 %long   0x4DA69E1A
data.set 0xA0116678 %long   0x2592F1CA
data.set 0xA011667C %long   0xCF2D392C
data.set 0xA0116680 %long   0x8C2BE475
data.set 0xA0116684 %long   0xB18A929F
data.set 0xA0116688 %long   0xB540AD00
data.set 0xA011668C %long   0xA9E98DA6
data.set 0xA0116690 %long   0x811815BE
data.set 0xA0116694 %long   0x4500BE77
data.set 0xA0116698 %long   0xA8AC44F0
data.set 0xA011669C %long   0xBD531F4E
data.set 0xA01166A0 %long   0x8D62EF70
data.set 0xA01166A4 %long   0x85FFC95D
data.set 0xA01166A8 %long   0x11786E95
data.set 0xA01166AC %long   0x044888C4
data.set 0xA01166B0 %long   0x20D5740D
data.set 0xA01166B4 %long   0x74A4E3E8
data.set 0xA01166B8 %long   0xAD131AED
data.set 0xA01166BC %long   0x6C2E159C
data.set 0xA01166C0 %long   0x674B0004
data.set 0xA01166C4 %long   0x51BC725B
data.set 0xA01166C8 %long   0xBD25C204
data.set 0xA01166CC %long   0x433D2016
data.set 0xA01166D0 %long   0x1E4988B1
data.set 0xA01166D4 %long   0xEEFD52AE
data.set 0xA01166D8 %long   0x3B8CC43A
data.set 0xA01166DC %long   0x659242B5
data.set 0xA01166E0 %long   0x6782D388
data.set 0xA01166E4 %long   0xA6DC6E2B
data.set 0xA01166E8 %long   0xDDCE0914
data.set 0xA01166EC %long   0x34DB2795
data.set 0xA01166F0 %long   0x6D3FAEC9
data.set 0xA01166F4 %long   0x78BC1449
data.set 0xA01166F8 %long   0xB1C0F9D2
data.set 0xA01166FC %long   0x6CF863C6
data.set 0xA0116700 %long   0x1360AE89
data.set 0xA0116704 %long   0xF010EE0A
data.set 0xA0116708 %long   0xDC7D7BC7
data.set 0xA011670C %long   0x250E5D6F
data.set 0xA0116710 %long   0xBC1DDD68
data.set 0xA0116714 %long   0x287D0786
data.set 0xA0116718 %long   0xF48A9E6A
data.set 0xA011671C %long   0x44CA8F88
data.set 0xA0116720 %long   0xF9256ACD
data.set 0xA0116724 %long   0xA65A77BF
data.set 0xA0116728 %long   0x57C88063
data.set 0xA011672C %long   0xA9CFFEA4
data.set 0xA0116730 %long   0x8753BD88
data.set 0xA0116734 %long   0x61612BB8
data.set 0xA0116738 %long   0x6BCC2CF9
data.set 0xA011673C %long   0x912B8A35
data.set 0xA0116740 %long   0x28F9E53B
data.set 0xA0116744 %long   0x774F1A31
data.set 0xA0116748 %long   0x7067C6C7
data.set 0xA011674C %long   0x66FDD65E
data.set 0xA0116750 %long   0x6F36B363
data.set 0xA0116754 %long   0xA1D8BEB6
data.set 0xA0116758 %long   0x84D58A45
data.set 0xA011675C %long   0xC6DDDE61
data.set 0xA0116760 %long   0x4F5B9645
data.set 0xA0116764 %long   0xD43BE700
data.set 0xA0116768 %long   0x6A5F895E
data.set 0xA011676C %long   0x08BD2D28
data.set 0xA0116770 %long   0xD6DD88E2
data.set 0xA0116774 %long   0x631C1D44
data.set 0xA0116778 %long   0xF9BD0AE7
data.set 0xA011677C %long   0x609EB4BB
data.set 0xA0116780 %long   0xFDFA7974
data.set 0xA0116784 %long   0x4AEE5A96
data.set 0xA0116788 %long   0x2FC384A6
data.set 0xA011678C %long   0xC424547A
data.set 0xA0116790 %long   0x5A2236A7
data.set 0xA0116794 %long   0x35B728D6
data.set 0xA0116798 %long   0xB031146D
data.set 0xA011679C %long   0x7C890B8C
data.set 0xA01167A0 %long   0x01A419FC
data.set 0xA01167A4 %long   0x79CD22B6
data.set 0xA01167A8 %long   0x26274801
data.set 0xA01167AC %long   0xC2382DEB
data.set 0xA01167B0 %long   0xE60B8108
data.set 0xA01167B4 %long   0xB8E5E63D
data.set 0xA01167B8 %long   0x7A789F2F
data.set 0xA01167BC %long   0x22CEEA19
data.set 0xA01167C0 %long   0xDD375EAE
data.set 0xA01167C4 %long   0x60095FCD
data.set 0xA01167C8 %long   0x4BCDFAF1
data.set 0xA01167CC %long   0x13742CFD
data.set 0xA01167D0 %long   0x1C57411B
data.set 0xA01167D4 %long   0x4A99E0B4
data.set 0xA01167D8 %long   0x659FBD01
data.set 0xA01167DC %long   0x1BC1A71F
data.set 0xA01167E0 %long   0x85173E4D
data.set 0xA01167E4 %long   0x1D2B5D77
data.set 0xA01167E8 %long   0x68776681
data.set 0xA01167EC %long   0x6FF368E6
data.set 0xA01167F0 %long   0x5CECD325
data.set 0xA01167F4 %long   0x785ABFAB
data.set 0xA01167F8 %long   0xD093BBA6
data.set 0xA01167FC %long   0x838964BB
data.set 0xA0116800 %long   0xAD31F6B6
data.set 0xA0116804 %long   0xC2380B75
data.set 0xA0116808 %long   0x6BC671CC
data.set 0xA011680C %long   0x353FD960
data.set 0xA0116810 %long   0xF4D89C9F
data.set 0xA0116814 %long   0x29F944DE
data.set 0xA0116818 %long   0xA10E8A11
data.set 0xA011681C %long   0x69FF479D
data.set 0xA0116820 %long   0xEF0158C1
data.set 0xA0116824 %long   0x7E913C76
data.set 0xA0116828 %long   0xC71B72E7
data.set 0xA011682C %long   0xABB960D8
data.set 0xA0116830 %long   0xAA644A6B
data.set 0xA0116834 %long   0x60000344
data.set 0xA0116838 %long   0xA20DC146
data.set 0xA011683C %long   0x6DBE6279
data.set 0xA0116840 %long   0x77593481
data.set 0xA0116844 %long   0x1671884B
data.set 0xA0116848 %long   0x9A90BD0A
data.set 0xA011684C %long   0x463AF6D3
data.set 0xA0116850 %long   0x4A6FA278
data.set 0xA0116854 %long   0x62864262
data.set 0xA0116858 %long   0x48B8C349
data.set 0xA011685C %long   0x41CA6878
data.set 0xA0116860 %long   0xC23DA37B
data.set 0xA0116864 %long   0xB55A1461
data.set 0xA0116868 %long   0xC7BC9CAB
data.set 0xA011686C %long   0x89F339FC
data.set 0xA0116870 %long   0xBCB145A5
data.set 0xA0116874 %long   0x632F50A4
data.set 0xA0116878 %long   0xC1F825A4
data.set 0xA011687C %long   0x8B3CA027
data.set 0xA0116880 %long   0x6B20FEC2
data.set 0xA0116884 %long   0x5A1A5565
data.set 0xA0116888 %long   0xC6B3EC3A
data.set 0xA011688C %long   0x119F5E38
data.set 0xA0116890 %long   0x478FE05E
data.set 0xA0116894 %long   0x163FD326
data.set 0xA0116898 %long   0xF9F686C6
data.set 0xA011689C %long   0xAF0DFD0A
data.set 0xA01168A0 %long   0xB78AC830
data.set 0xA01168A4 %long   0xE2D2CEA1
data.set 0xA01168A8 %long   0x550242EF
data.set 0xA01168AC %long   0x4E556219
data.set 0xA01168B0 %long   0xC63400DC
data.set 0xA01168B4 %long   0xADFBD05C
data.set 0xA01168B8 %long   0xF8EF7A8F
data.set 0xA01168BC %long   0x5CAB8CC6
data.set 0xA01168C0 %long   0x9EFAB92A
data.set 0xA01168C4 %long   0xF35F70E6
data.set 0xA01168C8 %long   0x5314B625
data.set 0xA01168CC %long   0x63F2C23E
data.set 0xA01168D0 %long   0x2339F8B7
data.set 0xA01168D4 %long   0x6511EF82
data.set 0xA01168D8 %long   0x020EA005
data.set 0xA01168DC %long   0x912C1287
data.set 0xA01168E0 %long   0xDB3A5FC7
data.set 0xA01168E4 %long   0x94CE0F64
data.set 0xA01168E8 %long   0x4E2A33AD
data.set 0xA01168EC %long   0x2035AA1A
data.set 0xA01168F0 %long   0x38804B46
data.set 0xA01168F4 %long   0x9BEAC55D
data.set 0xA01168F8 %long   0xF7C49FF3
data.set 0xA01168FC %long   0xAF8B0EBF
data.set 0xA0116900 %long   0x79740A15
data.set 0xA0116904 %long   0xE1F54C94
data.set 0xA0116908 %long   0xF9154F3D
data.set 0xA011690C %long   0xBB1D4116
data.set 0xA0116910 %long   0x652094EB
data.set 0xA0116914 %long   0x9D55039E
data.set 0xA0116918 %long   0x6CC0AA86
data.set 0xA011691C %long   0xA14EA0C4
data.set 0xA0116920 %long   0xF7035485
data.set 0xA0116924 %long   0x49CEB47D
data.set 0xA0116928 %long   0x15E91B72
data.set 0xA011692C %long   0x1ACCDB99
data.set 0xA0116930 %long   0xE43EFE22
data.set 0xA0116934 %long   0x71201FD9
data.set 0xA0116938 %long   0x9D3907CB
data.set 0xA011693C %long   0x63FC44B3
data.set 0xA0116940 %long   0x1C288422
data.set 0xA0116944 %long   0xEDCEFAEB
data.set 0xA0116948 %long   0xE3C31658
data.set 0xA011694C %long   0xEA5C1D39
data.set 0xA0116950 %long   0xC35CDEDF
data.set 0xA0116954 %long   0xD114D8BC
data.set 0xA0116958 %long   0xF9DEF47D
data.set 0xA011695C %long   0xE2BA843E
data.set 0xA0116960 %long   0x10CD0D15
data.set 0xA0116964 %long   0x00764737
data.set 0xA0116968 %long   0xF3B93622
data.set 0xA011696C %long   0xC90B346A
data.set 0xA0116970 %long   0x5530281E
data.set 0xA0116974 %long   0xED18DFCE
data.set 0xA0116978 %long   0x5A9DA19F
data.set 0xA011697C %long   0x45196EBA
data.set 0xA0116980 %long   0x2BE0BDBA
data.set 0xA0116984 %long   0x4DF9CD0A
data.set 0xA0116988 %long   0x5C46DC58
data.set 0xA011698C %long   0x41BA9CAA
data.set 0xA0116990 %long   0xE7CC283F
data.set 0xA0116994 %long   0xAF61C03F
data.set 0xA0116998 %long   0xD4447FB8
data.set 0xA011699C %long   0x89059DF1
data.set 0xA01169A0 %long   0x0D880700
data.set 0xA01169A4 %long   0x01140EBA
data.set 0xA01169A8 %long   0xFC16B817
data.set 0xA01169AC %long   0x0E444965
data.set 0xA01169B0 %long   0xE0A64F85
data.set 0xA01169B4 %long   0x48E7217E
data.set 0xA01169B8 %long   0x9DB05287
data.set 0xA01169BC %long   0xD6588062
data.set 0xA01169C0 %long   0xAD5B091A
data.set 0xA01169C4 %long   0xF2B1C070
data.set 0xA01169C8 %long   0xB80C6853
data.set 0xA01169CC %long   0x9CC73F7B
data.set 0xA01169D0 %long   0xFEA5BDA5
data.set 0xA01169D4 %long   0x795988EC
data.set 0xA01169D8 %long   0xCFBB0013
data.set 0xA01169DC %long   0x139C1451
data.set 0xA01169E0 %long   0x25251506
data.set 0xA01169E4 %long   0x59051203
data.set 0xA01169E8 %long   0x4D08D1DF
data.set 0xA01169EC %long   0x9DB0D674
data.set 0xA01169F0 %long   0xBE8461BC
data.set 0xA01169F4 %long   0xB3203A40
data.set 0xA01169F8 %long   0xCE6DDDF2
data.set 0xA01169FC %long   0xDF729CDA
data.set 0xA0116A00 %long   0x64D44E6D
data.set 0xA0116A04 %long   0x9BCA4FA9
data.set 0xA0116A08 %long   0xCB1403B2
data.set 0xA0116A0C %long   0x3BF1311B
data.set 0xA0116A10 %long   0xAF8CFADC
data.set 0xA0116A14 %long   0x40AB642B
data.set 0xA0116A18 %long   0x56065B08
data.set 0xA0116A1C %long   0x39B06AD1
data.set 0xA0116A20 %long   0x22251D5B
data.set 0xA0116A24 %long   0x706C9D9F
data.set 0xA0116A28 %long   0xAC7573BD
data.set 0xA0116A2C %long   0x96E7706C
data.set 0xA0116A30 %long   0x1AE8ECF4
data.set 0xA0116A34 %long   0xFDD27DA4
data.set 0xA0116A38 %long   0xD281D3A2
data.set 0xA0116A3C %long   0x6F184789
data.set 0xA0116A40 %long   0xCB5031A7
data.set 0xA0116A44 %long   0x5EAE59D0
data.set 0xA0116A48 %long   0xBAB6E1B0
data.set 0xA0116A4C %long   0x6BF030F9
data.set 0xA0116A50 %long   0x33B74D01
data.set 0xA0116A54 %long   0x6F44A992
data.set 0xA0116A58 %long   0x68E44F15
data.set 0xA0116A5C %long   0x6EA34E18
data.set 0xA0116A60 %long   0xD37FF0B3
data.set 0xA0116A64 %long   0x81D85B05
data.set 0xA0116A68 %long   0x26CE57D0
data.set 0xA0116A6C %long   0xDDCFDCB1
data.set 0xA0116A70 %long   0x2B6BB52B
data.set 0xA0116A74 %long   0xA6CBA9D3
data.set 0xA0116A78 %long   0x92CB838F
data.set 0xA0116A7C %long   0x363FB8F0
data.set 0xA0116A80 %long   0xE65D900E
data.set 0xA0116A84 %long   0x9B752FF7
data.set 0xA0116A88 %long   0xCE45F796
data.set 0xA0116A8C %long   0x73F403BB
data.set 0xA0116A90 %long   0xA5F7B575
data.set 0xA0116A94 %long   0xA203FEEB
data.set 0xA0116A98 %long   0x4E752A4D
data.set 0xA0116A9C %long   0x4F5200AD
data.set 0xA0116AA0 %long   0x6A6A28E2
data.set 0xA0116AA4 %long   0x16CAEC0D
data.set 0xA0116AA8 %long   0xAFA0ADD9
data.set 0xA0116AAC %long   0xA205E5FF
data.set 0xA0116AB0 %long   0x83372996
data.set 0xA0116AB4 %long   0x497B5870
data.set 0xA0116AB8 %long   0x472CB6E6
data.set 0xA0116ABC %long   0xB6C37311
data.set 0xA0116AC0 %long   0x5539E404
data.set 0xA0116AC4 %long   0x0E63D434
data.set 0xA0116AC8 %long   0x01E3CBF3
data.set 0xA0116ACC %long   0xA9D85515
data.set 0xA0116AD0 %long   0x8CDAA185
data.set 0xA0116AD4 %long   0xDCB3BE38
data.set 0xA0116AD8 %long   0xB9F93DB1
data.set 0xA0116ADC %long   0x328B091C
data.set 0xA0116AE0 %long   0x1EE6067A
data.set 0xA0116AE4 %long   0x458B42A0
data.set 0xA0116AE8 %long   0x582AFFC8
data.set 0xA0116AEC %long   0x4743C7FE
data.set 0xA0116AF0 %long   0x9A506999
data.set 0xA0116AF4 %long   0xFD53D903
data.set 0xA0116AF8 %long   0x423EE1AA
data.set 0xA0116AFC %long   0xE4053896
data.set 0xA0116B00 %long   0x94C28493
data.set 0xA0116B04 %long   0x7A97F10C
data.set 0xA0116B08 %long   0x636372AD
data.set 0xA0116B0C %long   0x02FA7331
data.set 0xA0116B10 %long   0xB704273C
data.set 0xA0116B14 %long   0xF58B27A1
data.set 0xA0116B18 %long   0x2AD3D94B
data.set 0xA0116B1C %long   0x93432A21
data.set 0xA0116B20 %long   0x60F95877
data.set 0xA0116B24 %long   0x844333C7
data.set 0xA0116B28 %long   0xDB9FBF60
data.set 0xA0116B2C %long   0x32CC4277
data.set 0xA0116B30 %long   0x026CC554
data.set 0xA0116B34 %long   0x7B05F3B6
data.set 0xA0116B38 %long   0x423270D2
data.set 0xA0116B3C %long   0x1A081E22
data.set 0xA0116B40 %long   0xDDD514CD
data.set 0xA0116B44 %long   0xB4DE6F69
data.set 0xA0116B48 %long   0xF921CEA2
data.set 0xA0116B4C %long   0xFD649CD4
data.set 0xA0116B50 %long   0xF4475A5C
data.set 0xA0116B54 %long   0xFF4F8C98
data.set 0xA0116B58 %long   0xF8BE63C2
data.set 0xA0116B5C %long   0xBFCB6028
data.set 0xA0116B60 %long   0xE67B916E
data.set 0xA0116B64 %long   0xAC39E9ED
data.set 0xA0116B68 %long   0x85A1AF7C
data.set 0xA0116B6C %long   0x8AA555E8
data.set 0xA0116B70 %long   0x5BEDC7FE
data.set 0xA0116B74 %long   0xA53AD943
data.set 0xA0116B78 %long   0xD6B717C0
data.set 0xA0116B7C %long   0x33DB9F2B
data.set 0xA0116B80 %long   0x6AF68EE8
data.set 0xA0116B84 %long   0xF1E2F464
data.set 0xA0116B88 %long   0x06DB98E8
data.set 0xA0116B8C %long   0xBEBADF61
data.set 0xA0116B90 %long   0xE0656FF4
data.set 0xA0116B94 %long   0xC4E7FB70
data.set 0xA0116B98 %long   0x61AD55E0
data.set 0xA0116B9C %long   0x4AF28E3F
data.set 0xA0116BA0 %long   0x07B2887A
data.set 0xA0116BA4 %long   0xCCD1DB7B
data.set 0xA0116BA8 %long   0x08F804B0
data.set 0xA0116BAC %long   0xA57EEFC8
data.set 0xA0116BB0 %long   0xD570B50D
data.set 0xA0116BB4 %long   0xB0756022
data.set 0xA0116BB8 %long   0xCEA59235
data.set 0xA0116BBC %long   0x885B30F0
data.set 0xA0116BC0 %long   0xA74F14AC
data.set 0xA0116BC4 %long   0x836A4E52
data.set 0xA0116BC8 %long   0x7B13A0FE
data.set 0xA0116BCC %long   0x42535C18
data.set 0xA0116BD0 %long   0x241FD7F4
data.set 0xA0116BD4 %long   0x3ACE82BB
data.set 0xA0116BD8 %long   0xE6D2088E
data.set 0xA0116BDC %long   0xD2910AE5
data.set 0xA0116BE0 %long   0x99F65C5B
data.set 0xA0116BE4 %long   0x27A4684D
data.set 0xA0116BE8 %long   0xF9E679A9
data.set 0xA0116BEC %long   0x00D973A5
data.set 0xA0116BF0 %long   0x152D5407
data.set 0xA0116BF4 %long   0x802DCE8F
data.set 0xA0116BF8 %long   0x530215B5
data.set 0xA0116BFC %long   0xF6D703FA
data.set 0xA0116C00 %long   0x09BCB169
data.set 0xA0116C04 %long   0xA1031379
data.set 0xA0116C08 %long   0x58D09FD8
data.set 0xA0116C0C %long   0x5349BE0C
data.set 0xA0116C10 %long   0x0DD92346
data.set 0xA0116C14 %long   0xA17FD8D8
data.set 0xA0116C18 %long   0x609D07BF
data.set 0xA0116C1C %long   0x941114FC
data.set 0xA0116C20 %long   0xBE84679F
data.set 0xA0116C24 %long   0xD9ED4052
data.set 0xA0116C28 %long   0x491978F8
data.set 0xA0116C2C %long   0x9BBA4F90
data.set 0xA0116C30 %long   0x38007668
data.set 0xA0116C34 %long   0x07BB94D1
data.set 0xA0116C38 %long   0x94B74955
data.set 0xA0116C3C %long   0xF6363F3B
data.set 0xA0116C40 %long   0x1041260E
data.set 0xA0116C44 %long   0x046FCB80
data.set 0xA0116C48 %long   0x18B2E006
data.set 0xA0116C4C %long   0x67A0028C
data.set 0xA0116C50 %long   0xEB8B3C4A
data.set 0xA0116C54 %long   0xBB2FAE38
data.set 0xA0116C58 %long   0xDE6C600D
data.set 0xA0116C5C %long   0x31CC85A2
data.set 0xA0116C60 %long   0xFBB77501
data.set 0xA0116C64 %long   0x08E8762E
data.set 0xA0116C68 %long   0xD21EEE9F
data.set 0xA0116C6C %long   0xD2F13E54
data.set 0xA0116C70 %long   0x6C35F30A
data.set 0xA0116C74 %long   0x40629DC3
data.set 0xA0116C78 %long   0x40B5DDFA
data.set 0xA0116C7C %long   0x6B662839
data.set 0xA0116C80 %long   0x3B5D01FB
data.set 0xA0116C84 %long   0x38EC7362
data.set 0xA0116C88 %long   0x2F466598
data.set 0xA0116C8C %long   0x59B49CB7
data.set 0xA0116C90 %long   0x01B8D82C
data.set 0xA0116C94 %long   0xBE989281
data.set 0xA0116C98 %long   0x22EFF97A
data.set 0xA0116C9C %long   0x808F874C
data.set 0xA0116CA0 %long   0xC0089D49
data.set 0xA0116CA4 %long   0xBAB7E7C8
data.set 0xA0116CA8 %long   0xB927569B
data.set 0xA0116CAC %long   0xCE0EFE02
data.set 0xA0116CB0 %long   0x7C512781
data.set 0xA0116CB4 %long   0xBD0F078A
data.set 0xA0116CB8 %long   0x4336B8A9
data.set 0xA0116CBC %long   0x6B3013D0
data.set 0xA0116CC0 %long   0xEA1FAB6C
data.set 0xA0116CC4 %long   0x6E047685
data.set 0xA0116CC8 %long   0xC4C98A3B
data.set 0xA0116CCC %long   0x41181E9A
data.set 0xA0116CD0 %long   0x509BF3BA
data.set 0xA0116CD4 %long   0x1246D3FB
data.set 0xA0116CD8 %long   0xA7F678AB
data.set 0xA0116CDC %long   0xDDF11433
data.set 0xA0116CE0 %long   0x100DB48F
data.set 0xA0116CE4 %long   0x67704FB1
data.set 0xA0116CE8 %long   0x10F131B9
data.set 0xA0116CEC %long   0xDB2C9935
data.set 0xA0116CF0 %long   0x9E5566D9
data.set 0xA0116CF4 %long   0xB5DA22E6
data.set 0xA0116CF8 %long   0x55FB3950
data.set 0xA0116CFC %long   0xE82CB19B
data.set 0xA0116D00 %long   0xCA4A43E2
data.set 0xA0116D04 %long   0x07DFB48A
data.set 0xA0116D08 %long   0xF6BEA489
data.set 0xA0116D0C %long   0x7F058713
data.set 0xA0116D10 %long   0xB6D0F670
data.set 0xA0116D14 %long   0xF32B3767
data.set 0xA0116D18 %long   0xB4C082BC
data.set 0xA0116D1C %long   0xCA42BB7E
data.set 0xA0116D20 %long   0xD547C0CA
data.set 0xA0116D24 %long   0xBE418D9D
data.set 0xA0116D28 %long   0xE4202B66
data.set 0xA0116D2C %long   0x1FD135AD
data.set 0xA0116D30 %long   0x9A961BDC
data.set 0xA0116D34 %long   0x18CCA316
data.set 0xA0116D38 %long   0x62AD586F
data.set 0xA0116D3C %long   0xD9C5E309
data.set 0xA0116D40 %long   0x959C6B8D
data.set 0xA0116D44 %long   0xC460664E
data.set 0xA0116D48 %long   0xE7314569
data.set 0xA0116D4C %long   0xA1CBB923
data.set 0xA0116D50 %long   0x6401AA72
data.set 0xA0116D54 %long   0x1F4FC7CC
data.set 0xA0116D58 %long   0x3E624CCE
data.set 0xA0116D5C %long   0x51902891
data.set 0xA0116D60 %long   0xEAF70B35
data.set 0xA0116D64 %long   0xC2748FB8
data.set 0xA0116D68 %long   0x7C7C8D77
data.set 0xA0116D6C %long   0x150050FF
data.set 0xA0116D70 %long   0x8D2B8AE1
data.set 0xA0116D74 %long   0xD6663EA2
data.set 0xA0116D78 %long   0x5F66E7E2
data.set 0xA0116D7C %long   0x9608415C
data.set 0xA0116D80 %long   0x6A7D16B8
data.set 0xA0116D84 %long   0x4C330407
data.set 0xA0116D88 %long   0x222CB53A
data.set 0xA0116D8C %long   0xB337ED5D
data.set 0xA0116D90 %long   0x2F213225
data.set 0xA0116D94 %long   0x5F085705
data.set 0xA0116D98 %long   0x82BDB1CE
data.set 0xA0116D9C %long   0x8E64A182
data.set 0xA0116DA0 %long   0x8F8A0788
data.set 0xA0116DA4 %long   0xCAC24E22
data.set 0xA0116DA8 %long   0x9BA48C19
data.set 0xA0116DAC %long   0xAC864611
data.set 0xA0116DB0 %long   0xBB34A2E7
data.set 0xA0116DB4 %long   0x6B3993F3
data.set 0xA0116DB8 %long   0x93D850F9
data.set 0xA0116DBC %long   0xF21E34B0
data.set 0xA0116DC0 %long   0x67153940
data.set 0xA0116DC4 %long   0x91743A0E
data.set 0xA0116DC8 %long   0xA0184F73
data.set 0xA0116DCC %long   0xEA9F54B8
data.set 0xA0116DD0 %long   0xA73A5F03
data.set 0xA0116DD4 %long   0x952F6E85
data.set 0xA0116DD8 %long   0x9E616F8E
data.set 0xA0116DDC %long   0xDFB65F48
data.set 0xA0116DE0 %long   0xB1ECADC6
data.set 0xA0116DE4 %long   0xB93CE8E1
data.set 0xA0116DE8 %long   0xAB1A7CE6
data.set 0xA0116DEC %long   0x13C9294C
data.set 0xA0116DF0 %long   0xE27C83D2
data.set 0xA0116DF4 %long   0x3AFA6E44
data.set 0xA0116DF8 %long   0x128CE02D
data.set 0xA0116DFC %long   0x5092C8C8
data.set 0xA0116E00 %long   0x533C21CF
data.set 0xA0116E04 %long   0x9BB0D26F
data.set 0xA0116E08 %long   0x31ED8311
data.set 0xA0116E0C %long   0xF4CEE8C3
data.set 0xA0116E10 %long   0xEC557941
data.set 0xA0116E14 %long   0x3CD02E0E
data.set 0xA0116E18 %long   0xB3F6D2F5
data.set 0xA0116E1C %long   0x1C3CA18C
data.set 0xA0116E20 %long   0x7006490B
data.set 0xA0116E24 %long   0x3A52FDF0
data.set 0xA0116E28 %long   0x718AF340
data.set 0xA0116E2C %long   0xAE2C447A
data.set 0xA0116E30 %long   0xC89FD07C
data.set 0xA0116E34 %long   0x15702337
data.set 0xA0116E38 %long   0xB6E69561
data.set 0xA0116E3C %long   0x0B746C24
data.set 0xA0116E40 %long   0x1B7B1734
data.set 0xA0116E44 %long   0xF2CB1320
data.set 0xA0116E48 %long   0x72640ED0
data.set 0xA0116E4C %long   0x1AC38DCB
data.set 0xA0116E50 %long   0x492D7B43
data.set 0xA0116E54 %long   0x54C7F704
data.set 0xA0116E58 %long   0xBCACCB23
data.set 0xA0116E5C %long   0x7773312B
data.set 0xA0116E60 %long   0xDF1E0407
data.set 0xA0116E64 %long   0x99578FE7
data.set 0xA0116E68 %long   0x7F3039B2
data.set 0xA0116E6C %long   0x5FE1B1A6
data.set 0xA0116E70 %long   0x5BB7D4DA
data.set 0xA0116E74 %long   0xFC6BA63F
data.set 0xA0116E78 %long   0x1C7177F0
data.set 0xA0116E7C %long   0x845A4792
data.set 0xA0116E80 %long   0x4FE20A7B
data.set 0xA0116E84 %long   0xA5E167D6
data.set 0xA0116E88 %long   0x4F96A56A
data.set 0xA0116E8C %long   0xD9107E68
data.set 0xA0116E90 %long   0x840DCF7C
data.set 0xA0116E94 %long   0x081E3C30
data.set 0xA0116E98 %long   0x719AD7DE
data.set 0xA0116E9C %long   0x517CB4EA
data.set 0xA0116EA0 %long   0x6CDC49D0
data.set 0xA0116EA4 %long   0x99C1BFF9
data.set 0xA0116EA8 %long   0xB7446DE0
data.set 0xA0116EAC %long   0x73508F3A
data.set 0xA0116EB0 %long   0x6FFCA453
data.set 0xA0116EB4 %long   0xFE976944
data.set 0xA0116EB8 %long   0x8798A32A
data.set 0xA0116EBC %long   0x2769C663
data.set 0xA0116EC0 %long   0x99D74DDE
data.set 0xA0116EC4 %long   0x7AA8B947
data.set 0xA0116EC8 %long   0xD8822462
data.set 0xA0116ECC %long   0x19E4A251
data.set 0xA0116ED0 %long   0x86ADD525
data.set 0xA0116ED4 %long   0x3115A75B
data.set 0xA0116ED8 %long   0x7E6F14F8
data.set 0xA0116EDC %long   0xA38874F6
data.set 0xA0116EE0 %long   0x370FA8BC
data.set 0xA0116EE4 %long   0xD5A45153
data.set 0xA0116EE8 %long   0xF5936989
data.set 0xA0116EEC %long   0xCFDB9509
data.set 0xA0116EF0 %long   0xA684A50C
data.set 0xA0116EF4 %long   0x65C48188
data.set 0xA0116EF8 %long   0x2BB76CB3
data.set 0xA0116EFC %long   0xB2055F6A
data.set 0xA0116F00 %long   0xF528B1B1
data.set 0xA0116F04 %long   0x0807D715
data.set 0xA0116F08 %long   0xDE42221F
data.set 0xA0116F0C %long   0xEF8FB5A4
data.set 0xA0116F10 %long   0x074C3D5F
data.set 0xA0116F14 %long   0x60982853
data.set 0xA0116F18 %long   0xB0F43271
data.set 0xA0116F1C %long   0x8CD5B622
data.set 0xA0116F20 %long   0x01DCD432
data.set 0xA0116F24 %long   0x7693C303
data.set 0xA0116F28 %long   0x2CB86467
data.set 0xA0116F2C %long   0x37A81411
data.set 0xA0116F30 %long   0xC5D80AC8
data.set 0xA0116F34 %long   0xDE496022
data.set 0xA0116F38 %long   0x69035EEA
data.set 0xA0116F3C %long   0xB6110F5A
data.set 0xA0116F40 %long   0x8E6BC30F
data.set 0xA0116F44 %long   0x0D21D1F8
data.set 0xA0116F48 %long   0xCC9D3D7A
data.set 0xA0116F4C %long   0x690121C1
data.set 0xA0116F50 %long   0xAF2621E5
data.set 0xA0116F54 %long   0xF38AACF9
data.set 0xA0116F58 %long   0x4DC69603
data.set 0xA0116F5C %long   0xA65EF74A
data.set 0xA0116F60 %long   0x3F8A076B
data.set 0xA0116F64 %long   0xF90A0881
data.set 0xA0116F68 %long   0x06E50856
data.set 0xA0116F6C %long   0x3AC989E6
data.set 0xA0116F70 %long   0xDEF8B18E
data.set 0xA0116F74 %long   0x5BAD23AC
data.set 0xA0116F78 %long   0xC6B22096
data.set 0xA0116F7C %long   0x365EDD08
data.set 0xA0116F80 %long   0x36B82929
data.set 0xA0116F84 %long   0x77E0E41D
data.set 0xA0116F88 %long   0x4B2392C3
data.set 0xA0116F8C %long   0xE9D31318
data.set 0xA0116F90 %long   0x1874786C
data.set 0xA0116F94 %long   0xB4433CBB
data.set 0xA0116F98 %long   0xD33BA440
data.set 0xA0116F9C %long   0xA672798F
data.set 0xA0116FA0 %long   0xA45E4E46
data.set 0xA0116FA4 %long   0x16C3A33C
data.set 0xA0116FA8 %long   0xEF1C33DA
data.set 0xA0116FAC %long   0xB365DC94
data.set 0xA0116FB0 %long   0x65C7583C
data.set 0xA0116FB4 %long   0x353D7817
data.set 0xA0116FB8 %long   0xE6C9DD49
data.set 0xA0116FBC %long   0x7F8186CF
data.set 0xA0116FC0 %long   0x11997865
data.set 0xA0116FC4 %long   0x04DC9E1D
data.set 0xA0116FC8 %long   0x9122F681
data.set 0xA0116FCC %long   0x0F80891F
data.set 0xA0116FD0 %long   0x0008DD2D
data.set 0xA0116FD4 %long   0x971FE9F7
data.set 0xA0116FD8 %long   0x49EB7F0F
data.set 0xA0116FDC %long   0x6F487E6E
data.set 0xA0116FE0 %long   0x03F3F56F
data.set 0xA0116FE4 %long   0x32CF332E
data.set 0xA0116FE8 %long   0x29930CFD
data.set 0xA0116FEC %long   0x3749A6D4
data.set 0xA0116FF0 %long   0x3843BD0E
data.set 0xA0116FF4 %long   0xDB020B40
data.set 0xA0116FF8 %long   0xC1DB6F2A
data.set 0xA0116FFC %long   0x1AF49020
data.set 0xA0117000 %long   0xD6AE56D1
data.set 0xA0117004 %long   0x9C215B3F
data.set 0xA0117008 %long   0xB8B83509
data.set 0xA011700C %long   0x0A76DD19
data.set 0xA0117010 %long   0x4E973F21
data.set 0xA0117014 %long   0x4D02160B
data.set 0xA0117018 %long   0xB3112F22
data.set 0xA011701C %long   0xA23DE3E6
data.set 0xA0117020 %long   0x877A1760
data.set 0xA0117024 %long   0xC0016E84
data.set 0xA0117028 %long   0xB5D94E18
data.set 0xA011702C %long   0x1F700E38
data.set 0xA0117030 %long   0x1E0A92E8
data.set 0xA0117034 %long   0x14DA0D48
data.set 0xA0117038 %long   0x106D8902
data.set 0xA011703C %long   0xC65DE8B7
data.set 0xA0117040 %long   0x152C33FA
data.set 0xA0117044 %long   0xA025F772
data.set 0xA0117048 %long   0xF975D478
data.set 0xA011704C %long   0x27BFA833
data.set 0xA0117050 %long   0xFB602A97
data.set 0xA0117054 %long   0x6AF00ED6
data.set 0xA0117058 %long   0x85F1E1BB
data.set 0xA011705C %long   0x7665BB1C
data.set 0xA0117060 %long   0x02637DA2
data.set 0xA0117064 %long   0xCA403F7C
data.set 0xA0117068 %long   0x80203890
data.set 0xA011706C %long   0xD4FC37A8
data.set 0xA0117070 %long   0x07D21BFC
data.set 0xA0117074 %long   0xA8ED6376
data.set 0xA0117078 %long   0xC42E81FF
data.set 0xA011707C %long   0x1F0DCB74
data.set 0xA0117080 %long   0xFE019951
data.set 0xA0117084 %long   0xACB76B6A
data.set 0xA0117088 %long   0xAF04D901
data.set 0xA011708C %long   0x50BBD45C
data.set 0xA0117090 %long   0xB29F381A
data.set 0xA0117094 %long   0xBC4F447A
data.set 0xA0117098 %long   0x966E03AE
data.set 0xA011709C %long   0x2242CEF6
data.set 0xA01170A0 %long   0x49518937
data.set 0xA01170A4 %long   0x1402A8B0
data.set 0xA01170A8 %long   0x06AE6AE3
data.set 0xA01170AC %long   0xA24A34F4
data.set 0xA01170B0 %long   0x4E092713
data.set 0xA01170B4 %long   0xCA1BFCD7
data.set 0xA01170B8 %long   0xFAC5629D
data.set 0xA01170BC %long   0x9BC15225
data.set 0xA01170C0 %long   0x4B29A878
data.set 0xA01170C4 %long   0xC04BB1AF
data.set 0xA01170C8 %long   0x49AB0A74
data.set 0xA01170CC %long   0x5476E001
data.set 0xA01170D0 %long   0xB955A7DE
data.set 0xA01170D4 %long   0x893ABAD4
data.set 0xA01170D8 %long   0xB6C41D3C
data.set 0xA01170DC %long   0xBAED59F5
data.set 0xA01170E0 %long   0x394859B5
data.set 0xA01170E4 %long   0x91408F24
data.set 0xA01170E8 %long   0x2F7CD0A7
data.set 0xA01170EC %long   0x55B63C2E
data.set 0xA01170F0 %long   0x7A5FCC25
data.set 0xA01170F4 %long   0x4EC4ECAA
data.set 0xA01170F8 %long   0x4D475AA5
data.set 0xA01170FC %long   0x6FEF9C09
data.set 0xA0117100 %long   0x6EF3C29B
data.set 0xA0117104 %long   0x39EABFBE
data.set 0xA0117108 %long   0x58B5A408
data.set 0xA011710C %long   0xB8DC8A3F
data.set 0xA0117110 %long   0x7C6F32F5
data.set 0xA0117114 %long   0xBBB8511C
data.set 0xA0117118 %long   0xC51DDDE2
data.set 0xA011711C %long   0x1A2389A9
data.set 0xA0117120 %long   0x8D83DEBE
data.set 0xA0117124 %long   0x3DD8506E
data.set 0xA0117128 %long   0x0465532B
data.set 0xA011712C %long   0x6796B777
data.set 0xA0117130 %long   0x87804D21
data.set 0xA0117134 %long   0xE3D1CAA3
data.set 0xA0117138 %long   0x2A27BAB8
data.set 0xA011713C %long   0xF1549BE0
data.set 0xA0117140 %long   0xEB5B0A0D
data.set 0xA0117144 %long   0x383EDB8C
data.set 0xA0117148 %long   0x2821D127
data.set 0xA011714C %long   0xA39BB436
data.set 0xA0117150 %long   0x9C3BE309
data.set 0xA0117154 %long   0x92FB0E55
data.set 0xA0117158 %long   0xA01CF41C
data.set 0xA011715C %long   0x4C9A89B8
data.set 0xA0117160 %long   0x83AB3519
data.set 0xA0117164 %long   0x6F251CBD
data.set 0xA0117168 %long   0x46D79B6C
data.set 0xA011716C %long   0x3D1956BB
data.set 0xA0117170 %long   0x8072BFD7
data.set 0xA0117174 %long   0xC0583C19
data.set 0xA0117178 %long   0x4207B8EF
data.set 0xA011717C %long   0x1DD4A792
data.set 0xA0117180 %long   0xC70B8C57
data.set 0xA0117184 %long   0xFB91B5E8
data.set 0xA0117188 %long   0xE2887A93
data.set 0xA011718C %long   0xA2A0636E
data.set 0xA0117190 %long   0x28758AFA
data.set 0xA0117194 %long   0xDC8A977F
data.set 0xA0117198 %long   0x59CAF357
data.set 0xA011719C %long   0xCE718061
data.set 0xA01171A0 %long   0xFC5BCC8A
data.set 0xA01171A4 %long   0x016CA2AF
data.set 0xA01171A8 %long   0x06F840F7
data.set 0xA01171AC %long   0x6522A70F
data.set 0xA01171B0 %long   0x0B3897C1
data.set 0xA01171B4 %long   0xABB1266C
data.set 0xA01171B8 %long   0x60CAEBE9
data.set 0xA01171BC %long   0x2D066E0B
data.set 0xA01171C0 %long   0x21425401
data.set 0xA01171C4 %long   0xEF0C90F8
data.set 0xA01171C8 %long   0xAC6314D7
data.set 0xA01171CC %long   0xF6B8C80F
data.set 0xA01171D0 %long   0x6A6E62CA
data.set 0xA01171D4 %long   0x91F643AC
data.set 0xA01171D8 %long   0xEA756D4A
data.set 0xA01171DC %long   0x264092B3
data.set 0xA01171E0 %long   0x0099CD83
data.set 0xA01171E4 %long   0xC9EC7D87
data.set 0xA01171E8 %long   0x6CF5807F
data.set 0xA01171EC %long   0x8A99F3B6
data.set 0xA01171F0 %long   0x1CDCB058
data.set 0xA01171F4 %long   0x301E157E
data.set 0xA01171F8 %long   0xD35B9A8F
data.set 0xA01171FC %long   0xDFF7B7D3
data.set 0xA0117200 %long   0x4E49BAD4
data.set 0xA0117204 %long   0x76D96E1B
data.set 0xA0117208 %long   0xBE583B05
data.set 0xA011720C %long   0x97C27429
data.set 0xA0117210 %long   0xFF23B93F
data.set 0xA0117214 %long   0xB59CE688
data.set 0xA0117218 %long   0x5071BDDA
data.set 0xA011721C %long   0x874A229F
data.set 0xA0117220 %long   0x0B6AD072
data.set 0xA0117224 %long   0xB7DE4D7B
data.set 0xA0117228 %long   0xE0324E74
data.set 0xA011722C %long   0x0C56BF4D
data.set 0xA0117230 %long   0x3BFFBE7D
data.set 0xA0117234 %long   0x1456D392
data.set 0xA0117238 %long   0x3550BC67
data.set 0xA011723C %long   0x30FFF543
data.set 0xA0117240 %long   0xF2D32B5E
data.set 0xA0117244 %long   0x7284704B
data.set 0xA0117248 %long   0xFA513D1B
data.set 0xA011724C %long   0x67627EAC
data.set 0xA0117250 %long   0x42AB0BFA
data.set 0xA0117254 %long   0x060B18C2
data.set 0xA0117258 %long   0xEA739443
data.set 0xA011725C %long   0xC30483A4
data.set 0xA0117260 %long   0x35877C9E
data.set 0xA0117264 %long   0x2E960555
data.set 0xA0117268 %long   0xD0875979
data.set 0xA011726C %long   0xFCB90876
data.set 0xA0117270 %long   0x4764FECB
data.set 0xA0117274 %long   0x39BE4474
data.set 0xA0117278 %long   0x2D6427F7
data.set 0xA011727C %long   0xC4EC8F82
data.set 0xA0117280 %long   0xF1807550
data.set 0xA0117284 %long   0xD9F8B1A4
data.set 0xA0117288 %long   0xA78898A1
data.set 0xA011728C %long   0xC5F5C469
data.set 0xA0117290 %long   0xD6E9B3F5
data.set 0xA0117294 %long   0x75233A69
data.set 0xA0117298 %long   0x1AD2A521
data.set 0xA011729C %long   0xA68021DE
data.set 0xA01172A0 %long   0x3125D624
data.set 0xA01172A4 %long   0xF0E19E1B
data.set 0xA01172A8 %long   0x24CBDA0D
data.set 0xA01172AC %long   0x2A7C4A43
data.set 0xA01172B0 %long   0x56B1E8F4
data.set 0xA01172B4 %long   0x4966CDB7
data.set 0xA01172B8 %long   0xC583ED3F
data.set 0xA01172BC %long   0x7A8BE778
data.set 0xA01172C0 %long   0x7CC3E502
data.set 0xA01172C4 %long   0xB5359B6E
data.set 0xA01172C8 %long   0x6F8CDEF5
data.set 0xA01172CC %long   0x7D38DCF3
data.set 0xA01172D0 %long   0xA1725E0D
data.set 0xA01172D4 %long   0xCD0AD924
data.set 0xA01172D8 %long   0x9845BAE7
data.set 0xA01172DC %long   0x313DDAF0
data.set 0xA01172E0 %long   0x6002A6ED
data.set 0xA01172E4 %long   0x5DB8146D
data.set 0xA01172E8 %long   0xD885631D
data.set 0xA01172EC %long   0xDECE6D6D
data.set 0xA01172F0 %long   0x5525D9BB
data.set 0xA01172F4 %long   0x38702818
data.set 0xA01172F8 %long   0x1301A515
data.set 0xA01172FC %long   0xD96C1047
data.set 0xA0117300 %long   0xA4A5307D
data.set 0xA0117304 %long   0x360247CC
data.set 0xA0117308 %long   0x6E64B32B
data.set 0xA011730C %long   0xCFE52562
data.set 0xA0117310 %long   0xB35B7AFD
data.set 0xA0117314 %long   0xCCB86E5D
data.set 0xA0117318 %long   0xF7F20835
data.set 0xA011731C %long   0xA24FD1DA
data.set 0xA0117320 %long   0x8CDA78C3
data.set 0xA0117324 %long   0xEBF15080
data.set 0xA0117328 %long   0x13F98CF2
data.set 0xA011732C %long   0x4097781F
data.set 0xA0117330 %long   0x51F5626E
data.set 0xA0117334 %long   0xCEE89888
data.set 0xA0117338 %long   0x0340732F
data.set 0xA011733C %long   0x106C58F4
data.set 0xA0117340 %long   0x130CC5CD
data.set 0xA0117344 %long   0x07677278
data.set 0xA0117348 %long   0xF6D1FE7B
data.set 0xA011734C %long   0xF2A53CC7
data.set 0xA0117350 %long   0xF6ACCAEE
data.set 0xA0117354 %long   0xBBBD33C5
data.set 0xA0117358 %long   0x8E6FA978
data.set 0xA011735C %long   0x7469446A
data.set 0xA0117360 %long   0x50305398
data.set 0xA0117364 %long   0xC037B4F0
data.set 0xA0117368 %long   0xB05D22BB
data.set 0xA011736C %long   0x166D86A8
data.set 0xA0117370 %long   0x24C1C2C6
data.set 0xA0117374 %long   0xC4B04CE6
data.set 0xA0117378 %long   0x83CC0482
data.set 0xA011737C %long   0x9B99C62F
data.set 0xA0117380 %long   0x4ED5E145
data.set 0xA0117384 %long   0x1A5A4E9C
data.set 0xA0117388 %long   0xDDFB3C5E
data.set 0xA011738C %long   0x2881E600
data.set 0xA0117390 %long   0xA31954D2
data.set 0xA0117394 %long   0xCDF7D1F0
data.set 0xA0117398 %long   0x2F1E0AF8
data.set 0xA011739C %long   0x2616522F
data.set 0xA01173A0 %long   0x1C6301E7
data.set 0xA01173A4 %long   0x6D3B291A
data.set 0xA01173A8 %long   0x3972CBB1
data.set 0xA01173AC %long   0x90A16716
data.set 0xA01173B0 %long   0x33FED1D6
data.set 0xA01173B4 %long   0x419636E3
data.set 0xA01173B8 %long   0x9337AE82
data.set 0xA01173BC %long   0xDAD8FCA2
data.set 0xA01173C0 %long   0x50867B5B
data.set 0xA01173C4 %long   0x1821218E
data.set 0xA01173C8 %long   0x5100E5FD
data.set 0xA01173CC %long   0x4986111C
data.set 0xA01173D0 %long   0x22CC0C1E
data.set 0xA01173D4 %long   0x9E130288
data.set 0xA01173D8 %long   0xDF2C1F32
data.set 0xA01173DC %long   0x09861FB9
data.set 0xA01173E0 %long   0x1DFC2EDF
data.set 0xA01173E4 %long   0x94E51657
data.set 0xA01173E8 %long   0xE148E180
data.set 0xA01173EC %long   0xF36FBD3E
data.set 0xA01173F0 %long   0x54686E31
data.set 0xA01173F4 %long   0x39FCB589
data.set 0xA01173F8 %long   0x3B98B63D
data.set 0xA01173FC %long   0x6767C669
data.set 0xA0117400 %long   0x59CDFDC3
data.set 0xA0117404 %long   0xEB4C6992
data.set 0xA0117408 %long   0x9756D837
data.set 0xA011740C %long   0x90301F9B
data.set 0xA0117410 %long   0x7AEB9C91
data.set 0xA0117414 %long   0xB28A1A0C
data.set 0xA0117418 %long   0xF6E6B26E
data.set 0xA011741C %long   0xF34D52BC
data.set 0xA0117420 %long   0xE50279D5
data.set 0xA0117424 %long   0xEF1215AC
data.set 0xA0117428 %long   0x1ABBC9E5
data.set 0xA011742C %long   0x17A85530
data.set 0xA0117430 %long   0xE8CEA426
data.set 0xA0117434 %long   0x14F2D00F
data.set 0xA0117438 %long   0x161758CA
data.set 0xA011743C %long   0x002094A2
data.set 0xA0117440 %long   0xA75A507B
data.set 0xA0117444 %long   0x1EE44FD7
data.set 0xA0117448 %long   0xF587DC8F
data.set 0xA011744C %long   0xDEDAA67C
data.set 0xA0117450 %long   0x14DEFF8B
data.set 0xA0117454 %long   0xA5CCE467
data.set 0xA0117458 %long   0x17CEA7D4
data.set 0xA011745C %long   0x47921058
data.set 0xA0117460 %long   0x76C62879
data.set 0xA0117464 %long   0xCCA25336
data.set 0xA0117468 %long   0xD26BFED3
data.set 0xA011746C %long   0xC68715E8
data.set 0xA0117470 %long   0x983D00CE
data.set 0xA0117474 %long   0xD4E28337
data.set 0xA0117478 %long   0x739B6962
data.set 0xA011747C %long   0xF1D3C69E
data.set 0xA0117480 %long   0x90AB07C7
data.set 0xA0117484 %long   0xE22ADA36
data.set 0xA0117488 %long   0x89D187E4
data.set 0xA011748C %long   0x70ED106F
data.set 0xA0117490 %long   0x7645A2C7
data.set 0xA0117494 %long   0xCCB41779
data.set 0xA0117498 %long   0x81A1E93C
data.set 0xA011749C %long   0x4C59EA78
data.set 0xA01174A0 %long   0xB235F891
data.set 0xA01174A4 %long   0x4EFAC3B2
data.set 0xA01174A8 %long   0xCCE2A6C4
data.set 0xA01174AC %long   0xCDF5D55B
data.set 0xA01174B0 %long   0x021FB02D
data.set 0xA01174B4 %long   0x08C11086
data.set 0xA01174B8 %long   0xEE396F6F
data.set 0xA01174BC %long   0x4DC399DE
data.set 0xA01174C0 %long   0xD07A31DD
data.set 0xA01174C4 %long   0xF535E69A
data.set 0xA01174C8 %long   0x92440AD3
data.set 0xA01174CC %long   0xE13E64EE
data.set 0xA01174D0 %long   0x92FA805C
data.set 0xA01174D4 %long   0xBCF6069B
data.set 0xA01174D8 %long   0x0F1CF580
data.set 0xA01174DC %long   0xBF0DD3A0
data.set 0xA01174E0 %long   0x9160C327
data.set 0xA01174E4 %long   0x60351871
data.set 0xA01174E8 %long   0xF3852461
data.set 0xA01174EC %long   0x08D8E574
data.set 0xA01174F0 %long   0xF5340A56
data.set 0xA01174F4 %long   0xEAB063DE
data.set 0xA01174F8 %long   0x70E107B8
data.set 0xA01174FC %long   0xA98A47C2
data.set 0xA0117500 %long   0x0A2E74C1
data.set 0xA0117504 %long   0x8F5DBF49
data.set 0xA0117508 %long   0xE08A0443
data.set 0xA011750C %long   0xFDC0F6FA
data.set 0xA0117510 %long   0xC3478B01
data.set 0xA0117514 %long   0x17A6AEBC
data.set 0xA0117518 %long   0x7DA5B263
data.set 0xA011751C %long   0x525CE335
data.set 0xA0117520 %long   0xB3415C56
data.set 0xA0117524 %long   0x02E95223
data.set 0xA0117528 %long   0x51FC0399
data.set 0xA011752C %long   0x065F378F
data.set 0xA0117530 %long   0x0900F2E4
data.set 0xA0117534 %long   0xED92C50F
data.set 0xA0117538 %long   0xF69EF05F
data.set 0xA011753C %long   0x17CA5023
data.set 0xA0117540 %long   0x101FF3BE
data.set 0xA0117544 %long   0x80D54B52
data.set 0xA0117548 %long   0x7687BD9D
data.set 0xA011754C %long   0x276EB447
data.set 0xA0117550 %long   0xD2AACC0F
data.set 0xA0117554 %long   0xFCA48C2C
data.set 0xA0117558 %long   0x9DDF131B
data.set 0xA011755C %long   0xE5D9CE3D
data.set 0xA0117560 %long   0xF234EF80
data.set 0xA0117564 %long   0x1DA1C2ED
data.set 0xA0117568 %long   0xF6DCCD19
data.set 0xA011756C %long   0x0B4D0013
data.set 0xA0117570 %long   0x9434D357
data.set 0xA0117574 %long   0x70410B7D
data.set 0xA0117578 %long   0x3A2B7478
data.set 0xA011757C %long   0x0384BF0D
data.set 0xA0117580 %long   0x5D90AF31
data.set 0xA0117584 %long   0x61E42915
data.set 0xA0117588 %long   0x9821967A
data.set 0xA011758C %long   0x032FB521
data.set 0xA0117590 %long   0x38B4CBE4
data.set 0xA0117594 %long   0x76D59B67
data.set 0xA0117598 %long   0x18A44904
data.set 0xA011759C %long   0x4CCF3F7D
data.set 0xA01175A0 %long   0xDBC70F07
data.set 0xA01175A4 %long   0x0B72DAC2
data.set 0xA01175A8 %long   0x01DD3081
data.set 0xA01175AC %long   0x3AC08927
data.set 0xA01175B0 %long   0x3AAD0C2B
data.set 0xA01175B4 %long   0x68E286E7
data.set 0xA01175B8 %long   0x11D9486D
data.set 0xA01175BC %long   0xD3109A95
data.set 0xA01175C0 %long   0x12F041E3
data.set 0xA01175C4 %long   0xA827779C
data.set 0xA01175C8 %long   0xEFD8676A
data.set 0xA01175CC %long   0x33C9D986
data.set 0xA01175D0 %long   0xF260F002
data.set 0xA01175D4 %long   0x68E3B4CB
data.set 0xA01175D8 %long   0xF4B21038
data.set 0xA01175DC %long   0xBD69A0A9
data.set 0xA01175E0 %long   0x66FB1D7D
data.set 0xA01175E4 %long   0xFD234790
data.set 0xA01175E8 %long   0xA32A7858
data.set 0xA01175EC %long   0x4E2D9203
data.set 0xA01175F0 %long   0x098F2407
data.set 0xA01175F4 %long   0x33796806
data.set 0xA01175F8 %long   0xBBD1D42B
data.set 0xA01175FC %long   0xF80A4654
data.set 0xA0117600 %long   0xED75F61D
data.set 0xA0117604 %long   0x6DF4A482
data.set 0xA0117608 %long   0x89934137
data.set 0xA011760C %long   0xCBB9DC75
data.set 0xA0117610 %long   0xB5969E1B
data.set 0xA0117614 %long   0x1177F5AF
data.set 0xA0117618 %long   0x7C3C27CD
data.set 0xA011761C %long   0x8A1CCCD1
data.set 0xA0117620 %long   0xBFD1E364
data.set 0xA0117624 %long   0xF8DD49D7
data.set 0xA0117628 %long   0xC4E759FD
data.set 0xA011762C %long   0xA7FE69CF
data.set 0xA0117630 %long   0xFF0F6629
data.set 0xA0117634 %long   0x428D6EB1
data.set 0xA0117638 %long   0x35A030DA
data.set 0xA011763C %long   0x8361BB57
data.set 0xA0117640 %long   0x2A382682
data.set 0xA0117644 %long   0xE1913C66
data.set 0xA0117648 %long   0x4B094C34
data.set 0xA011764C %long   0xA7359A51
data.set 0xA0117650 %long   0x011F4112
data.set 0xA0117654 %long   0x1B68CA8C
data.set 0xA0117658 %long   0xBB53A1C8
data.set 0xA011765C %long   0x41E57125
data.set 0xA0117660 %long   0x6FC68CBF
data.set 0xA0117664 %long   0x833E1C22
data.set 0xA0117668 %long   0x77E0164E
data.set 0xA011766C %long   0x2A0C09CF
data.set 0xA0117670 %long   0x29C7BE36
data.set 0xA0117674 %long   0xFC3D3DB3
data.set 0xA0117678 %long   0x14358E32
data.set 0xA011767C %long   0xD437001A
data.set 0xA0117680 %long   0xDC9F6E01
data.set 0xA0117684 %long   0x1302ADD0
data.set 0xA0117688 %long   0xC5F0BE03
data.set 0xA011768C %long   0x1A71BDC7
data.set 0xA0117690 %long   0xA323F90D
data.set 0xA0117694 %long   0xD56DED87
data.set 0xA0117698 %long   0x26BDA618
data.set 0xA011769C %long   0xE01D761E
data.set 0xA01176A0 %long   0xD79311E6
data.set 0xA01176A4 %long   0x24AE3512
data.set 0xA01176A8 %long   0x84E1C95E
data.set 0xA01176AC %long   0x91019F68
data.set 0xA01176B0 %long   0x37BA5036
data.set 0xA01176B4 %long   0xEC407631
data.set 0xA01176B8 %long   0x40741C57
data.set 0xA01176BC %long   0x87BA6BE7
data.set 0xA01176C0 %long   0x48235DD1
data.set 0xA01176C4 %long   0x475D5F84
data.set 0xA01176C8 %long   0xAC3480A9
data.set 0xA01176CC %long   0xBB209912
data.set 0xA01176D0 %long   0xBA6AC664
data.set 0xA01176D4 %long   0xCCAA5436
data.set 0xA01176D8 %long   0xF025F5CC
data.set 0xA01176DC %long   0x63B7C249
data.set 0xA01176E0 %long   0x6859105B
data.set 0xA01176E4 %long   0xB5B4F9A2
data.set 0xA01176E8 %long   0xFA02E7F1
data.set 0xA01176EC %long   0x00FF72FC
data.set 0xA01176F0 %long   0x859EE9A2
data.set 0xA01176F4 %long   0xC6F52FD9
data.set 0xA01176F8 %long   0x6872218D
data.set 0xA01176FC %long   0x89BEBF06
data.set 0xA0117700 %long   0x7B6E3AB3
data.set 0xA0117704 %long   0x355A137F
data.set 0xA0117708 %long   0x65CC3240
data.set 0xA011770C %long   0x0BEA43D7
data.set 0xA0117710 %long   0x0D62A30F
data.set 0xA0117714 %long   0x65513CED
data.set 0xA0117718 %long   0x630B9E3C
data.set 0xA011771C %long   0x3860550D
data.set 0xA0117720 %long   0x3FA002B7
data.set 0xA0117724 %long   0xA8E7AD97
data.set 0xA0117728 %long   0x9FC27194
data.set 0xA011772C %long   0xC68AB0ED
data.set 0xA0117730 %long   0xE0E0AEB8
data.set 0xA0117734 %long   0xDCE18DB8
data.set 0xA0117738 %long   0x6C420444
data.set 0xA011773C %long   0x39808E45
data.set 0xA0117740 %long   0x853180CA
data.set 0xA0117744 %long   0x048FE5FB
data.set 0xA0117748 %long   0x22C729E5
data.set 0xA011774C %long   0xA68345C4
data.set 0xA0117750 %long   0x8CD20609
data.set 0xA0117754 %long   0x9F66D7B4
data.set 0xA0117758 %long   0x20B81022
data.set 0xA011775C %long   0x46D77AA9
data.set 0xA0117760 %long   0x51853272
data.set 0xA0117764 %long   0xCEB67A20
data.set 0xA0117768 %long   0xBA4334F4
data.set 0xA011776C %long   0x3FBD8450
data.set 0xA0117770 %long   0x61447AFF
data.set 0xA0117774 %long   0xDEB20FD7
data.set 0xA0117778 %long   0x3D7B8477
data.set 0xA011777C %long   0x084F6C2E
data.set 0xA0117780 %long   0x618A12B7
data.set 0xA0117784 %long   0xC34A45A3
data.set 0xA0117788 %long   0xFAC4EC59
data.set 0xA011778C %long   0xBAD105DD
data.set 0xA0117790 %long   0x8BC95D18
data.set 0xA0117794 %long   0x7F0A900B
data.set 0xA0117798 %long   0xE7346686
data.set 0xA011779C %long   0x606C7538
data.set 0xA01177A0 %long   0x6F9B445B
data.set 0xA01177A4 %long   0x8DC93A7B
data.set 0xA01177A8 %long   0xDB242D30
data.set 0xA01177AC %long   0x96B26A01
data.set 0xA01177B0 %long   0xC1C8AC51
data.set 0xA01177B4 %long   0x302D9808
data.set 0xA01177B8 %long   0x4A400AC8
data.set 0xA01177BC %long   0x43E8D1D4
data.set 0xA01177C0 %long   0x75CF61D6
data.set 0xA01177C4 %long   0x4BF63651
data.set 0xA01177C8 %long   0x6BE45D9E
data.set 0xA01177CC %long   0x1E4E24A2
data.set 0xA01177D0 %long   0xF9D83C40
data.set 0xA01177D4 %long   0xCF03AE59
data.set 0xA01177D8 %long   0x0D9D56BA
data.set 0xA01177DC %long   0xA411B665
data.set 0xA01177E0 %long   0xAB706D10
data.set 0xA01177E4 %long   0xA36846B2
data.set 0xA01177E8 %long   0xB1BD5D9C
data.set 0xA01177EC %long   0xB8D7D5C5
data.set 0xA01177F0 %long   0xAD040C13
data.set 0xA01177F4 %long   0x91BCDB3D
data.set 0xA01177F8 %long   0x6D3432DA
data.set 0xA01177FC %long   0x45B66312
data.set 0xA0117800 %long   0xBED16174
data.set 0xA0117804 %long   0x9B1AD2CF
data.set 0xA0117808 %long   0xD8C265BA
data.set 0xA011780C %long   0xE11CC9A5
data.set 0xA0117810 %long   0xBB88B688
data.set 0xA0117814 %long   0xE35EC441
data.set 0xA0117818 %long   0x86B2132B
data.set 0xA011781C %long   0x78819EEF
data.set 0xA0117820 %long   0x061F3290
data.set 0xA0117824 %long   0x0B69C686
data.set 0xA0117828 %long   0xAE27A1FC
data.set 0xA011782C %long   0xE02DA8BA
data.set 0xA0117830 %long   0x9361EAC0
data.set 0xA0117834 %long   0xC91C0352
data.set 0xA0117838 %long   0x7F729FCC
data.set 0xA011783C %long   0xC99BD3F4
data.set 0xA0117840 %long   0x15E4CD26
data.set 0xA0117844 %long   0x1E725661
data.set 0xA0117848 %long   0x308DCF2A
data.set 0xA011784C %long   0x28655590
data.set 0xA0117850 %long   0xAF98DBF3
data.set 0xA0117854 %long   0x9616D801
data.set 0xA0117858 %long   0xBBF5FF5E
data.set 0xA011785C %long   0x46D0BBC0
data.set 0xA0117860 %long   0x60909983
data.set 0xA0117864 %long   0x5AAACD42
data.set 0xA0117868 %long   0x4974FC5A
data.set 0xA011786C %long   0x0321E9ED
data.set 0xA0117870 %long   0xE2E6244C
data.set 0xA0117874 %long   0xE5363A71
data.set 0xA0117878 %long   0x2D1D9767
data.set 0xA011787C %long   0xA33361F2
data.set 0xA0117880 %long   0x5145431E
data.set 0xA0117884 %long   0x76372452
data.set 0xA0117888 %long   0xF5A87911
data.set 0xA011788C %long   0x3F37698C
data.set 0xA0117890 %long   0xF880FED5
data.set 0xA0117894 %long   0x46C5C43A
data.set 0xA0117898 %long   0x7463B0CD
data.set 0xA011789C %long   0x0C6EFB2F
data.set 0xA01178A0 %long   0xC1D17066
data.set 0xA01178A4 %long   0x66F7C156
data.set 0xA01178A8 %long   0x92F7D525
data.set 0xA01178AC %long   0x318880BD
data.set 0xA01178B0 %long   0xE90DD4FC
data.set 0xA01178B4 %long   0x89F4AFAF
data.set 0xA01178B8 %long   0x78180320
data.set 0xA01178BC %long   0xC453352C
data.set 0xA01178C0 %long   0xB432C852
data.set 0xA01178C4 %long   0xA02905D1
data.set 0xA01178C8 %long   0xE2E173D3
data.set 0xA01178CC %long   0xE65337F1
data.set 0xA01178D0 %long   0xE599D4E9
data.set 0xA01178D4 %long   0x0402B621
data.set 0xA01178D8 %long   0x88AC1272
data.set 0xA01178DC %long   0x6BEF3F20
data.set 0xA01178E0 %long   0x39D4A3E7
data.set 0xA01178E4 %long   0x7B480BAB
data.set 0xA01178E8 %long   0x3DF6A6E6
data.set 0xA01178EC %long   0x871D85C0
data.set 0xA01178F0 %long   0xC4651F1C
data.set 0xA01178F4 %long   0x81C16D43
data.set 0xA01178F8 %long   0x0EE543E9
data.set 0xA01178FC %long   0x43158D38
data.set 0xA0117900 %long   0xEEC83A2F
data.set 0xA0117904 %long   0x8249C13F
data.set 0xA0117908 %long   0xD09BEA04
data.set 0xA011790C %long   0x0617BABF
data.set 0xA0117910 %long   0x6575D7FA
data.set 0xA0117914 %long   0x2C4741C6
data.set 0xA0117918 %long   0x7AFE9724
data.set 0xA011791C %long   0x7B9AE685
data.set 0xA0117920 %long   0xEE4AF011
data.set 0xA0117924 %long   0x9E564594
data.set 0xA0117928 %long   0x5699C9C0
data.set 0xA011792C %long   0x833702A4
data.set 0xA0117930 %long   0x902FFEA5
data.set 0xA0117934 %long   0xA9587F62
data.set 0xA0117938 %long   0x87F933E6
data.set 0xA011793C %long   0x27D2096D
data.set 0xA0117940 %long   0xD9DA4F86
data.set 0xA0117944 %long   0xCC0C9899
data.set 0xA0117948 %long   0xA2CEE51F
data.set 0xA011794C %long   0x5DF3F318
data.set 0xA0117950 %long   0x8CA7635A
data.set 0xA0117954 %long   0xDFD0F976
data.set 0xA0117958 %long   0xC6681876
data.set 0xA011795C %long   0x84A2D01F
data.set 0xA0117960 %long   0x31C8B2A9
data.set 0xA0117964 %long   0x03B824C2
data.set 0xA0117968 %long   0xB7C2DEE1
data.set 0xA011796C %long   0x87C27ADE
data.set 0xA0117970 %long   0x4FD34831
data.set 0xA0117974 %long   0x86687319
data.set 0xA0117978 %long   0x4AC28181
data.set 0xA011797C %long   0x8829AD49
data.set 0xA0117980 %long   0xCD4D7036
data.set 0xA0117984 %long   0x306374EE
data.set 0xA0117988 %long   0x557F7243
data.set 0xA011798C %long   0xB818CBF2
data.set 0xA0117990 %long   0xED4D63B8
data.set 0xA0117994 %long   0xEBD8C1D2
data.set 0xA0117998 %long   0xAAE29ED4
data.set 0xA011799C %long   0x2ECA9895
data.set 0xA01179A0 %long   0xAAF1C993
data.set 0xA01179A4 %long   0x6EE654D7
data.set 0xA01179A8 %long   0x873F5574
data.set 0xA01179AC %long   0x1A68A378
data.set 0xA01179B0 %long   0x60E42ADF
data.set 0xA01179B4 %long   0x5C6057A4
data.set 0xA01179B8 %long   0x3B58A594
data.set 0xA01179BC %long   0x0C57569A
data.set 0xA01179C0 %long   0x2B31A4B3
data.set 0xA01179C4 %long   0x22EDF59B
data.set 0xA01179C8 %long   0x060E5036
data.set 0xA01179CC %long   0x426D2FD0
data.set 0xA01179D0 %long   0x16250ED4
data.set 0xA01179D4 %long   0x3FAB0CF9
data.set 0xA01179D8 %long   0xB3B34DCD
data.set 0xA01179DC %long   0xA53669B2
data.set 0xA01179E0 %long   0xAC196F66
data.set 0xA01179E4 %long   0xFE2C30E7
data.set 0xA01179E8 %long   0xC70D920B
data.set 0xA01179EC %long   0xE8C3D93A
data.set 0xA01179F0 %long   0x1315E9B6
data.set 0xA01179F4 %long   0xA4EB839D
data.set 0xA01179F8 %long   0x282F6687
data.set 0xA01179FC %long   0x68AB880C
data.set 0xA0117A00 %long   0x084FE62F
data.set 0xA0117A04 %long   0xA0F78A90
data.set 0xA0117A08 %long   0x3B47D11C
data.set 0xA0117A0C %long   0xF26FDA3C
data.set 0xA0117A10 %long   0xDF92D984
data.set 0xA0117A14 %long   0x97BEB983
data.set 0xA0117A18 %long   0x4A7C1BDF
data.set 0xA0117A1C %long   0xB34AAF16
data.set 0xA0117A20 %long   0xC999ACEA
data.set 0xA0117A24 %long   0xA808CD84
data.set 0xA0117A28 %long   0x3530B93A
data.set 0xA0117A2C %long   0x0477CBA1
data.set 0xA0117A30 %long   0x07FF82E0
data.set 0xA0117A34 %long   0x71D31685
data.set 0xA0117A38 %long   0xD5C91592
data.set 0xA0117A3C %long   0xF5F7F29D
data.set 0xA0117A40 %long   0xCC5A1D6D
data.set 0xA0117A44 %long   0x01403948
data.set 0xA0117A48 %long   0x8953431A
data.set 0xA0117A4C %long   0xD11693BE
data.set 0xA0117A50 %long   0x7730908D
data.set 0xA0117A54 %long   0x2792FFE7
data.set 0xA0117A58 %long   0x5E65A5BA
data.set 0xA0117A5C %long   0x547538D2
data.set 0xA0117A60 %long   0x51B212CF
data.set 0xA0117A64 %long   0xFAEDDB23
data.set 0xA0117A68 %long   0x6DB34D98
data.set 0xA0117A6C %long   0x79CCF88D
data.set 0xA0117A70 %long   0x8D780888
data.set 0xA0117A74 %long   0x350DC4CB
data.set 0xA0117A78 %long   0xFC319524
data.set 0xA0117A7C %long   0x4235800B
data.set 0xA0117A80 %long   0x85388D8A
data.set 0xA0117A84 %long   0x95B685B0
data.set 0xA0117A88 %long   0xAFE5EAE0
data.set 0xA0117A8C %long   0x31EC088C
data.set 0xA0117A90 %long   0x4F3EC68A
data.set 0xA0117A94 %long   0x6262D62E
data.set 0xA0117A98 %long   0x843C3097
data.set 0xA0117A9C %long   0x156B1A03
data.set 0xA0117AA0 %long   0xE91FD9F0
data.set 0xA0117AA4 %long   0xE4FADD2C
data.set 0xA0117AA8 %long   0xD1E81ADC
data.set 0xA0117AAC %long   0xECC5F763
data.set 0xA0117AB0 %long   0x18090D1C
data.set 0xA0117AB4 %long   0xF09C4343
data.set 0xA0117AB8 %long   0x163AA8C1
data.set 0xA0117ABC %long   0x83194F2B
data.set 0xA0117AC0 %long   0x48EA3597
data.set 0xA0117AC4 %long   0x11818AD3
data.set 0xA0117AC8 %long   0xB5DD6A04
data.set 0xA0117ACC %long   0x9C7815FF
data.set 0xA0117AD0 %long   0x4FDEE49F
data.set 0xA0117AD4 %long   0xD5D47B44
data.set 0xA0117AD8 %long   0x2810F8B7
data.set 0xA0117ADC %long   0x8ECBA571
data.set 0xA0117AE0 %long   0x02623AC2
data.set 0xA0117AE4 %long   0xB66911FB
data.set 0xA0117AE8 %long   0x7823C12A
data.set 0xA0117AEC %long   0x97568EE2
data.set 0xA0117AF0 %long   0xAB1DDE79
data.set 0xA0117AF4 %long   0x8860C897
data.set 0xA0117AF8 %long   0x11C94CF9
data.set 0xA0117AFC %long   0xFB7A6F90
data.set 0xA0117B00 %long   0x3D1FEEF3
data.set 0xA0117B04 %long   0x06AE72F2
data.set 0xA0117B08 %long   0x5A0C6833
data.set 0xA0117B0C %long   0x9147A7D2
data.set 0xA0117B10 %long   0x43C69067
data.set 0xA0117B14 %long   0x9B6CBAB2
data.set 0xA0117B18 %long   0x4DE98983
data.set 0xA0117B1C %long   0x5BBA6E58
data.set 0xA0117B20 %long   0xDE5346FF
data.set 0xA0117B24 %long   0xE575F69E
data.set 0xA0117B28 %long   0x930AAB86
data.set 0xA0117B2C %long   0x44AD62F5
data.set 0xA0117B30 %long   0xDB1DD27F
data.set 0xA0117B34 %long   0xE3C9E9EF
data.set 0xA0117B38 %long   0xEEF76087
data.set 0xA0117B3C %long   0x69843976
data.set 0xA0117B40 %long   0x97D16F59
data.set 0xA0117B44 %long   0xA748C8CE
data.set 0xA0117B48 %long   0x65ADFEA1
data.set 0xA0117B4C %long   0x2DF8D486
data.set 0xA0117B50 %long   0x44406B63
data.set 0xA0117B54 %long   0x62070B90
data.set 0xA0117B58 %long   0x4E4EEC2D
data.set 0xA0117B5C %long   0xB7FAB09E
data.set 0xA0117B60 %long   0x7841805C
data.set 0xA0117B64 %long   0x3FD7C10B
data.set 0xA0117B68 %long   0xCD598CB9
data.set 0xA0117B6C %long   0xD902B156
data.set 0xA0117B70 %long   0xAC931790
data.set 0xA0117B74 %long   0x4DFC2A57
data.set 0xA0117B78 %long   0x3AB739BC
data.set 0xA0117B7C %long   0x8D49372C
data.set 0xA0117B80 %long   0x41738EDF
data.set 0xA0117B84 %long   0xE0E3EECA
data.set 0xA0117B88 %long   0xFE1858C5
data.set 0xA0117B8C %long   0xEF5F4C45
data.set 0xA0117B90 %long   0xE0AF32F7
data.set 0xA0117B94 %long   0x1B0BA79F
data.set 0xA0117B98 %long   0xE0581D54
data.set 0xA0117B9C %long   0xCF2B08AC
data.set 0xA0117BA0 %long   0x5F7A60A5
data.set 0xA0117BA4 %long   0xA511EA7A
data.set 0xA0117BA8 %long   0x98DA96F7
data.set 0xA0117BAC %long   0x8F350228
data.set 0xA0117BB0 %long   0x71C993D5
data.set 0xA0117BB4 %long   0x9031D4E4
data.set 0xA0117BB8 %long   0xDC1ADDC6
data.set 0xA0117BBC %long   0x9F5CEB67
data.set 0xA0117BC0 %long   0xC658853A
data.set 0xA0117BC4 %long   0xDD82A501
data.set 0xA0117BC8 %long   0xB4210B03
data.set 0xA0117BCC %long   0x7135018E
data.set 0xA0117BD0 %long   0x6F3B5B9A
data.set 0xA0117BD4 %long   0x3B68A42B
data.set 0xA0117BD8 %long   0x446114F1
data.set 0xA0117BDC %long   0xCEB7011A
data.set 0xA0117BE0 %long   0x06914029
data.set 0xA0117BE4 %long   0xF17B787C
data.set 0xA0117BE8 %long   0x8E9C3A0F
data.set 0xA0117BEC %long   0x5F6C1C8C
data.set 0xA0117BF0 %long   0xCADFF0D5
data.set 0xA0117BF4 %long   0x8558F87A
data.set 0xA0117BF8 %long   0xBEA58AC0
data.set 0xA0117BFC %long   0x72F9B3B1
data.set 0xA0117C00 %long   0x5CBA04F9
data.set 0xA0117C04 %long   0x0E77AFC7
data.set 0xA0117C08 %long   0xCD49B62C
data.set 0xA0117C0C %long   0xEADE3227
data.set 0xA0117C10 %long   0x0775DFAA
data.set 0xA0117C14 %long   0x875DA250
data.set 0xA0117C18 %long   0xE6337D6C
data.set 0xA0117C1C %long   0xE5A44ED9
data.set 0xA0117C20 %long   0x162DA67D
data.set 0xA0117C24 %long   0x9D7071A4
data.set 0xA0117C28 %long   0xB2CC27E1
data.set 0xA0117C2C %long   0xB284EA8B
data.set 0xA0117C30 %long   0x4FE6C623
data.set 0xA0117C34 %long   0x492B95DC
data.set 0xA0117C38 %long   0xEB3B6C5B
data.set 0xA0117C3C %long   0xCD01FFC6
data.set 0xA0117C40 %long   0x3EB9BF78
data.set 0xA0117C44 %long   0x2108513A
data.set 0xA0117C48 %long   0x83E9EB4A
data.set 0xA0117C4C %long   0xBC3146D2
data.set 0xA0117C50 %long   0x55F77A00
data.set 0xA0117C54 %long   0x3421A5DB
data.set 0xA0117C58 %long   0x53A19831
data.set 0xA0117C5C %long   0x0F523498
data.set 0xA0117C60 %long   0xC443C3C1
data.set 0xA0117C64 %long   0x0DDB48A5
data.set 0xA0117C68 %long   0x71FB1B66
data.set 0xA0117C6C %long   0x36522864
data.set 0xA0117C70 %long   0x31FACD7A
data.set 0xA0117C74 %long   0x5CFF15F5
data.set 0xA0117C78 %long   0x94902681
data.set 0xA0117C7C %long   0xC58228F3
data.set 0xA0117C80 %long   0x9BF59F9D
data.set 0xA0117C84 %long   0x3C374263
data.set 0xA0117C88 %long   0xB27DE0DB
data.set 0xA0117C8C %long   0x99875473
data.set 0xA0117C90 %long   0x18696916
data.set 0xA0117C94 %long   0x9243A43E
data.set 0xA0117C98 %long   0x3A49EE89
data.set 0xA0117C9C %long   0x4DAE874B
data.set 0xA0117CA0 %long   0x2A868B95
data.set 0xA0117CA4 %long   0xB694FD05
data.set 0xA0117CA8 %long   0x1ADC85AD
data.set 0xA0117CAC %long   0x788D0E8B
data.set 0xA0117CB0 %long   0x2DE41C9F
data.set 0xA0117CB4 %long   0x966482BB
data.set 0xA0117CB8 %long   0xBAD878CF
data.set 0xA0117CBC %long   0x3FED074E
data.set 0xA0117CC0 %long   0x46EB6A8B
data.set 0xA0117CC4 %long   0x728CF664
data.set 0xA0117CC8 %long   0xECAF672C
data.set 0xA0117CCC %long   0x64215A45
data.set 0xA0117CD0 %long   0x9E2416B2
data.set 0xA0117CD4 %long   0xBEB2817D
data.set 0xA0117CD8 %long   0x02610C0C
data.set 0xA0117CDC %long   0x1AC3C74B
data.set 0xA0117CE0 %long   0xA47B8B9A
data.set 0xA0117CE4 %long   0x77133860
data.set 0xA0117CE8 %long   0x82000F31
data.set 0xA0117CEC %long   0x95A9601F
data.set 0xA0117CF0 %long   0xA03F34CB
data.set 0xA0117CF4 %long   0x16E7D4E9
data.set 0xA0117CF8 %long   0x0C10F1C7
data.set 0xA0117CFC %long   0xC975A651
data.set 0xA0117D00 %long   0xF67F2E50
data.set 0xA0117D04 %long   0xDE8D0BA2
data.set 0xA0117D08 %long   0xDEDD1AE7
data.set 0xA0117D0C %long   0x53D04B6E
data.set 0xA0117D10 %long   0xF959F909
data.set 0xA0117D14 %long   0x27EFD54F
data.set 0xA0117D18 %long   0xFEE22F9F
data.set 0xA0117D1C %long   0x41864866
data.set 0xA0117D20 %long   0x7E6A2BD8
data.set 0xA0117D24 %long   0x0AFF9800
data.set 0xA0117D28 %long   0x33F79A6F
data.set 0xA0117D2C %long   0x762116B7
data.set 0xA0117D30 %long   0x76572B37
data.set 0xA0117D34 %long   0xE5F87EBF
data.set 0xA0117D38 %long   0x511AE200
data.set 0xA0117D3C %long   0x37226DCA
data.set 0xA0117D40 %long   0x501005EE
data.set 0xA0117D44 %long   0x45E52EE2
data.set 0xA0117D48 %long   0xF4B28C63
data.set 0xA0117D4C %long   0xC1CC78BB
data.set 0xA0117D50 %long   0xCB14D8DC
data.set 0xA0117D54 %long   0x59FC2E08
data.set 0xA0117D58 %long   0xB64E7EB1
data.set 0xA0117D5C %long   0xB53EA2C2
data.set 0xA0117D60 %long   0x2BD07D47
data.set 0xA0117D64 %long   0x117D8F16
data.set 0xA0117D68 %long   0x2E724A3F
data.set 0xA0117D6C %long   0x33E13696
data.set 0xA0117D70 %long   0xA9CFC12B
data.set 0xA0117D74 %long   0x6225C709
data.set 0xA0117D78 %long   0xB206D1D1
data.set 0xA0117D7C %long   0x2DA02B49
data.set 0xA0117D80 %long   0xCA4A52BA
data.set 0xA0117D84 %long   0x418334D9
data.set 0xA0117D88 %long   0x7D093D52
data.set 0xA0117D8C %long   0xBCA7EEA9
data.set 0xA0117D90 %long   0x50D6B3BC
data.set 0xA0117D94 %long   0xA9DA11AB
data.set 0xA0117D98 %long   0x0B553A46
data.set 0xA0117D9C %long   0x2C40FA94
data.set 0xA0117DA0 %long   0x07912419
data.set 0xA0117DA4 %long   0xBF9EA8AF
data.set 0xA0117DA8 %long   0xA8B66645
data.set 0xA0117DAC %long   0xE26D130F
data.set 0xA0117DB0 %long   0xAB037FCC
data.set 0xA0117DB4 %long   0xC95BE426
data.set 0xA0117DB8 %long   0xE9D17280
data.set 0xA0117DBC %long   0x15C4F137
data.set 0xA0117DC0 %long   0xCED69E75
data.set 0xA0117DC4 %long   0xCC27138E
data.set 0xA0117DC8 %long   0x0CD1E640
data.set 0xA0117DCC %long   0xE85C2173
data.set 0xA0117DD0 %long   0x54D33190
data.set 0xA0117DD4 %long   0x1201228A
data.set 0xA0117DD8 %long   0xF51BD8A9
data.set 0xA0117DDC %long   0x03A10E24
data.set 0xA0117DE0 %long   0x38643237
data.set 0xA0117DE4 %long   0xD0D68099
data.set 0xA0117DE8 %long   0x03AA26E6
data.set 0xA0117DEC %long   0x4CBA72EC
data.set 0xA0117DF0 %long   0x0F60180D
data.set 0xA0117DF4 %long   0x0A238F04
data.set 0xA0117DF8 %long   0x4FE8BEE4
data.set 0xA0117DFC %long   0xBD302FB2
data.set 0xA0117E00 %long   0xF92157D3
data.set 0xA0117E04 %long   0xDEA1B59B
data.set 0xA0117E08 %long   0x0424992E
data.set 0xA0117E0C %long   0x547DA3D0
data.set 0xA0117E10 %long   0xB5F2B22B
data.set 0xA0117E14 %long   0x0EBEFDEF
data.set 0xA0117E18 %long   0xA443F4A9
data.set 0xA0117E1C %long   0x9DAB341D
data.set 0xA0117E20 %long   0x3BF6D431
data.set 0xA0117E24 %long   0xA5C346D6
data.set 0xA0117E28 %long   0xAB340E09
data.set 0xA0117E2C %long   0x537198FD
data.set 0xA0117E30 %long   0xBCF2A867
data.set 0xA0117E34 %long   0x70787616
data.set 0xA0117E38 %long   0xEB71DB2F
data.set 0xA0117E3C %long   0x7A3A894C
data.set 0xA0117E40 %long   0x26F1513B
data.set 0xA0117E44 %long   0x7AB30154
data.set 0xA0117E48 %long   0x24724C8A
data.set 0xA0117E4C %long   0xFEECFBAB
data.set 0xA0117E50 %long   0x90376700
data.set 0xA0117E54 %long   0xF6BE9931
data.set 0xA0117E58 %long   0xC2701578
data.set 0xA0117E5C %long   0x4FCF3CEC
data.set 0xA0117E60 %long   0xBE6886D5
data.set 0xA0117E64 %long   0x89B165B1
data.set 0xA0117E68 %long   0x4D2DBE53
data.set 0xA0117E6C %long   0x5EAA0742
data.set 0xA0117E70 %long   0xAE49312F
data.set 0xA0117E74 %long   0xB13AE91A
data.set 0xA0117E78 %long   0x7C5AEA78
data.set 0xA0117E7C %long   0x657B5B3C
data.set 0xA0117E80 %long   0x6AB4DF8C
data.set 0xA0117E84 %long   0x80BD7CA5
data.set 0xA0117E88 %long   0x1E70FD3D
data.set 0xA0117E8C %long   0xED63296D
data.set 0xA0117E90 %long   0x9B92B40F
data.set 0xA0117E94 %long   0x90FAF7A4
data.set 0xA0117E98 %long   0x5353321D
data.set 0xA0117E9C %long   0x8E30779D
data.set 0xA0117EA0 %long   0xFB1A0608
data.set 0xA0117EA4 %long   0x7B1DEF60
data.set 0xA0117EA8 %long   0x56D8DBC5
data.set 0xA0117EAC %long   0x7E440849
data.set 0xA0117EB0 %long   0x58C55F81
data.set 0xA0117EB4 %long   0x2A51DDAE
data.set 0xA0117EB8 %long   0x55F0F9C4
data.set 0xA0117EBC %long   0xD3EBD555
data.set 0xA0117EC0 %long   0xE1411737
data.set 0xA0117EC4 %long   0xC2D2340D
data.set 0xA0117EC8 %long   0x3C96A613
data.set 0xA0117ECC %long   0xF455EA21
data.set 0xA0117ED0 %long   0x6699A374
data.set 0xA0117ED4 %long   0xBA7879C3
data.set 0xA0117ED8 %long   0xF1C14F38
data.set 0xA0117EDC %long   0xD496C210
data.set 0xA0117EE0 %long   0x6D3F96D7
data.set 0xA0117EE4 %long   0x7C7B8725
data.set 0xA0117EE8 %long   0x83359E2D
data.set 0xA0117EEC %long   0x16AD32EC
data.set 0xA0117EF0 %long   0xD2B6316F
data.set 0xA0117EF4 %long   0x7D2292A1
data.set 0xA0117EF8 %long   0x98962190
data.set 0xA0117EFC %long   0xD61A8C41
data.set 0xA0117F00 %long   0x27E38952
data.set 0xA0117F04 %long   0x4A8B6B44
data.set 0xA0117F08 %long   0x75A18987
data.set 0xA0117F0C %long   0xABD81CD6
data.set 0xA0117F10 %long   0x06598EB0
data.set 0xA0117F14 %long   0x98372141
data.set 0xA0117F18 %long   0xDCCB5C59
data.set 0xA0117F1C %long   0x976156B1
data.set 0xA0117F20 %long   0xAB1650DB
data.set 0xA0117F24 %long   0x1E168AD0
data.set 0xA0117F28 %long   0x9AE0CD37
data.set 0xA0117F2C %long   0x9FDBD5EF
data.set 0xA0117F30 %long   0xB9BBA17A
data.set 0xA0117F34 %long   0xFC08C1AC
data.set 0xA0117F38 %long   0x006C6B5E
data.set 0xA0117F3C %long   0xC05556CB
data.set 0xA0117F40 %long   0x68680A23
data.set 0xA0117F44 %long   0xFF8EC28B
data.set 0xA0117F48 %long   0xE8249E73
data.set 0xA0117F4C %long   0xAE0EF940
data.set 0xA0117F50 %long   0x01734AE8
data.set 0xA0117F54 %long   0x752AAD6F
data.set 0xA0117F58 %long   0xD8E45310
data.set 0xA0117F5C %long   0xEDDB7BC8
data.set 0xA0117F60 %long   0x4604A814
data.set 0xA0117F64 %long   0xCA1A4A24
data.set 0xA0117F68 %long   0x0A5BA23A
data.set 0xA0117F6C %long   0x805EED85
data.set 0xA0117F70 %long   0xD277C91A
data.set 0xA0117F74 %long   0x2BAEB423
data.set 0xA0117F78 %long   0x3BD94C70
data.set 0xA0117F7C %long   0xC5B7EE58
data.set 0xA0117F80 %long   0x42F44D0D
data.set 0xA0117F84 %long   0x3DC7E4FA
data.set 0xA0117F88 %long   0xDE11510B
data.set 0xA0117F8C %long   0x49B828C5
data.set 0xA0117F90 %long   0xE820CFBE
data.set 0xA0117F94 %long   0x34C14674
data.set 0xA0117F98 %long   0x5C1480DF
data.set 0xA0117F9C %long   0xEA7D6553
data.set 0xA0117FA0 %long   0x499473A6
data.set 0xA0117FA4 %long   0x75601264
data.set 0xA0117FA8 %long   0x628D8A7D
data.set 0xA0117FAC %long   0x4B375AA7
data.set 0xA0117FB0 %long   0xCC965267
data.set 0xA0117FB4 %long   0x5714059D
data.set 0xA0117FB8 %long   0x27E2BEB3
data.set 0xA0117FBC %long   0x94BA760E
data.set 0xA0117FC0 %long   0xA37402D3
data.set 0xA0117FC4 %long   0xFCF28C2D
data.set 0xA0117FC8 %long   0xBE8AE3E1
data.set 0xA0117FCC %long   0xD846BBA5
data.set 0xA0117FD0 %long   0xC9944CEC
data.set 0xA0117FD4 %long   0xCA9607D4
data.set 0xA0117FD8 %long   0xE6C573A5
data.set 0xA0117FDC %long   0x42CFDAB5
data.set 0xA0117FE0 %long   0xCA097A7E
data.set 0xA0117FE4 %long   0x5C527490
data.set 0xA0117FE8 %long   0xB6125E32
data.set 0xA0117FEC %long   0x8E370B91
data.set 0xA0117FF0 %long   0x76AD12F7
data.set 0xA0117FF4 %long   0xE7EF4AC4
data.set 0xA0117FF8 %long   0x549C1E51
data.set 0xA0117FFC %long   0x61553751
data.set 0xA0118000 %long   0x34D65632
data.set 0xA0118004 %long   0xFC4738C5
data.set 0xA0118008 %long   0x65FC1FB1
data.set 0xA011800C %long   0xEE354E88
data.set 0xA0118010 %long   0x5F5FFAC1
data.set 0xA0118014 %long   0x47F37DC1
data.set 0xA0118018 %long   0xEC2AE869
data.set 0xA011801C %long   0x8692FFE0
data.set 0xA0118020 %long   0x7A1D6D08
data.set 0xA0118024 %long   0x21083F5A
data.set 0xA0118028 %long   0xE2691AA2
data.set 0xA011802C %long   0x9A483650
data.set 0xA0118030 %long   0xA7AE0D07
data.set 0xA0118034 %long   0xA83EB521
data.set 0xA0118038 %long   0xBDE113E1
data.set 0xA011803C %long   0x95CCE324
data.set 0xA0118040 %long   0x7091B191
data.set 0xA0118044 %long   0xF6711D62
data.set 0xA0118048 %long   0x5728FC94
data.set 0xA011804C %long   0x4A48094B
data.set 0xA0118050 %long   0xD185D29D
data.set 0xA0118054 %long   0x3250F752
data.set 0xA0118058 %long   0x2820E7AE
data.set 0xA011805C %long   0xF4845587
data.set 0xA0118060 %long   0x20687DD8
data.set 0xA0118064 %long   0xE19D08FB
data.set 0xA0118068 %long   0x2525547C
data.set 0xA011806C %long   0xB1181C0F
data.set 0xA0118070 %long   0xEC20046C
data.set 0xA0118074 %long   0x2BC21D04
data.set 0xA0118078 %long   0xD5C7C2DF
data.set 0xA011807C %long   0x3D0BF61B
data.set 0xA0118080 %long   0x6399D8A5
data.set 0xA0118084 %long   0x1C9E2C41
data.set 0xA0118088 %long   0x98BE4B64
data.set 0xA011808C %long   0xC0ED04C9
data.set 0xA0118090 %long   0x78FB7EE7
data.set 0xA0118094 %long   0x873AB583
data.set 0xA0118098 %long   0xAA00D49F
data.set 0xA011809C %long   0xE67BACC9
data.set 0xA01180A0 %long   0x04C977EA
data.set 0xA01180A4 %long   0x50B8242F
data.set 0xA01180A8 %long   0x921E0701
data.set 0xA01180AC %long   0x152C45B9
data.set 0xA01180B0 %long   0xB77DB193
data.set 0xA01180B4 %long   0x9E7020CB
data.set 0xA01180B8 %long   0xB32BB4FC
data.set 0xA01180BC %long   0x4D13E0C1
data.set 0xA01180C0 %long   0x240F9181
data.set 0xA01180C4 %long   0x1E33D564
data.set 0xA01180C8 %long   0x314DBFB6
data.set 0xA01180CC %long   0x562728DF
data.set 0xA01180D0 %long   0xA07E51F1
data.set 0xA01180D4 %long   0x5AE885E7
data.set 0xA01180D8 %long   0x2DBBA7DC
data.set 0xA01180DC %long   0xBBCC4FD9
data.set 0xA01180E0 %long   0x56986C9E
data.set 0xA01180E4 %long   0x9E1C4401
data.set 0xA01180E8 %long   0x9C49CF74
data.set 0xA01180EC %long   0xFC145E5E
data.set 0xA01180F0 %long   0xCEC5F35C
data.set 0xA01180F4 %long   0xE8C5449E
data.set 0xA01180F8 %long   0x00930D32
data.set 0xA01180FC %long   0xB339046D
data.set 0xA0118100 %long   0x9BBA11A3
data.set 0xA0118104 %long   0x3CCF3256
data.set 0xA0118108 %long   0x36FFEF9F
data.set 0xA011810C %long   0x561EF558
data.set 0xA0118110 %long   0x489E16E4
data.set 0xA0118114 %long   0x5CCF418D
data.set 0xA0118118 %long   0x0849D92B
data.set 0xA011811C %long   0x374EE304
data.set 0xA0118120 %long   0x9BB1560F
data.set 0xA0118124 %long   0xAAD3C2A8
data.set 0xA0118128 %long   0x252E1ABF
data.set 0xA011812C %long   0x4A9339FE
data.set 0xA0118130 %long   0x784AF155
data.set 0xA0118134 %long   0xD5CFDDAA
data.set 0xA0118138 %long   0xD2C170B9
data.set 0xA011813C %long   0xFF99E50E
data.set 0xA0118140 %long   0xD305FFA2
data.set 0xA0118144 %long   0x48820BAD
data.set 0xA0118148 %long   0xB171C272
data.set 0xA011814C %long   0xB67B0F42
data.set 0xA0118150 %long   0x6076080D
data.set 0xA0118154 %long   0x4E7D4F24
data.set 0xA0118158 %long   0xB6ABC84E
data.set 0xA011815C %long   0x62462606
data.set 0xA0118160 %long   0x8BDFC24C
data.set 0xA0118164 %long   0x5E4CCE02
data.set 0xA0118168 %long   0xDD36ACFA
data.set 0xA011816C %long   0x1BE00896
data.set 0xA0118170 %long   0x30172232
data.set 0xA0118174 %long   0x1E0B2324
data.set 0xA0118178 %long   0x71F2CF16
data.set 0xA011817C %long   0x7D9D3181
data.set 0xA0118180 %long   0x9E4E54A7
data.set 0xA0118184 %long   0x25EF7DE2
data.set 0xA0118188 %long   0x692F2B90
data.set 0xA011818C %long   0x9FE6731B
data.set 0xA0118190 %long   0x9074DED5
data.set 0xA0118194 %long   0x112F5158
data.set 0xA0118198 %long   0xA874558B
data.set 0xA011819C %long   0x5B84B490
data.set 0xA01181A0 %long   0x11DFB991
data.set 0xA01181A4 %long   0x68F870AC
data.set 0xA01181A8 %long   0x73A65FC6
data.set 0xA01181AC %long   0x3E49BE70
data.set 0xA01181B0 %long   0xD966555E
data.set 0xA01181B4 %long   0x3781C07E
data.set 0xA01181B8 %long   0x79F96AF4
data.set 0xA01181BC %long   0x001FC76C
data.set 0xA01181C0 %long   0x470DFF8B
data.set 0xA01181C4 %long   0x9DB8B26C
data.set 0xA01181C8 %long   0x764DDF31
data.set 0xA01181CC %long   0xA8C3EF79
data.set 0xA01181D0 %long   0x09288C7D
data.set 0xA01181D4 %long   0x25408CA5
data.set 0xA01181D8 %long   0x27536CFD
data.set 0xA01181DC %long   0x58B603D3
data.set 0xA01181E0 %long   0x5B81C22E
data.set 0xA01181E4 %long   0xD1423CD4
data.set 0xA01181E8 %long   0xB9AB1448
data.set 0xA01181EC %long   0x59E9CE34
data.set 0xA01181F0 %long   0xE323C177
data.set 0xA01181F4 %long   0x00F3B96A
data.set 0xA01181F8 %long   0xA4777B27
data.set 0xA01181FC %long   0xE318B5AC
data.set 0xA0118200 %long   0x5EC4CFE6
data.set 0xA0118204 %long   0x172354B6
data.set 0xA0118208 %long   0x7406D7A2
data.set 0xA011820C %long   0xED03B76C
data.set 0xA0118210 %long   0xE38AB3A0
data.set 0xA0118214 %long   0x870DD4C7
data.set 0xA0118218 %long   0x9819BC0A
data.set 0xA011821C %long   0x6559C113
data.set 0xA0118220 %long   0xD59E93AB
data.set 0xA0118224 %long   0xA42F91DE
data.set 0xA0118228 %long   0xD0796007
data.set 0xA011822C %long   0xC0A190B5
data.set 0xA0118230 %long   0xD792EE15
data.set 0xA0118234 %long   0x0ADEA680
data.set 0xA0118238 %long   0x0FE51AA7
data.set 0xA011823C %long   0xCC508387
data.set 0xA0118240 %long   0xA9B231A4
data.set 0xA0118244 %long   0x0F3A0489
data.set 0xA0118248 %long   0x2E5E42D7
data.set 0xA011824C %long   0x4B2807A7
data.set 0xA0118250 %long   0xAF8745EE
data.set 0xA0118254 %long   0xBDD38914
data.set 0xA0118258 %long   0xBF4BCBCC
data.set 0xA011825C %long   0xC9980AEA
data.set 0xA0118260 %long   0xCAB1D68D
data.set 0xA0118264 %long   0x36896705
data.set 0xA0118268 %long   0xBAE95F48
data.set 0xA011826C %long   0x7D340BA5
data.set 0xA0118270 %long   0x0437893E
data.set 0xA0118274 %long   0x75771070
data.set 0xA0118278 %long   0x75D8168D
data.set 0xA011827C %long   0x43BB7B8B
data.set 0xA0118280 %long   0x1AD55B3C
data.set 0xA0118284 %long   0x9A793BBF
data.set 0xA0118288 %long   0x0A23A06F
data.set 0xA011828C %long   0x6D1D76C5
data.set 0xA0118290 %long   0x18E455A6
data.set 0xA0118294 %long   0x6ABB33C9
data.set 0xA0118298 %long   0x33C51510
data.set 0xA011829C %long   0x80616E9A
data.set 0xA01182A0 %long   0x866CC93B
data.set 0xA01182A4 %long   0xDE23478B
data.set 0xA01182A8 %long   0x93AF444A
data.set 0xA01182AC %long   0x4B2A9C1B
data.set 0xA01182B0 %long   0xFE24EFC7
data.set 0xA01182B4 %long   0xB4F1997E
data.set 0xA01182B8 %long   0x85CBD2ED
data.set 0xA01182BC %long   0xF34D89B0
data.set 0xA01182C0 %long   0x45FB979E
data.set 0xA01182C4 %long   0x75FCEA09
data.set 0xA01182C8 %long   0xC7306D83
data.set 0xA01182CC %long   0x6D2342AF
data.set 0xA01182D0 %long   0x3B87FFD6
data.set 0xA01182D4 %long   0x0510B97A
data.set 0xA01182D8 %long   0xB29B4B68
data.set 0xA01182DC %long   0x26F4B26E
data.set 0xA01182E0 %long   0xA9802270
data.set 0xA01182E4 %long   0x2D4EA858
data.set 0xA01182E8 %long   0xCE57327B
data.set 0xA01182EC %long   0x1F489458
data.set 0xA01182F0 %long   0xCB1C2D0A
data.set 0xA01182F4 %long   0x12583DE1
data.set 0xA01182F8 %long   0x20EBC58A
data.set 0xA01182FC %long   0x178C60D5
data.set 0xA0118300 %long   0xA931B77B
data.set 0xA0118304 %long   0xEA1043BB
data.set 0xA0118308 %long   0xB882DB95
data.set 0xA011830C %long   0x77A1D276
data.set 0xA0118310 %long   0x7AA58E8A
data.set 0xA0118314 %long   0x51DACC5C
data.set 0xA0118318 %long   0xE5B042CC
data.set 0xA011831C %long   0xD024C1FA
data.set 0xA0118320 %long   0xEA71114C
data.set 0xA0118324 %long   0xA934A806
data.set 0xA0118328 %long   0x0077DA7F
data.set 0xA011832C %long   0x9E6BDC12
data.set 0xA0118330 %long   0x237665D1
data.set 0xA0118334 %long   0x7B9A45CB
data.set 0xA0118338 %long   0x2AD68C48
data.set 0xA011833C %long   0x69C4D33A
data.set 0xA0118340 %long   0x17C0183C
data.set 0xA0118344 %long   0x20C0FF75
data.set 0xA0118348 %long   0x6870902C
data.set 0xA011834C %long   0x7973D847
data.set 0xA0118350 %long   0x5369F0A3
data.set 0xA0118354 %long   0x3195CD16
data.set 0xA0118358 %long   0x260D0FFF
data.set 0xA011835C %long   0xF94A8B43
data.set 0xA0118360 %long   0x7A3E809B
data.set 0xA0118364 %long   0xABD00BE5
data.set 0xA0118368 %long   0xFE95B50D
data.set 0xA011836C %long   0x47A3C439
data.set 0xA0118370 %long   0x3B14EA5F
data.set 0xA0118374 %long   0x0F9730E0
data.set 0xA0118378 %long   0x10EE5CFF
data.set 0xA011837C %long   0xFABAF352
data.set 0xA0118380 %long   0x71ED09AC
data.set 0xA0118384 %long   0x6F1F459C
data.set 0xA0118388 %long   0x896ED6D4
data.set 0xA011838C %long   0xAD8A4224
data.set 0xA0118390 %long   0x54EE4AF7
data.set 0xA0118394 %long   0xE1920BB1
data.set 0xA0118398 %long   0xAF72BF3D
data.set 0xA011839C %long   0xDD8D6783
data.set 0xA01183A0 %long   0x44D85062
data.set 0xA01183A4 %long   0x816CF856
data.set 0xA01183A8 %long   0xB4976798
data.set 0xA01183AC %long   0x8A8277C0
data.set 0xA01183B0 %long   0xB3DCA849
data.set 0xA01183B4 %long   0x35A4A523
data.set 0xA01183B8 %long   0xB42B2421
data.set 0xA01183BC %long   0x20A0C772
data.set 0xA01183C0 %long   0xEF4BDFEF
data.set 0xA01183C4 %long   0x4ECBFB73
data.set 0xA01183C8 %long   0x85FCADB3
data.set 0xA01183CC %long   0xB76AAC1B
data.set 0xA01183D0 %long   0xF900DC7E
data.set 0xA01183D4 %long   0x0A9D3636
data.set 0xA01183D8 %long   0x1414E8B8
data.set 0xA01183DC %long   0x4CB22677
data.set 0xA01183E0 %long   0xF1435D30
data.set 0xA01183E4 %long   0xB89F76EB
data.set 0xA01183E8 %long   0x69EA7BF7
data.set 0xA01183EC %long   0xB00B8362
data.set 0xA01183F0 %long   0x2AB101CA
data.set 0xA01183F4 %long   0x9C8A40CD
data.set 0xA01183F8 %long   0x0739890B
data.set 0xA01183FC %long   0x947EB2C8
data.set 0xA0118400 %long   0x702A5352
data.set 0xA0118404 %long   0x5B970773
data.set 0xA0118408 %long   0x5DD68E5E
data.set 0xA011840C %long   0x467C01E1
data.set 0xA0118410 %long   0xDE838B1A
data.set 0xA0118414 %long   0xD610C218
data.set 0xA0118418 %long   0x69CCC867
data.set 0xA011841C %long   0x10D861E4
data.set 0xA0118420 %long   0x9C109315
data.set 0xA0118424 %long   0x6D5A34DC
data.set 0xA0118428 %long   0xD5F77B1E
data.set 0xA011842C %long   0xE6DD0698
data.set 0xA0118430 %long   0x87E1FFCC
data.set 0xA0118434 %long   0x6965A3C3
data.set 0xA0118438 %long   0x34E7DFC6
data.set 0xA011843C %long   0x66733AFD
data.set 0xA0118440 %long   0xAF88AC76
data.set 0xA0118444 %long   0xC2B044FD
data.set 0xA0118448 %long   0x8B37CB07
data.set 0xA011844C %long   0x804F0990
data.set 0xA0118450 %long   0x3D326B97
data.set 0xA0118454 %long   0x806B2378
data.set 0xA0118458 %long   0x2A7622F6
data.set 0xA011845C %long   0x8DAB4F32
data.set 0xA0118460 %long   0xA49384B1
data.set 0xA0118464 %long   0x15C04623
data.set 0xA0118468 %long   0x8BB5C5FF
data.set 0xA011846C %long   0xECB11F04
data.set 0xA0118470 %long   0x76B7F2FE
data.set 0xA0118474 %long   0x00108101
data.set 0xA0118478 %long   0x19BBE0CD
data.set 0xA011847C %long   0x1665F204
data.set 0xA0118480 %long   0xB331462B
data.set 0xA0118484 %long   0x6A9114F0
data.set 0xA0118488 %long   0x607FE163
data.set 0xA011848C %long   0x770B79A9
data.set 0xA0118490 %long   0xF99E877C
data.set 0xA0118494 %long   0x973FF597
data.set 0xA0118498 %long   0x14E8379E
data.set 0xA011849C %long   0x1D2CDAB4
data.set 0xA01184A0 %long   0x99382333
data.set 0xA01184A4 %long   0xDFC7B619
data.set 0xA01184A8 %long   0x4EE3A0C3
data.set 0xA01184AC %long   0xC02EF982
data.set 0xA01184B0 %long   0xEE316FDD
data.set 0xA01184B4 %long   0x40860CDF
data.set 0xA01184B8 %long   0x2F7DC032
data.set 0xA01184BC %long   0x0E1A74C6
data.set 0xA01184C0 %long   0xC77CF24A
data.set 0xA01184C4 %long   0xDD912A89
data.set 0xA01184C8 %long   0x73D45CDE
data.set 0xA01184CC %long   0xE2D8D133
data.set 0xA01184D0 %long   0x85093B2D
data.set 0xA01184D4 %long   0x4993C4DD
data.set 0xA01184D8 %long   0x138A98A6
data.set 0xA01184DC %long   0xBDF6546C
data.set 0xA01184E0 %long   0xF3C43DE1
data.set 0xA01184E4 %long   0x36CE7DD9
data.set 0xA01184E8 %long   0xA3A79C84
data.set 0xA01184EC %long   0x1A663390
data.set 0xA01184F0 %long   0x6F95B1A4
data.set 0xA01184F4 %long   0xB702B91B
data.set 0xA01184F8 %long   0x3969979D
data.set 0xA01184FC %long   0x42F5E8CC
data.set 0xA0118500 %long   0xA40BC6C6
data.set 0xA0118504 %long   0x17289D51
data.set 0xA0118508 %long   0xF03320DB
data.set 0xA011850C %long   0x6B4505E1
data.set 0xA0118510 %long   0x98FCBC47
data.set 0xA0118514 %long   0xE07C88C9
data.set 0xA0118518 %long   0xEA10E286
data.set 0xA011851C %long   0x22B42AFB
data.set 0xA0118520 %long   0x0D88D9B4
data.set 0xA0118524 %long   0xC9B8529E
data.set 0xA0118528 %long   0x96805DC1
data.set 0xA011852C %long   0x53511C9A
data.set 0xA0118530 %long   0x4388FFB2
data.set 0xA0118534 %long   0x67E6974B
data.set 0xA0118538 %long   0x094C3397
data.set 0xA011853C %long   0xF28EDCD6
data.set 0xA0118540 %long   0x4AD0ABE9
data.set 0xA0118544 %long   0x846A49F6
data.set 0xA0118548 %long   0xC4F629CD
data.set 0xA011854C %long   0x1B2EDBF0
data.set 0xA0118550 %long   0x861915EB
data.set 0xA0118554 %long   0x5E3D2BAC
data.set 0xA0118558 %long   0xF5FF8806
data.set 0xA011855C %long   0x35CAEFFA
data.set 0xA0118560 %long   0x0DBB6D50
data.set 0xA0118564 %long   0x63806225
data.set 0xA0118568 %long   0x663840B9
data.set 0xA011856C %long   0xE7C8242B
data.set 0xA0118570 %long   0x56CE4382
data.set 0xA0118574 %long   0xA7E9DC99
data.set 0xA0118578 %long   0xA5D88CC8
data.set 0xA011857C %long   0x1544528C
data.set 0xA0118580 %long   0xDEE69CB2
data.set 0xA0118584 %long   0x3BD108E3
data.set 0xA0118588 %long   0xA16E3F5A
data.set 0xA011858C %long   0x1DB4FD93
data.set 0xA0118590 %long   0x74977CFA
data.set 0xA0118594 %long   0xFA9BDF36
data.set 0xA0118598 %long   0xC89FC6FF
data.set 0xA011859C %long   0x1D9527C2
data.set 0xA01185A0 %long   0x4DEE6D4C
data.set 0xA01185A4 %long   0x7A8A6912
data.set 0xA01185A8 %long   0x297C969A
data.set 0xA01185AC %long   0x8EEEAE5B
data.set 0xA01185B0 %long   0x3CC9D696
data.set 0xA01185B4 %long   0xB23C33A4
data.set 0xA01185B8 %long   0x1A6E4CDF
data.set 0xA01185BC %long   0xF56893E5
data.set 0xA01185C0 %long   0xC67CEE37
data.set 0xA01185C4 %long   0xB8A1EDE6
data.set 0xA01185C8 %long   0x8DEF5C88
data.set 0xA01185CC %long   0x86950C23
data.set 0xA01185D0 %long   0xBAE5E2BD
data.set 0xA01185D4 %long   0x193A95B3
data.set 0xA01185D8 %long   0x56D0AC17
data.set 0xA01185DC %long   0x51906117
data.set 0xA01185E0 %long   0x0F442F1E
data.set 0xA01185E4 %long   0xC6554E6A
data.set 0xA01185E8 %long   0x2EF993CF
data.set 0xA01185EC %long   0xBEE8F149
data.set 0xA01185F0 %long   0xAA536FB5
data.set 0xA01185F4 %long   0xF43122EF
data.set 0xA01185F8 %long   0x92D75BCC
data.set 0xA01185FC %long   0x3F7981A4
data.set 0xA0118600 %long   0x940F142E
data.set 0xA0118604 %long   0xC9DD9795
data.set 0xA0118608 %long   0x89213DE5
data.set 0xA011860C %long   0xCD95CCF3
data.set 0xA0118610 %long   0x131132E5
data.set 0xA0118614 %long   0x0C9CF7C8
data.set 0xA0118618 %long   0xA9ECFE40
data.set 0xA011861C %long   0xB41A5A89
data.set 0xA0118620 %long   0x1EB439AC
data.set 0xA0118624 %long   0xFCAA4DCB
data.set 0xA0118628 %long   0xB207D565
data.set 0xA011862C %long   0x26DC30D6
data.set 0xA0118630 %long   0xE4A11AB2
data.set 0xA0118634 %long   0x112DDBFF
data.set 0xA0118638 %long   0x3FF3DDBE
data.set 0xA011863C %long   0x8539C15C
data.set 0xA0118640 %long   0x09D3043E
data.set 0xA0118644 %long   0xA11AC4CB
data.set 0xA0118648 %long   0x8391EAC8
data.set 0xA011864C %long   0x4ACE9DCA
data.set 0xA0118650 %long   0x6821384F
data.set 0xA0118654 %long   0xC8CF3E4A
data.set 0xA0118658 %long   0xEC6FC98C
data.set 0xA011865C %long   0x076EEECB
data.set 0xA0118660 %long   0xB7128426
data.set 0xA0118664 %long   0x294BD3C0
data.set 0xA0118668 %long   0x4756CA1A
data.set 0xA011866C %long   0x42DEEB7B
data.set 0xA0118670 %long   0xFD80D6E5
data.set 0xA0118674 %long   0xB0DBFA31
data.set 0xA0118678 %long   0xE003B362
data.set 0xA011867C %long   0xF6C66553
data.set 0xA0118680 %long   0x73F45924
data.set 0xA0118684 %long   0xD413C83F
data.set 0xA0118688 %long   0xF85F4E43
data.set 0xA011868C %long   0x11D8F02F
data.set 0xA0118690 %long   0x13085DFC
data.set 0xA0118694 %long   0x23148F1E
data.set 0xA0118698 %long   0x37E9BD9C
data.set 0xA011869C %long   0xEE6C938C
data.set 0xA01186A0 %long   0xA830D41D
data.set 0xA01186A4 %long   0xED1CC72D
data.set 0xA01186A8 %long   0x8DF8B376
data.set 0xA01186AC %long   0x3FB47F79
data.set 0xA01186B0 %long   0x9C26703B
data.set 0xA01186B4 %long   0x1C22B2B0
data.set 0xA01186B8 %long   0xFB34B716
data.set 0xA01186BC %long   0x1760E030
data.set 0xA01186C0 %long   0xE5692936
data.set 0xA01186C4 %long   0x896612A0
data.set 0xA01186C8 %long   0x7EAA84FD
data.set 0xA01186CC %long   0x815BC2DF
data.set 0xA01186D0 %long   0x8522EA5D
data.set 0xA01186D4 %long   0x5D8AE899
data.set 0xA01186D8 %long   0xE7526DCE
data.set 0xA01186DC %long   0x221FE1A3
data.set 0xA01186E0 %long   0xAAE70C74
data.set 0xA01186E4 %long   0x57F0B6B3
data.set 0xA01186E8 %long   0xF45A1286
data.set 0xA01186EC %long   0x0139CB75
data.set 0xA01186F0 %long   0x89D93ACF
data.set 0xA01186F4 %long   0xCEE53819
data.set 0xA01186F8 %long   0x53A3C27F
data.set 0xA01186FC %long   0xA28F9D97
data.set 0xA0118700 %long   0xA3D2F65A
data.set 0xA0118704 %long   0xFD952712
data.set 0xA0118708 %long   0x8547253F
data.set 0xA011870C %long   0x5E531AED
data.set 0xA0118710 %long   0xCEEBA9AE
data.set 0xA0118714 %long   0x36737643
data.set 0xA0118718 %long   0x33411785
data.set 0xA011871C %long   0x1666BA38
data.set 0xA0118720 %long   0x45A8DBE7
data.set 0xA0118724 %long   0xFADD0732
data.set 0xA0118728 %long   0x9BF8F647
data.set 0xA011872C %long   0x4B4A47DF
data.set 0xA0118730 %long   0x66481D0B
data.set 0xA0118734 %long   0xEEB52296
data.set 0xA0118738 %long   0x79F26755
data.set 0xA011873C %long   0x23AF14A8
data.set 0xA0118740 %long   0x7C3B5283
data.set 0xA0118744 %long   0x345B028B
data.set 0xA0118748 %long   0x4DDBC386
data.set 0xA011874C %long   0xBF8DC62F
data.set 0xA0118750 %long   0x77020047
data.set 0xA0118754 %long   0x661F304E
data.set 0xA0118758 %long   0x9B456DFE
data.set 0xA011875C %long   0x66AF3C0E
data.set 0xA0118760 %long   0x4E65C54F
data.set 0xA0118764 %long   0x1E6EE97F
data.set 0xA0118768 %long   0xEEADF6D5
data.set 0xA011876C %long   0x1F508F87
data.set 0xA0118770 %long   0x1C63D29D
data.set 0xA0118774 %long   0x5A87597A
data.set 0xA0118778 %long   0xEDC66D09
data.set 0xA011877C %long   0x2032FD65
data.set 0xA0118780 %long   0xF4959D71
data.set 0xA0118784 %long   0x92289ABA
data.set 0xA0118788 %long   0x532070B1
data.set 0xA011878C %long   0xA217C93D
data.set 0xA0118790 %long   0x65CB9ACD
data.set 0xA0118794 %long   0xBA8CEF05
data.set 0xA0118798 %long   0x0D842727
data.set 0xA011879C %long   0x0AB52FDD
data.set 0xA01187A0 %long   0xC6ED9C29
data.set 0xA01187A4 %long   0x3BC9FBB7
data.set 0xA01187A8 %long   0xAE2A58F1
data.set 0xA01187AC %long   0xDCD308DD
data.set 0xA01187B0 %long   0xCF5B898D
data.set 0xA01187B4 %long   0xC6898A21
data.set 0xA01187B8 %long   0x25DF241F
data.set 0xA01187BC %long   0x7B6A377D
data.set 0xA01187C0 %long   0x6A5CE6EA
data.set 0xA01187C4 %long   0x6B34BCAD
data.set 0xA01187C8 %long   0xED644093
data.set 0xA01187CC %long   0x1E41BBB4
data.set 0xA01187D0 %long   0x21DD6D6E
data.set 0xA01187D4 %long   0x8641261E
data.set 0xA01187D8 %long   0x162D8277
data.set 0xA01187DC %long   0x0A88BEDA
data.set 0xA01187E0 %long   0x0A37A11B
data.set 0xA01187E4 %long   0x4B6FB35A
data.set 0xA01187E8 %long   0x9CA740F3
data.set 0xA01187EC %long   0xE576EF27
data.set 0xA01187F0 %long   0x1BA03A7E
data.set 0xA01187F4 %long   0xBD02950A
data.set 0xA01187F8 %long   0xACDBA1A1
data.set 0xA01187FC %long   0xCAC659BB
data.set 0xA0118800 %long   0xACCCD839
data.set 0xA0118804 %long   0xD74EB9FB
data.set 0xA0118808 %long   0x589AF414
data.set 0xA011880C %long   0xEFD61DB4
data.set 0xA0118810 %long   0x56114EFF
data.set 0xA0118814 %long   0x5F013297
data.set 0xA0118818 %long   0x9AB84DD0
data.set 0xA011881C %long   0xE6775ABA
data.set 0xA0118820 %long   0x9A39162C
data.set 0xA0118824 %long   0x760F706F
data.set 0xA0118828 %long   0x2EC83420
data.set 0xA011882C %long   0xACB42F61
data.set 0xA0118830 %long   0xB8D720DB
data.set 0xA0118834 %long   0x7C9F11A2
data.set 0xA0118838 %long   0xE20E2AC0
data.set 0xA011883C %long   0x337FDCC8
data.set 0xA0118840 %long   0x9A2447BE
data.set 0xA0118844 %long   0xD0A3B0AE
data.set 0xA0118848 %long   0xBBDCA226
data.set 0xA011884C %long   0xCF6B4F90
data.set 0xA0118850 %long   0xE41A131E
data.set 0xA0118854 %long   0xA7A30115
data.set 0xA0118858 %long   0x767A8715
data.set 0xA011885C %long   0x52B6A9AC
data.set 0xA0118860 %long   0x1BB2E5E6
data.set 0xA0118864 %long   0x0E6F0FA5
data.set 0xA0118868 %long   0x90D29068
data.set 0xA011886C %long   0xD117A7F3
data.set 0xA0118870 %long   0xF87C1D80
data.set 0xA0118874 %long   0xDAA18952
data.set 0xA0118878 %long   0x2F0C4782
data.set 0xA011887C %long   0xE2EABC87
data.set 0xA0118880 %long   0x48779EE7
data.set 0xA0118884 %long   0xDE442024
data.set 0xA0118888 %long   0xA483CFFB
data.set 0xA011888C %long   0x70FC183D
data.set 0xA0118890 %long   0x52243939
data.set 0xA0118894 %long   0xCBFBB43B
data.set 0xA0118898 %long   0xC4E3A621
data.set 0xA011889C %long   0x4BBC50BE
data.set 0xA01188A0 %long   0x62AA2E73
data.set 0xA01188A4 %long   0x3606750A
data.set 0xA01188A8 %long   0x58C6D246
data.set 0xA01188AC %long   0x848A3FB8
data.set 0xA01188B0 %long   0x5DD9F8FF
data.set 0xA01188B4 %long   0x2A6497BA
data.set 0xA01188B8 %long   0x1677FB70
data.set 0xA01188BC %long   0xC2B441E9
data.set 0xA01188C0 %long   0xE6DE50FE
data.set 0xA01188C4 %long   0x460C04BF
data.set 0xA01188C8 %long   0x355F6D6B
data.set 0xA01188CC %long   0x2D3A5773
data.set 0xA01188D0 %long   0x8BAB864E
data.set 0xA01188D4 %long   0x6B7AF592
data.set 0xA01188D8 %long   0x02302E27
data.set 0xA01188DC %long   0x26D62B11
data.set 0xA01188E0 %long   0xB85EBF45
data.set 0xA01188E4 %long   0x2E2830E7
data.set 0xA01188E8 %long   0x2FB214D8
data.set 0xA01188EC %long   0xB84D10A6
data.set 0xA01188F0 %long   0x4D358083
data.set 0xA01188F4 %long   0xE1483BD5
data.set 0xA01188F8 %long   0xE2CFA8A9
data.set 0xA01188FC %long   0x709CFEAC
data.set 0xA0118900 %long   0x08627457
data.set 0xA0118904 %long   0x7E4EE674
data.set 0xA0118908 %long   0x58E6F6A0
data.set 0xA011890C %long   0xF7E10F82
data.set 0xA0118910 %long   0xBD14E021
data.set 0xA0118914 %long   0x55CCB832
data.set 0xA0118918 %long   0x2A4C49CD
data.set 0xA011891C %long   0xABC58488
data.set 0xA0118920 %long   0x9730E7C4
data.set 0xA0118924 %long   0xCDF90E58
data.set 0xA0118928 %long   0x5692B9D0
data.set 0xA011892C %long   0x86644528
data.set 0xA0118930 %long   0x39460D82
data.set 0xA0118934 %long   0x3A78C088
data.set 0xA0118938 %long   0x8CED452A
data.set 0xA011893C %long   0x338BAAB7
data.set 0xA0118940 %long   0xB098A685
data.set 0xA0118944 %long   0x1C1A6A6A
data.set 0xA0118948 %long   0x8DA58CE5
data.set 0xA011894C %long   0xA7D20E01
data.set 0xA0118950 %long   0x97EC8F5A
data.set 0xA0118954 %long   0x6A1A4B45
data.set 0xA0118958 %long   0x77E9F20C
data.set 0xA011895C %long   0x08E92646
data.set 0xA0118960 %long   0xFAFA0980
data.set 0xA0118964 %long   0x4CBA4202
data.set 0xA0118968 %long   0x44499FD0
data.set 0xA011896C %long   0xE1E02267
data.set 0xA0118970 %long   0x98A75E65
data.set 0xA0118974 %long   0x2565B5B0
data.set 0xA0118978 %long   0x5A4106B2
data.set 0xA011897C %long   0xBD078600
data.set 0xA0118980 %long   0x41725AEF
data.set 0xA0118984 %long   0x1AFDB1CC
data.set 0xA0118988 %long   0x0CD5F037
data.set 0xA011898C %long   0x66E3F2D2
data.set 0xA0118990 %long   0x94E0D38B
data.set 0xA0118994 %long   0xAD1F667A
data.set 0xA0118998 %long   0xD14C14FD
data.set 0xA011899C %long   0x2CCBECB3
data.set 0xA01189A0 %long   0x21617E2C
data.set 0xA01189A4 %long   0x7E01FF0A
data.set 0xA01189A8 %long   0xE0FBF24D
data.set 0xA01189AC %long   0x44790189
data.set 0xA01189B0 %long   0x4829CCDA
data.set 0xA01189B4 %long   0xD31C5E63
data.set 0xA01189B8 %long   0x4B27DAFD
data.set 0xA01189BC %long   0xEFCB5C4C
data.set 0xA01189C0 %long   0x13E9FAAB
data.set 0xA01189C4 %long   0x98E326EC
data.set 0xA01189C8 %long   0x516C42B7
data.set 0xA01189CC %long   0x1C9FA4AC
data.set 0xA01189D0 %long   0x2DB1B0F8
data.set 0xA01189D4 %long   0xED66B428
data.set 0xA01189D8 %long   0xF032C10D
data.set 0xA01189DC %long   0xA88B36A0
data.set 0xA01189E0 %long   0xD705D288
data.set 0xA01189E4 %long   0xD7F658AE
data.set 0xA01189E8 %long   0x8FD7D61B
data.set 0xA01189EC %long   0x835C6A29
data.set 0xA01189F0 %long   0x7460D85A
data.set 0xA01189F4 %long   0x5C2511DD
data.set 0xA01189F8 %long   0x4B897979
data.set 0xA01189FC %long   0xF737B201
data.set 0xA0118A00 %long   0x2F42FCFF
data.set 0xA0118A04 %long   0x539B196E
data.set 0xA0118A08 %long   0xA095F20F
data.set 0xA0118A0C %long   0x1ABF6EB0
data.set 0xA0118A10 %long   0x8206DCD7
data.set 0xA0118A14 %long   0x74A5323D
data.set 0xA0118A18 %long   0x6B612012
data.set 0xA0118A1C %long   0xE5E9D925
data.set 0xA0118A20 %long   0x008641D7
data.set 0xA0118A24 %long   0xF3465A1D
data.set 0xA0118A28 %long   0x39D9A441
data.set 0xA0118A2C %long   0x9198256C
data.set 0xA0118A30 %long   0xA0552595
data.set 0xA0118A34 %long   0x26095B93
data.set 0xA0118A38 %long   0xE76AFBD6
data.set 0xA0118A3C %long   0xE49FE940
data.set 0xA0118A40 %long   0x36D6BF93
data.set 0xA0118A44 %long   0x4E77196A
data.set 0xA0118A48 %long   0xCA0A636A
data.set 0xA0118A4C %long   0xFE27B1BF
data.set 0xA0118A50 %long   0xB2AAF0B6
data.set 0xA0118A54 %long   0x9AA2F257
data.set 0xA0118A58 %long   0xF0A5C39E
data.set 0xA0118A5C %long   0xEEA6F9C4
data.set 0xA0118A60 %long   0x271F9BE4
data.set 0xA0118A64 %long   0x9E3F01B9
data.set 0xA0118A68 %long   0x01611A68
data.set 0xA0118A6C %long   0x309143CF
data.set 0xA0118A70 %long   0x3D4F13E2
data.set 0xA0118A74 %long   0x290D730B
data.set 0xA0118A78 %long   0xEA7DBAB8
data.set 0xA0118A7C %long   0x095E9B42
data.set 0xA0118A80 %long   0x9DA98E2C
data.set 0xA0118A84 %long   0xF5E409FF
data.set 0xA0118A88 %long   0x791CD6FA
data.set 0xA0118A8C %long   0xE4EBBB8F
data.set 0xA0118A90 %long   0x9F48C845
data.set 0xA0118A94 %long   0x8D5A314F
data.set 0xA0118A98 %long   0x7A3AD8B3
data.set 0xA0118A9C %long   0x1FE36599
data.set 0xA0118AA0 %long   0x4B56DE17
data.set 0xA0118AA4 %long   0x3056711D
data.set 0xA0118AA8 %long   0x0ADB1ACB
data.set 0xA0118AAC %long   0xDD4FC807
data.set 0xA0118AB0 %long   0x2F8C646E
data.set 0xA0118AB4 %long   0xD7AC312B
data.set 0xA0118AB8 %long   0x9CF8CC40
data.set 0xA0118ABC %long   0xB96206F7
data.set 0xA0118AC0 %long   0x2D9741B3
data.set 0xA0118AC4 %long   0x06CD8BF0
data.set 0xA0118AC8 %long   0x605A6570
data.set 0xA0118ACC %long   0xC4D5CE85
data.set 0xA0118AD0 %long   0xF98FC8F7
data.set 0xA0118AD4 %long   0x05185A86
data.set 0xA0118AD8 %long   0x9C27E1AD
data.set 0xA0118ADC %long   0x6516DA3E
data.set 0xA0118AE0 %long   0xA26E4552
data.set 0xA0118AE4 %long   0x4E214229
data.set 0xA0118AE8 %long   0x823A6AC8
data.set 0xA0118AEC %long   0x73DBE4D2
data.set 0xA0118AF0 %long   0xFF383CCB
data.set 0xA0118AF4 %long   0x8A9DAED3
data.set 0xA0118AF8 %long   0xAAE93516
data.set 0xA0118AFC %long   0xF594E46E
data.set 0xA0118B00 %long   0x1F668362
data.set 0xA0118B04 %long   0xD30A060B
data.set 0xA0118B08 %long   0xCBB9B586
data.set 0xA0118B0C %long   0x77983988
data.set 0xA0118B10 %long   0xA403DABF
data.set 0xA0118B14 %long   0x31AA0680
data.set 0xA0118B18 %long   0x02B0F804
data.set 0xA0118B1C %long   0xCF001349
data.set 0xA0118B20 %long   0x69D3F885
data.set 0xA0118B24 %long   0xB997E33C
data.set 0xA0118B28 %long   0x6DF986E0
data.set 0xA0118B2C %long   0xDB45BEB3
data.set 0xA0118B30 %long   0xB344D0A6
data.set 0xA0118B34 %long   0x90FD8E3D
data.set 0xA0118B38 %long   0x800A1C43
data.set 0xA0118B3C %long   0xE015F149
data.set 0xA0118B40 %long   0x1C643D32
data.set 0xA0118B44 %long   0x8124E4F6
data.set 0xA0118B48 %long   0xF3B7A02B
data.set 0xA0118B4C %long   0x53E0D42A
data.set 0xA0118B50 %long   0x916BDC06
data.set 0xA0118B54 %long   0x1882EBF5
data.set 0xA0118B58 %long   0x2EC0942E
data.set 0xA0118B5C %long   0xB9A8AFA5
data.set 0xA0118B60 %long   0x582E5D87
data.set 0xA0118B64 %long   0x57B2DB82
data.set 0xA0118B68 %long   0x4F98FB30
data.set 0xA0118B6C %long   0xA5F0B4C5
data.set 0xA0118B70 %long   0x0EB7C6F2
data.set 0xA0118B74 %long   0x7FCC4E5D
data.set 0xA0118B78 %long   0x826F64AA
data.set 0xA0118B7C %long   0x12303A10
data.set 0xA0118B80 %long   0x8DC764F3
data.set 0xA0118B84 %long   0x48060A5F
data.set 0xA0118B88 %long   0xA3415BB3
data.set 0xA0118B8C %long   0x04CDCBD9
data.set 0xA0118B90 %long   0xDF724FA8
data.set 0xA0118B94 %long   0x0D35BF60
data.set 0xA0118B98 %long   0x7AB21B7F
data.set 0xA0118B9C %long   0x9A7B8688
data.set 0xA0118BA0 %long   0x9ECCC659
data.set 0xA0118BA4 %long   0xA8E5CF5A
data.set 0xA0118BA8 %long   0x55617297
data.set 0xA0118BAC %long   0x86860152
data.set 0xA0118BB0 %long   0x5CDB72FE
data.set 0xA0118BB4 %long   0xFB823668
data.set 0xA0118BB8 %long   0x106F5047
data.set 0xA0118BBC %long   0xF6C083D9
data.set 0xA0118BC0 %long   0xA8BCAC8F
data.set 0xA0118BC4 %long   0x181D009B
data.set 0xA0118BC8 %long   0x3E0DD91D
data.set 0xA0118BCC %long   0x7A1E93BB
data.set 0xA0118BD0 %long   0x4B8621B6
data.set 0xA0118BD4 %long   0x7F2EC10E
data.set 0xA0118BD8 %long   0x0208ACA7
data.set 0xA0118BDC %long   0xCC2B099D
data.set 0xA0118BE0 %long   0x90D30406
data.set 0xA0118BE4 %long   0x3CC5B4D7
data.set 0xA0118BE8 %long   0x925188A6
data.set 0xA0118BEC %long   0x058D74CC
data.set 0xA0118BF0 %long   0x7046CB88
data.set 0xA0118BF4 %long   0x78C880D1
data.set 0xA0118BF8 %long   0x593D6B70
data.set 0xA0118BFC %long   0x6BF6D304
data.set 0xA0118C00 %long   0x802F4E7F
data.set 0xA0118C04 %long   0xAE7F6E89
data.set 0xA0118C08 %long   0x8CCBCDAF
data.set 0xA0118C0C %long   0x27BA2F77
data.set 0xA0118C10 %long   0x42C95493
data.set 0xA0118C14 %long   0x2BB6D428
data.set 0xA0118C18 %long   0x3FE6DB6E
data.set 0xA0118C1C %long   0xA60A7618
data.set 0xA0118C20 %long   0x2D9B522D
data.set 0xA0118C24 %long   0x691E94A0
data.set 0xA0118C28 %long   0x4CC05B4C
data.set 0xA0118C2C %long   0x93A8670D
data.set 0xA0118C30 %long   0x6B948F1C
data.set 0xA0118C34 %long   0xA921FA70
data.set 0xA0118C38 %long   0xE2145440
data.set 0xA0118C3C %long   0xAA09D837
data.set 0xA0118C40 %long   0x59672059
data.set 0xA0118C44 %long   0x2AD25F48
data.set 0xA0118C48 %long   0x9A24FD0D
data.set 0xA0118C4C %long   0x19E29668
data.set 0xA0118C50 %long   0xD9F1EC20
data.set 0xA0118C54 %long   0x856A9FD0
data.set 0xA0118C58 %long   0x705EBDC6
data.set 0xA0118C5C %long   0xBAF4EAE6
data.set 0xA0118C60 %long   0xB966F8A3
data.set 0xA0118C64 %long   0xB6DF0E6C
data.set 0xA0118C68 %long   0x898FA127
data.set 0xA0118C6C %long   0x22027BC9
data.set 0xA0118C70 %long   0xF1CBECC3
data.set 0xA0118C74 %long   0x26F4FDDC
data.set 0xA0118C78 %long   0xEC57FB83
data.set 0xA0118C7C %long   0xEA0297BF
data.set 0xA0118C80 %long   0x7CA309A4
data.set 0xA0118C84 %long   0xC163BBD3
data.set 0xA0118C88 %long   0xBB0E9961
data.set 0xA0118C8C %long   0x066E980C
data.set 0xA0118C90 %long   0x3775A97D
data.set 0xA0118C94 %long   0x0EF8F7D5
data.set 0xA0118C98 %long   0x685D9ED6
data.set 0xA0118C9C %long   0x104998E1
data.set 0xA0118CA0 %long   0x2A0EEAFC
data.set 0xA0118CA4 %long   0x5FFDEC11
data.set 0xA0118CA8 %long   0x82055C18
data.set 0xA0118CAC %long   0x46B7575E
data.set 0xA0118CB0 %long   0x3886CA42
data.set 0xA0118CB4 %long   0x0A3FA688
data.set 0xA0118CB8 %long   0x0F6E97D6
data.set 0xA0118CBC %long   0x71ABE66E
data.set 0xA0118CC0 %long   0xD6D73A22
data.set 0xA0118CC4 %long   0x11A4BAC9
data.set 0xA0118CC8 %long   0x088EA807
data.set 0xA0118CCC %long   0x35943C01
data.set 0xA0118CD0 %long   0x24A7F176
data.set 0xA0118CD4 %long   0x492C15F3
data.set 0xA0118CD8 %long   0x7524B12B
data.set 0xA0118CDC %long   0x5B2A60EF
data.set 0xA0118CE0 %long   0xC046CFC7
data.set 0xA0118CE4 %long   0x7C68AA17
data.set 0xA0118CE8 %long   0xF11A9C3F
data.set 0xA0118CEC %long   0xBB5F16F6
data.set 0xA0118CF0 %long   0x0299A57C
data.set 0xA0118CF4 %long   0xAD307B92
data.set 0xA0118CF8 %long   0x51C21C23
data.set 0xA0118CFC %long   0xDE577275
data.set 0xA0118D00 %long   0xA268E089
data.set 0xA0118D04 %long   0x2D4A81FE
data.set 0xA0118D08 %long   0x6BF34130
data.set 0xA0118D0C %long   0x4A147653
data.set 0xA0118D10 %long   0x475F18FF
data.set 0xA0118D14 %long   0xDF2046AC
data.set 0xA0118D18 %long   0x45A15791
data.set 0xA0118D1C %long   0x81D31AF9
data.set 0xA0118D20 %long   0xFC3CF58F
data.set 0xA0118D24 %long   0x7B1CD48A
data.set 0xA0118D28 %long   0x30BE8AB2
data.set 0xA0118D2C %long   0x529C5EA2
data.set 0xA0118D30 %long   0x0E5F7E6C
data.set 0xA0118D34 %long   0xBE58DDE3
data.set 0xA0118D38 %long   0x68709D18
data.set 0xA0118D3C %long   0x8353AFA3
data.set 0xA0118D40 %long   0x60710DFB
data.set 0xA0118D44 %long   0x7D8CCDA7
data.set 0xA0118D48 %long   0xC11F1487
data.set 0xA0118D4C %long   0x061A64E0
data.set 0xA0118D50 %long   0xA12A79C6
data.set 0xA0118D54 %long   0x168FCA45
data.set 0xA0118D58 %long   0xA0EF156C
data.set 0xA0118D5C %long   0x723FC295
data.set 0xA0118D60 %long   0xE193E2D5
data.set 0xA0118D64 %long   0xCE0E6FAF
data.set 0xA0118D68 %long   0x2884262F
data.set 0xA0118D6C %long   0x8D733AE9
data.set 0xA0118D70 %long   0xB2240463
data.set 0xA0118D74 %long   0x24FE23EC
data.set 0xA0118D78 %long   0x536A797C
data.set 0xA0118D7C %long   0x3D718686
data.set 0xA0118D80 %long   0x7613B88D
data.set 0xA0118D84 %long   0xD33ADBF4
data.set 0xA0118D88 %long   0xE21E9DAE
data.set 0xA0118D8C %long   0x94F14031
data.set 0xA0118D90 %long   0xCABBD742
data.set 0xA0118D94 %long   0x10CDAD93
data.set 0xA0118D98 %long   0xF9D7379F
data.set 0xA0118D9C %long   0x39759657
data.set 0xA0118DA0 %long   0xE764860B
data.set 0xA0118DA4 %long   0x5906D724
data.set 0xA0118DA8 %long   0x0A74CBC4
data.set 0xA0118DAC %long   0x6CA9EAC5
data.set 0xA0118DB0 %long   0xFBCB2F8E
data.set 0xA0118DB4 %long   0x8C769022
data.set 0xA0118DB8 %long   0xC3264A3B
data.set 0xA0118DBC %long   0x68214D92
data.set 0xA0118DC0 %long   0x4FAF577A
data.set 0xA0118DC4 %long   0x7E7B1B29
data.set 0xA0118DC8 %long   0xB931DAAC
data.set 0xA0118DCC %long   0xB9F8DCC5
data.set 0xA0118DD0 %long   0xB78DE391
data.set 0xA0118DD4 %long   0xE0BEEDE1
data.set 0xA0118DD8 %long   0x5BA712A7
data.set 0xA0118DDC %long   0x67A37500
data.set 0xA0118DE0 %long   0xEB57B8D4
data.set 0xA0118DE4 %long   0x6240813A
data.set 0xA0118DE8 %long   0xA96265AF
data.set 0xA0118DEC %long   0xC2354959
data.set 0xA0118DF0 %long   0xF476402D
data.set 0xA0118DF4 %long   0x7700F7AA
data.set 0xA0118DF8 %long   0xCDDA6463
data.set 0xA0118DFC %long   0xE6E89FAB
data.set 0xA0118E00 %long   0xFE6623DC
data.set 0xA0118E04 %long   0x7F771978
data.set 0xA0118E08 %long   0xD9A7DF14
data.set 0xA0118E0C %long   0x467C48DE
data.set 0xA0118E10 %long   0x3423AC6E
data.set 0xA0118E14 %long   0x56F87DB7
data.set 0xA0118E18 %long   0xB1BCCDFE
data.set 0xA0118E1C %long   0x24A4D88C
data.set 0xA0118E20 %long   0xDB24352D
data.set 0xA0118E24 %long   0xCECD9407
data.set 0xA0118E28 %long   0xA0F30141
data.set 0xA0118E2C %long   0x80D5F9D9
data.set 0xA0118E30 %long   0x14D07948
data.set 0xA0118E34 %long   0x4C5859AE
data.set 0xA0118E38 %long   0x71AAF190
data.set 0xA0118E3C %long   0x4DF4F41F
data.set 0xA0118E40 %long   0x6097D3AB
data.set 0xA0118E44 %long   0xF1D60D61
data.set 0xA0118E48 %long   0xAE7ECB3C
data.set 0xA0118E4C %long   0x835F4224
data.set 0xA0118E50 %long   0x81BC6A94
data.set 0xA0118E54 %long   0xD2D4D841
data.set 0xA0118E58 %long   0xF1CCF9E6
data.set 0xA0118E5C %long   0xE96EC2CB
data.set 0xA0118E60 %long   0x30116679
data.set 0xA0118E64 %long   0x004C5438
data.set 0xA0118E68 %long   0xCFE2346E
data.set 0xA0118E6C %long   0xD067E3DA
data.set 0xA0118E70 %long   0xA023B925
data.set 0xA0118E74 %long   0x8928B757
data.set 0xA0118E78 %long   0x83FD9153
data.set 0xA0118E7C %long   0x8F18E820
data.set 0xA0118E80 %long   0xC1C24F73
data.set 0xA0118E84 %long   0xBE7764E6
data.set 0xA0118E88 %long   0x92A456E4
data.set 0xA0118E8C %long   0x5B295491
data.set 0xA0118E90 %long   0x9DBE6F5E
data.set 0xA0118E94 %long   0xABB63441
data.set 0xA0118E98 %long   0x89245348
data.set 0xA0118E9C %long   0xB4C03595
data.set 0xA0118EA0 %long   0xAF6C8381
data.set 0xA0118EA4 %long   0x6EA363D3
data.set 0xA0118EA8 %long   0x7C5DE163
data.set 0xA0118EAC %long   0x11575335
data.set 0xA0118EB0 %long   0x48BBBEB4
data.set 0xA0118EB4 %long   0x589DF32C
data.set 0xA0118EB8 %long   0x8AEB30A9
data.set 0xA0118EBC %long   0x9970FD09
data.set 0xA0118EC0 %long   0x4E44B802
data.set 0xA0118EC4 %long   0x4A965F3D
data.set 0xA0118EC8 %long   0x5DD8D472
data.set 0xA0118ECC %long   0x6E9DCE9A
data.set 0xA0118ED0 %long   0xCF924443
data.set 0xA0118ED4 %long   0x86C46834
data.set 0xA0118ED8 %long   0xABACD0E2
data.set 0xA0118EDC %long   0x499AD074
data.set 0xA0118EE0 %long   0x2EC29C8E
data.set 0xA0118EE4 %long   0x837F30BC
data.set 0xA0118EE8 %long   0xDC9C4145
data.set 0xA0118EEC %long   0x89CE1CE9
data.set 0xA0118EF0 %long   0x1D7713E3
data.set 0xA0118EF4 %long   0x0B8F5A15
data.set 0xA0118EF8 %long   0x725D2832
data.set 0xA0118EFC %long   0xAB450BD3
data.set 0xA0118F00 %long   0x6077445B
data.set 0xA0118F04 %long   0xF94397AA
data.set 0xA0118F08 %long   0x1F9DACEF
data.set 0xA0118F0C %long   0xA7BDBDF9
data.set 0xA0118F10 %long   0xD7AA5DE5
data.set 0xA0118F14 %long   0xECD983B7
data.set 0xA0118F18 %long   0x045951B5
data.set 0xA0118F1C %long   0x1B9B10DB
data.set 0xA0118F20 %long   0x6466B157
data.set 0xA0118F24 %long   0xC93F7E0F
data.set 0xA0118F28 %long   0x55D4B2C5
data.set 0xA0118F2C %long   0xD42AC677
data.set 0xA0118F30 %long   0xC97818BC
data.set 0xA0118F34 %long   0xBA232A4E
data.set 0xA0118F38 %long   0x10BC0301
data.set 0xA0118F3C %long   0x4F093E85
data.set 0xA0118F40 %long   0xEB1DEF52
data.set 0xA0118F44 %long   0xD3B29C1D
data.set 0xA0118F48 %long   0xB093A453
data.set 0xA0118F4C %long   0x7B3FEEDA
data.set 0xA0118F50 %long   0x420585C0
data.set 0xA0118F54 %long   0x288F2F2F
data.set 0xA0118F58 %long   0x0AA40A33
data.set 0xA0118F5C %long   0x9DBF0192
data.set 0xA0118F60 %long   0x78F69008
data.set 0xA0118F64 %long   0xB62DF03E
data.set 0xA0118F68 %long   0x3835BE6D
data.set 0xA0118F6C %long   0xB88C355E
data.set 0xA0118F70 %long   0xCC79820D
data.set 0xA0118F74 %long   0x2B0458DD
data.set 0xA0118F78 %long   0x265567FC
data.set 0xA0118F7C %long   0x88675655
data.set 0xA0118F80 %long   0x056F0469
data.set 0xA0118F84 %long   0xEE6EA6C1
data.set 0xA0118F88 %long   0xB4F4D5E9
data.set 0xA0118F8C %long   0xB3FDAA72
data.set 0xA0118F90 %long   0x448FA090
data.set 0xA0118F94 %long   0xC3B6FD6A
data.set 0xA0118F98 %long   0x328A8F7B
data.set 0xA0118F9C %long   0x4433B0E6
data.set 0xA0118FA0 %long   0x6B1F9ED8
data.set 0xA0118FA4 %long   0x4A3743BD
data.set 0xA0118FA8 %long   0x198FD605
data.set 0xA0118FAC %long   0x3787AE43
data.set 0xA0118FB0 %long   0x6B20A222
data.set 0xA0118FB4 %long   0x78EDF1C7
data.set 0xA0118FB8 %long   0xC9DDE674
data.set 0xA0118FBC %long   0x31302A55
data.set 0xA0118FC0 %long   0x7F9EF03A
data.set 0xA0118FC4 %long   0x291B3A3B
data.set 0xA0118FC8 %long   0x4B3F2D82
data.set 0xA0118FCC %long   0x3112B68A
data.set 0xA0118FD0 %long   0xEC23A7AE
data.set 0xA0118FD4 %long   0x83A6B0A4
data.set 0xA0118FD8 %long   0xAB69AFD2
data.set 0xA0118FDC %long   0x23FAF7DC
data.set 0xA0118FE0 %long   0xC4BB7D82
data.set 0xA0118FE4 %long   0x06E942BF
data.set 0xA0118FE8 %long   0xB79272EC
data.set 0xA0118FEC %long   0x460AF755
data.set 0xA0118FF0 %long   0x23AA0AEB
data.set 0xA0118FF4 %long   0x9133DC47
data.set 0xA0118FF8 %long   0x2361630C
data.set 0xA0118FFC %long   0xCFC5FCF9
data.set 0xA0119000 %long   0xED63100F
data.set 0xA0119004 %long   0xCB7758C7
data.set 0xA0119008 %long   0xA1F26719
data.set 0xA011900C %long   0xBC11CC80
data.set 0xA0119010 %long   0xBBF73F8E
data.set 0xA0119014 %long   0x1BECEEEB
data.set 0xA0119018 %long   0x9365F408
data.set 0xA011901C %long   0xC5927EFE
data.set 0xA0119020 %long   0xF0178345
data.set 0xA0119024 %long   0x5815D332
data.set 0xA0119028 %long   0x08913A27
data.set 0xA011902C %long   0x9AD8FC8A
data.set 0xA0119030 %long   0xA014F621
data.set 0xA0119034 %long   0x2BCC7747
data.set 0xA0119038 %long   0x82CE850A
data.set 0xA011903C %long   0x6A120D72
data.set 0xA0119040 %long   0x5346CEFC
data.set 0xA0119044 %long   0xFC66BEBD
data.set 0xA0119048 %long   0xB9A25967
data.set 0xA011904C %long   0x53E209DF
data.set 0xA0119050 %long   0x24C595D2
data.set 0xA0119054 %long   0xD6472D0C
data.set 0xA0119058 %long   0xFB4BEB06
data.set 0xA011905C %long   0x48319658
data.set 0xA0119060 %long   0xFF460FE6
data.set 0xA0119064 %long   0xFA7AF743
data.set 0xA0119068 %long   0xC52D1879
data.set 0xA011906C %long   0xC2D235B1
data.set 0xA0119070 %long   0x891B1C6A
data.set 0xA0119074 %long   0xC831B00E
data.set 0xA0119078 %long   0xDCD5FA20
data.set 0xA011907C %long   0x57210F47
data.set 0xA0119080 %long   0x06E303F5
data.set 0xA0119084 %long   0x8D4344D4
data.set 0xA0119088 %long   0xD1AB6B0D
data.set 0xA011908C %long   0x92EA3685
data.set 0xA0119090 %long   0x8B817353
data.set 0xA0119094 %long   0x4950052A
data.set 0xA0119098 %long   0xA3C3DB1C
data.set 0xA011909C %long   0x95FFB2AA
data.set 0xA01190A0 %long   0xF7F7601C
data.set 0xA01190A4 %long   0x40A813F8
data.set 0xA01190A8 %long   0x2A4C6EF9
data.set 0xA01190AC %long   0x6D930659
data.set 0xA01190B0 %long   0xBF34A946
data.set 0xA01190B4 %long   0x684B6631
data.set 0xA01190B8 %long   0x5C09D686
data.set 0xA01190BC %long   0x0E653199
data.set 0xA01190C0 %long   0x3E4DC525
data.set 0xA01190C4 %long   0xA32054ED
data.set 0xA01190C8 %long   0xFF096126
data.set 0xA01190CC %long   0xA39387C0
data.set 0xA01190D0 %long   0x84597F73
data.set 0xA01190D4 %long   0x978107CC
data.set 0xA01190D8 %long   0xE076FB6A
data.set 0xA01190DC %long   0xF12A27B8
data.set 0xA01190E0 %long   0xF2B302DE
data.set 0xA01190E4 %long   0x41EACC3E
data.set 0xA01190E8 %long   0xD1721876
data.set 0xA01190EC %long   0xEC23E5A0
data.set 0xA01190F0 %long   0x9CA91086
data.set 0xA01190F4 %long   0x7559A8AC
data.set 0xA01190F8 %long   0x223300B4
data.set 0xA01190FC %long   0x8E14906A
data.set 0xA0119100 %long   0xC98266CE
data.set 0xA0119104 %long   0xFA5D3711
data.set 0xA0119108 %long   0x0D1C4C5C
data.set 0xA011910C %long   0x1FE2446E
data.set 0xA0119110 %long   0x980E0259
data.set 0xA0119114 %long   0x550BDD9F
data.set 0xA0119118 %long   0x38DD141D
data.set 0xA011911C %long   0x40CC93DC
data.set 0xA0119120 %long   0xB8D4DE6F
data.set 0xA0119124 %long   0x81ED016F
data.set 0xA0119128 %long   0xA00CEF0E
data.set 0xA011912C %long   0x36491F85
data.set 0xA0119130 %long   0x059D7214
data.set 0xA0119134 %long   0x338F209A
data.set 0xA0119138 %long   0xBED52089
data.set 0xA011913C %long   0xADE8DA5E
data.set 0xA0119140 %long   0xC68692E5
data.set 0xA0119144 %long   0x5A513510
data.set 0xA0119148 %long   0xAB4AFC9B
data.set 0xA011914C %long   0xDDE2732A
data.set 0xA0119150 %long   0xCC41C7FC
data.set 0xA0119154 %long   0xE204BD3C
data.set 0xA0119158 %long   0xCE60A300
data.set 0xA011915C %long   0x59220062
data.set 0xA0119160 %long   0x594CE1EF
data.set 0xA0119164 %long   0xFCFDE032
data.set 0xA0119168 %long   0x3CD681AF
data.set 0xA011916C %long   0x60BFFD1C
data.set 0xA0119170 %long   0x516111C3
data.set 0xA0119174 %long   0xC219B511
data.set 0xA0119178 %long   0x8CB11943
data.set 0xA011917C %long   0x52E2B0F7
data.set 0xA0119180 %long   0x84B78903
data.set 0xA0119184 %long   0xE149361C
data.set 0xA0119188 %long   0x1D7F321A
data.set 0xA011918C %long   0x66E9A889
data.set 0xA0119190 %long   0x488EAF0D
data.set 0xA0119194 %long   0x70096652
data.set 0xA0119198 %long   0x172249F5
data.set 0xA011919C %long   0x797753D9
data.set 0xA01191A0 %long   0xB526E279
data.set 0xA01191A4 %long   0x58C12112
data.set 0xA01191A8 %long   0xCA50DBFA
data.set 0xA01191AC %long   0xF388E0C7
data.set 0xA01191B0 %long   0xECA09410
data.set 0xA01191B4 %long   0x93003BD8
data.set 0xA01191B8 %long   0xFA6B85BB
data.set 0xA01191BC %long   0xF77EC825
data.set 0xA01191C0 %long   0x54CA672D
data.set 0xA01191C4 %long   0x48E17A2A
data.set 0xA01191C8 %long   0x51A7D43A
data.set 0xA01191CC %long   0xF84EECF7
data.set 0xA01191D0 %long   0x31F1FEA3
data.set 0xA01191D4 %long   0xCF6982BF
data.set 0xA01191D8 %long   0x9A8A9F1B
data.set 0xA01191DC %long   0x4EDEE603
data.set 0xA01191E0 %long   0xE31FC7A2
data.set 0xA01191E4 %long   0x7F09F226
data.set 0xA01191E8 %long   0xE46BFA37
data.set 0xA01191EC %long   0xBF9B68D0
data.set 0xA01191F0 %long   0x12F2A9FD
data.set 0xA01191F4 %long   0x9CDC186B
data.set 0xA01191F8 %long   0x698055D2
data.set 0xA01191FC %long   0x6F7FA7C4
data.set 0xA0119200 %long   0x85DBFB3B
data.set 0xA0119204 %long   0xA8C0C25D
data.set 0xA0119208 %long   0x73EE0C32
data.set 0xA011920C %long   0x774E1169
data.set 0xA0119210 %long   0xBE5F6A4B
data.set 0xA0119214 %long   0x3EB34F84
data.set 0xA0119218 %long   0x4B69FBC5
data.set 0xA011921C %long   0xEC440693
data.set 0xA0119220 %long   0xCFF2B109
data.set 0xA0119224 %long   0xE608BCA2
data.set 0xA0119228 %long   0xC18C38C1
data.set 0xA011922C %long   0x868C7CB4
data.set 0xA0119230 %long   0xE649A6B0
data.set 0xA0119234 %long   0x8DAB30A3
data.set 0xA0119238 %long   0xA081CE0F
data.set 0xA011923C %long   0x219927C2
data.set 0xA0119240 %long   0x5A777B3B
data.set 0xA0119244 %long   0x585A57F9
data.set 0xA0119248 %long   0xD21B9832
data.set 0xA011924C %long   0xBABDFA40
data.set 0xA0119250 %long   0x67AEAD88
data.set 0xA0119254 %long   0xA8A62155
data.set 0xA0119258 %long   0x084A3BA1
data.set 0xA011925C %long   0x70497577
data.set 0xA0119260 %long   0x05233DC9
data.set 0xA0119264 %long   0x2229260B
data.set 0xA0119268 %long   0x51460DC1
data.set 0xA011926C %long   0x5CBA9039
data.set 0xA0119270 %long   0x065A29F8
data.set 0xA0119274 %long   0x613D8BE4
data.set 0xA0119278 %long   0xC5A0D96D
data.set 0xA011927C %long   0x31689376
data.set 0xA0119280 %long   0x4D362BDC
data.set 0xA0119284 %long   0x82569BB3
data.set 0xA0119288 %long   0xB4792BF4
data.set 0xA011928C %long   0xBF7E5697
data.set 0xA0119290 %long   0xC22D418C
data.set 0xA0119294 %long   0x614C80C6
data.set 0xA0119298 %long   0x20319BE8
data.set 0xA011929C %long   0x2ACDD9F7
data.set 0xA01192A0 %long   0x92477AAF
data.set 0xA01192A4 %long   0xC69A20C5
data.set 0xA01192A8 %long   0xC8FBCD45
data.set 0xA01192AC %long   0xE8E327FA
data.set 0xA01192B0 %long   0x75712CAE
data.set 0xA01192B4 %long   0x12BE2591
data.set 0xA01192B8 %long   0x56B9826A
data.set 0xA01192BC %long   0xCAD8EB27
data.set 0xA01192C0 %long   0x8132A8CC
data.set 0xA01192C4 %long   0x8368B5B4
data.set 0xA01192C8 %long   0x2DB20579
data.set 0xA01192CC %long   0x66BD71BB
data.set 0xA01192D0 %long   0x83319D31
data.set 0xA01192D4 %long   0xE85B0184
data.set 0xA01192D8 %long   0x1BCBAF9F
data.set 0xA01192DC %long   0x1D8DE1B4
data.set 0xA01192E0 %long   0x734F0E22
data.set 0xA01192E4 %long   0xF60DBA89
data.set 0xA01192E8 %long   0xEB3275A8
data.set 0xA01192EC %long   0xBDC1CAD9
data.set 0xA01192F0 %long   0xC5466B0F
data.set 0xA01192F4 %long   0xBD556130
data.set 0xA01192F8 %long   0x34DBFE94
data.set 0xA01192FC %long   0xDA3DDC22
data.set 0xA0119300 %long   0xF4EBB466
data.set 0xA0119304 %long   0x74A0F6B2
data.set 0xA0119308 %long   0x0848FE41
data.set 0xA011930C %long   0x6E8A3994
data.set 0xA0119310 %long   0xF8477B19
data.set 0xA0119314 %long   0x14EE3DF5
data.set 0xA0119318 %long   0x97C8A50E
data.set 0xA011931C %long   0x8A4A9F14
data.set 0xA0119320 %long   0x6BDDF043
data.set 0xA0119324 %long   0xD8D981A8
data.set 0xA0119328 %long   0xA5DA64E0
data.set 0xA011932C %long   0x10992235
data.set 0xA0119330 %long   0x7F77439B
data.set 0xA0119334 %long   0x8C2F3DFF
data.set 0xA0119338 %long   0x852FDD57
data.set 0xA011933C %long   0xA055FF0C
data.set 0xA0119340 %long   0x3037C6B0
data.set 0xA0119344 %long   0x63ACE46B
data.set 0xA0119348 %long   0x6B0A680E
data.set 0xA011934C %long   0x78B0C0F0
data.set 0xA0119350 %long   0x1303CB44
data.set 0xA0119354 %long   0x5587B703
data.set 0xA0119358 %long   0x0DF009D1
data.set 0xA011935C %long   0x5CF9D536
data.set 0xA0119360 %long   0x7DA31DA0
data.set 0xA0119364 %long   0x09B20048
data.set 0xA0119368 %long   0xD2E5AAF2
data.set 0xA011936C %long   0x8AE17182
data.set 0xA0119370 %long   0x5A117225
data.set 0xA0119374 %long   0x87F0BDF5
data.set 0xA0119378 %long   0xBC829132
data.set 0xA011937C %long   0x7784717B
data.set 0xA0119380 %long   0xF09E7535
data.set 0xA0119384 %long   0x59E9AB6B
data.set 0xA0119388 %long   0x83BFB6C2
data.set 0xA011938C %long   0x93049139
data.set 0xA0119390 %long   0x1E9B48EA
data.set 0xA0119394 %long   0x87252D68
data.set 0xA0119398 %long   0x41F1C98E
data.set 0xA011939C %long   0xD7FE8CED
data.set 0xA01193A0 %long   0x600B055A
data.set 0xA01193A4 %long   0xDCBFB902
data.set 0xA01193A8 %long   0xCC76652D
data.set 0xA01193AC %long   0xB412D38A
data.set 0xA01193B0 %long   0xD878ED67
data.set 0xA01193B4 %long   0x577B6695
data.set 0xA01193B8 %long   0x851AB6BA
data.set 0xA01193BC %long   0xC98A9F9C
data.set 0xA01193C0 %long   0x4A38C3E4
data.set 0xA01193C4 %long   0x31DDB8B1
data.set 0xA01193C8 %long   0xEBFC2D35
data.set 0xA01193CC %long   0x99EC02EE
data.set 0xA01193D0 %long   0x8ED575A5
data.set 0xA01193D4 %long   0xD5407B7D
data.set 0xA01193D8 %long   0xA28D6DD2
data.set 0xA01193DC %long   0x1FFFF246
data.set 0xA01193E0 %long   0x4846B446
data.set 0xA01193E4 %long   0x06CABEE8
data.set 0xA01193E8 %long   0xD3E97227
data.set 0xA01193EC %long   0x673F930A
data.set 0xA01193F0 %long   0xF74260B5
data.set 0xA01193F4 %long   0xEE98E676
data.set 0xA01193F8 %long   0xE034083B
data.set 0xA01193FC %long   0x71F6C65A
data.set 0xA0119400 %long   0x8BA0E3B0
data.set 0xA0119404 %long   0x02E3AEEE
data.set 0xA0119408 %long   0x31526A5D
data.set 0xA011940C %long   0x65AF5013
data.set 0xA0119410 %long   0xFC83A55F
data.set 0xA0119414 %long   0xAA43919D
data.set 0xA0119418 %long   0x024081EF
data.set 0xA011941C %long   0xD5BEE322
data.set 0xA0119420 %long   0x770A8E96
data.set 0xA0119424 %long   0x312E434D
data.set 0xA0119428 %long   0xB1DD73C5
data.set 0xA011942C %long   0x21FDC9EF
data.set 0xA0119430 %long   0xBC3837FC
data.set 0xA0119434 %long   0x9114DA5B
data.set 0xA0119438 %long   0x6A4E81E2
data.set 0xA011943C %long   0x44E2AEC7
data.set 0xA0119440 %long   0x7C9933F1
data.set 0xA0119444 %long   0x41319AD2
data.set 0xA0119448 %long   0x94ADB420
data.set 0xA011944C %long   0x6300871F
data.set 0xA0119450 %long   0xB084A67E
data.set 0xA0119454 %long   0xF73C2179
data.set 0xA0119458 %long   0x73B3147E
data.set 0xA011945C %long   0x5C1D7603
data.set 0xA0119460 %long   0x93EEEBC7
data.set 0xA0119464 %long   0x2A4BF0D4
data.set 0xA0119468 %long   0xBD2D0D8E
data.set 0xA011946C %long   0x28252598
data.set 0xA0119470 %long   0xD88ED09D
data.set 0xA0119474 %long   0x413F4E36
data.set 0xA0119478 %long   0x894D61C0
data.set 0xA011947C %long   0x880FBF7B
data.set 0xA0119480 %long   0xCA96DA6D
data.set 0xA0119484 %long   0xC2F55827
data.set 0xA0119488 %long   0x34071753
data.set 0xA011948C %long   0xD2791BAD
data.set 0xA0119490 %long   0x23CFA519
data.set 0xA0119494 %long   0xB8A17012
data.set 0xA0119498 %long   0xF574E8A0
data.set 0xA011949C %long   0xA06E010B
data.set 0xA01194A0 %long   0x2425E3C0
data.set 0xA01194A4 %long   0x230078B7
data.set 0xA01194A8 %long   0xACEF3FF2
data.set 0xA01194AC %long   0x84A97769
data.set 0xA01194B0 %long   0x0ACAFE37
data.set 0xA01194B4 %long   0x20D61141
data.set 0xA01194B8 %long   0xD4FA96D6
data.set 0xA01194BC %long   0x45DCF778
data.set 0xA01194C0 %long   0x2570BE91
data.set 0xA01194C4 %long   0x02835198
data.set 0xA01194C8 %long   0x54A99AD7
data.set 0xA01194CC %long   0xE48F3942
data.set 0xA01194D0 %long   0x4C5A8905
data.set 0xA01194D4 %long   0x9BEF6EC3
data.set 0xA01194D8 %long   0xE8691947
data.set 0xA01194DC %long   0xADB42A73
data.set 0xA01194E0 %long   0x52393757
data.set 0xA01194E4 %long   0xCB091B1C
data.set 0xA01194E8 %long   0x15EAB885
data.set 0xA01194EC %long   0x817785C8
data.set 0xA01194F0 %long   0x070627AB
data.set 0xA01194F4 %long   0xB07D2CFF
data.set 0xA01194F8 %long   0x86A9CC41
data.set 0xA01194FC %long   0x534E4283
data.set 0xA0119500 %long   0x2783EAF8
data.set 0xA0119504 %long   0xA8E2AA1A
data.set 0xA0119508 %long   0x2BFACB60
data.set 0xA011950C %long   0x2BFB9F54
data.set 0xA0119510 %long   0xECFEADCD
data.set 0xA0119514 %long   0x8D892E6E
data.set 0xA0119518 %long   0x76FF9F6A
data.set 0xA011951C %long   0x2A8CF66C
data.set 0xA0119520 %long   0x58EC8C7A
data.set 0xA0119524 %long   0x6D70EDA6
data.set 0xA0119528 %long   0x6B6568B4
data.set 0xA011952C %long   0x46F1C9F9
data.set 0xA0119530 %long   0x43FEB1A7
data.set 0xA0119534 %long   0x7F60712C
data.set 0xA0119538 %long   0x23D5CAFB
data.set 0xA011953C %long   0x99B7AC64
data.set 0xA0119540 %long   0xA8AE7DD2
data.set 0xA0119544 %long   0x5F4ECD76
data.set 0xA0119548 %long   0x95735E2E
data.set 0xA011954C %long   0x1BB985EC
data.set 0xA0119550 %long   0xF4F54194
data.set 0xA0119554 %long   0xBF6403C4
data.set 0xA0119558 %long   0xA3082D49
data.set 0xA011955C %long   0x61D2CD0E
data.set 0xA0119560 %long   0x39E177A8
data.set 0xA0119564 %long   0x5D28384B
data.set 0xA0119568 %long   0xFEA0B4E0
data.set 0xA011956C %long   0xC8365238
data.set 0xA0119570 %long   0x26C49ADA
data.set 0xA0119574 %long   0x086ADBF9
data.set 0xA0119578 %long   0x4169F322
data.set 0xA011957C %long   0xB180D40B
data.set 0xA0119580 %long   0x1D1AEE8E
data.set 0xA0119584 %long   0xFFADA190
data.set 0xA0119588 %long   0x30583AB2
data.set 0xA011958C %long   0xD2BF32DB
data.set 0xA0119590 %long   0x49E83463
data.set 0xA0119594 %long   0xD47C6404
data.set 0xA0119598 %long   0xC722B308
data.set 0xA011959C %long   0x5254F957
data.set 0xA01195A0 %long   0x37710728
data.set 0xA01195A4 %long   0xD1D6340C
data.set 0xA01195A8 %long   0x63DC4533
data.set 0xA01195AC %long   0xCB3E0E04
data.set 0xA01195B0 %long   0x83FB9FDF
data.set 0xA01195B4 %long   0xE5800CD5
data.set 0xA01195B8 %long   0x4B6BB97D
data.set 0xA01195BC %long   0x48E398CF
data.set 0xA01195C0 %long   0xD3AC9DEB
data.set 0xA01195C4 %long   0xCB409A34
data.set 0xA01195C8 %long   0x6870E3C1
data.set 0xA01195CC %long   0x5C0DE41E
data.set 0xA01195D0 %long   0xCC5BF64C
data.set 0xA01195D4 %long   0x2CAC6915
data.set 0xA01195D8 %long   0xF93B9838
data.set 0xA01195DC %long   0x7290046B
data.set 0xA01195E0 %long   0x82873FFC
data.set 0xA01195E4 %long   0x27DF6AA3
data.set 0xA01195E8 %long   0xFD74F493
data.set 0xA01195EC %long   0xA3AFF442
data.set 0xA01195F0 %long   0xAEAEA8D2
data.set 0xA01195F4 %long   0xE67E6CED
data.set 0xA01195F8 %long   0xAD58E7C4
data.set 0xA01195FC %long   0x7E530A51
data.set 0xA0119600 %long   0xE30F37FA
data.set 0xA0119604 %long   0x63002F57
data.set 0xA0119608 %long   0xFF61BD21
data.set 0xA011960C %long   0x88C2940C
data.set 0xA0119610 %long   0xD71C89FA
data.set 0xA0119614 %long   0xC8138CA9
data.set 0xA0119618 %long   0x0BAA7FA0
data.set 0xA011961C %long   0x2BC3B563
data.set 0xA0119620 %long   0xD4354CA1
data.set 0xA0119624 %long   0xB7ECD611
data.set 0xA0119628 %long   0xC32F269F
data.set 0xA011962C %long   0xFB0EF79E
data.set 0xA0119630 %long   0xD7CC2AAA
data.set 0xA0119634 %long   0xD6D91520
data.set 0xA0119638 %long   0x3FDDE084
data.set 0xA011963C %long   0x03F6F913
data.set 0xA0119640 %long   0xD887863F
data.set 0xA0119644 %long   0xB7047E89
data.set 0xA0119648 %long   0x464706D8
data.set 0xA011964C %long   0x5C14A048
data.set 0xA0119650 %long   0xE3B11385
data.set 0xA0119654 %long   0x00E26006
data.set 0xA0119658 %long   0x22C76BD0
data.set 0xA011965C %long   0xF3CBB304
data.set 0xA0119660 %long   0x46DA7C69
data.set 0xA0119664 %long   0xABCC9908
data.set 0xA0119668 %long   0x115B2478
data.set 0xA011966C %long   0xDEA6E4D0
data.set 0xA0119670 %long   0x07878C12
data.set 0xA0119674 %long   0xB8534F45
data.set 0xA0119678 %long   0xDDC27901
data.set 0xA011967C %long   0x7CF5058B
data.set 0xA0119680 %long   0x773102CD
data.set 0xA0119684 %long   0xD67A3AC4
data.set 0xA0119688 %long   0x307310ED
data.set 0xA011968C %long   0xAE6B120A
data.set 0xA0119690 %long   0x0CD16A43
data.set 0xA0119694 %long   0xE7DF3778
data.set 0xA0119698 %long   0xAFC6017C
data.set 0xA011969C %long   0x6FA07179
data.set 0xA01196A0 %long   0xF366A9DA
data.set 0xA01196A4 %long   0xD76AD675
data.set 0xA01196A8 %long   0x72A8DAD3
data.set 0xA01196AC %long   0xAC90E41D
data.set 0xA01196B0 %long   0xE7D7A720
data.set 0xA01196B4 %long   0xF31C976A
data.set 0xA01196B8 %long   0x8DB08675
data.set 0xA01196BC %long   0x29D1ABB2
data.set 0xA01196C0 %long   0xC1512EAF
data.set 0xA01196C4 %long   0x8506DB0A
data.set 0xA01196C8 %long   0x04BC5CCD
data.set 0xA01196CC %long   0xA1FADB9C
data.set 0xA01196D0 %long   0xE3943418
data.set 0xA01196D4 %long   0x11C1C920
data.set 0xA01196D8 %long   0x20839702
data.set 0xA01196DC %long   0x182FAD8E
data.set 0xA01196E0 %long   0x2D7B0962
data.set 0xA01196E4 %long   0x64DFD00D
data.set 0xA01196E8 %long   0x424585A4
data.set 0xA01196EC %long   0x4A4AA4AA
data.set 0xA01196F0 %long   0x9C681B1F
data.set 0xA01196F4 %long   0x5281CC14
data.set 0xA01196F8 %long   0x65E826E0
data.set 0xA01196FC %long   0x59FE441E
data.set 0xA0119700 %long   0xB7E4DFAE
data.set 0xA0119704 %long   0x0FF9DE97
data.set 0xA0119708 %long   0xCAB96880
data.set 0xA011970C %long   0x5EC118D0
data.set 0xA0119710 %long   0x7A4B8F4C
data.set 0xA0119714 %long   0xE1423164
data.set 0xA0119718 %long   0x08FF9C8F
data.set 0xA011971C %long   0x1FE6BD7A
data.set 0xA0119720 %long   0x512CB231
data.set 0xA0119724 %long   0xFFECFDA2
data.set 0xA0119728 %long   0x005738C5
data.set 0xA011972C %long   0x6BB25A7B
data.set 0xA0119730 %long   0xE6BBCBC4
data.set 0xA0119734 %long   0x67497B40
data.set 0xA0119738 %long   0xEE65EC74
data.set 0xA011973C %long   0xC50EDDB3
data.set 0xA0119740 %long   0xB40C7C24
data.set 0xA0119744 %long   0x846AA024
data.set 0xA0119748 %long   0xEA25D959
data.set 0xA011974C %long   0x99946647
data.set 0xA0119750 %long   0x3F34018F
data.set 0xA0119754 %long   0x8357ABDA
data.set 0xA0119758 %long   0x667525B2
data.set 0xA011975C %long   0x10D7026D
data.set 0xA0119760 %long   0x17EC1C16
data.set 0xA0119764 %long   0x848C040D
data.set 0xA0119768 %long   0x70CA3CC7
data.set 0xA011976C %long   0xBADAC6D0
data.set 0xA0119770 %long   0x8EC0E352
data.set 0xA0119774 %long   0x3537E7FA
data.set 0xA0119778 %long   0xDFA95E15
data.set 0xA011977C %long   0x3593E24B
data.set 0xA0119780 %long   0x6A2DB1D9
data.set 0xA0119784 %long   0xC9D6ECAE
data.set 0xA0119788 %long   0xC0A136C4
data.set 0xA011978C %long   0x906D517C
data.set 0xA0119790 %long   0x45E19166
data.set 0xA0119794 %long   0x968A8832
data.set 0xA0119798 %long   0xB7C50E2A
data.set 0xA011979C %long   0xBCD53C82
data.set 0xA01197A0 %long   0x86650A75
data.set 0xA01197A4 %long   0x337A2B30
data.set 0xA01197A8 %long   0x8F8E2E1E
data.set 0xA01197AC %long   0x89F55FF6
data.set 0xA01197B0 %long   0x754FBB4A
data.set 0xA01197B4 %long   0x2D915171
data.set 0xA01197B8 %long   0xA565F729
data.set 0xA01197BC %long   0x899235E5
data.set 0xA01197C0 %long   0xFE722DE7
data.set 0xA01197C4 %long   0xB0A2D18B
data.set 0xA01197C8 %long   0xE69137CE
data.set 0xA01197CC %long   0x58720B8B
data.set 0xA01197D0 %long   0x0D632924
data.set 0xA01197D4 %long   0x47250784
data.set 0xA01197D8 %long   0x4A85D6B2
data.set 0xA01197DC %long   0x3DF11BED
data.set 0xA01197E0 %long   0x364DDF20
data.set 0xA01197E4 %long   0x011D0B48
data.set 0xA01197E8 %long   0x4FFA50ED
data.set 0xA01197EC %long   0x7C5DEAE0
data.set 0xA01197F0 %long   0x01D08CC7
data.set 0xA01197F4 %long   0x31B59D22
data.set 0xA01197F8 %long   0x242D6504
data.set 0xA01197FC %long   0x5A6694CF
data.set 0xA0119800 %long   0xB6E8EAA9
data.set 0xA0119804 %long   0x89F6F860
data.set 0xA0119808 %long   0xBC311AED
data.set 0xA011980C %long   0xC64B4FC5
data.set 0xA0119810 %long   0x5A903E40
data.set 0xA0119814 %long   0x28BA71CF
data.set 0xA0119818 %long   0x3CC1980A
data.set 0xA011981C %long   0x3976D743
data.set 0xA0119820 %long   0x4520D044
data.set 0xA0119824 %long   0x71911C84
data.set 0xA0119828 %long   0xBD94CABC
data.set 0xA011982C %long   0x84FC9B29
data.set 0xA0119830 %long   0xD07D8336
data.set 0xA0119834 %long   0x52874FF3
data.set 0xA0119838 %long   0x971B83F9
data.set 0xA011983C %long   0x2F601F48
data.set 0xA0119840 %long   0x1329729B
data.set 0xA0119844 %long   0x15CB0CC8
data.set 0xA0119848 %long   0x9250A997
data.set 0xA011984C %long   0xCFF8E239
data.set 0xA0119850 %long   0x405DD1F6
data.set 0xA0119854 %long   0x0B2E5EB2
data.set 0xA0119858 %long   0xA568D2AA
data.set 0xA011985C %long   0x5C26232B
data.set 0xA0119860 %long   0x70D76DB3
data.set 0xA0119864 %long   0xCEF76F1B
data.set 0xA0119868 %long   0x073BD9BC
data.set 0xA011986C %long   0x5289EE47
data.set 0xA0119870 %long   0xFF848C78
data.set 0xA0119874 %long   0xA73FBCF7
data.set 0xA0119878 %long   0x76B96570
data.set 0xA011987C %long   0x7DD73916
data.set 0xA0119880 %long   0xE200477D
data.set 0xA0119884 %long   0xF725D073
data.set 0xA0119888 %long   0x109CA406
data.set 0xA011988C %long   0x09B0903A
data.set 0xA0119890 %long   0xF937FE04
data.set 0xA0119894 %long   0x5CB3ADC3
data.set 0xA0119898 %long   0x1E35B142
data.set 0xA011989C %long   0x82E71C3E
data.set 0xA01198A0 %long   0x28EE7F1B
data.set 0xA01198A4 %long   0x983AFFE2
data.set 0xA01198A8 %long   0x1022DAFF
data.set 0xA01198AC %long   0x20E6FE36
data.set 0xA01198B0 %long   0x99AA72C7
data.set 0xA01198B4 %long   0x6152878D
data.set 0xA01198B8 %long   0x1D02D904
data.set 0xA01198BC %long   0x89E782E6
data.set 0xA01198C0 %long   0x62605DF2
data.set 0xA01198C4 %long   0xF186DF0A
data.set 0xA01198C8 %long   0x2D069364
data.set 0xA01198CC %long   0xDBC622E4
data.set 0xA01198D0 %long   0x7710AF03
data.set 0xA01198D4 %long   0xEB21A6C9
data.set 0xA01198D8 %long   0x638654A1
data.set 0xA01198DC %long   0x55AC69A9
data.set 0xA01198E0 %long   0x09FF4232
data.set 0xA01198E4 %long   0x713B3636
data.set 0xA01198E8 %long   0x6F158C78
data.set 0xA01198EC %long   0x088E83AD
data.set 0xA01198F0 %long   0x140542AD
data.set 0xA01198F4 %long   0x7621B6A3
data.set 0xA01198F8 %long   0x12D2CE21
data.set 0xA01198FC %long   0x6DC3E276
data.set 0xA0119900 %long   0x485CE95C
data.set 0xA0119904 %long   0xBB56C785
data.set 0xA0119908 %long   0x8B9767EF
data.set 0xA011990C %long   0x39AC4651
data.set 0xA0119910 %long   0x9BC850DE
data.set 0xA0119914 %long   0xF4616BFB
data.set 0xA0119918 %long   0xA2C9C215
data.set 0xA011991C %long   0x4CCBEAA5
data.set 0xA0119920 %long   0xD4ED6C26
data.set 0xA0119924 %long   0xED8E2FA5
data.set 0xA0119928 %long   0x1552BB8E
data.set 0xA011992C %long   0x940B2A3F
data.set 0xA0119930 %long   0xA29EDCD6
data.set 0xA0119934 %long   0xFA200540
data.set 0xA0119938 %long   0x8264B19E
data.set 0xA011993C %long   0xFFAC6E25
data.set 0xA0119940 %long   0xD7B2B207
data.set 0xA0119944 %long   0xB5800C4D
data.set 0xA0119948 %long   0x6A5674DB
data.set 0xA011994C %long   0xC1F1CE09
data.set 0xA0119950 %long   0xAA2B19F0
data.set 0xA0119954 %long   0x900FCC24
data.set 0xA0119958 %long   0xFF1D9081
data.set 0xA011995C %long   0xCE0CD2BA
data.set 0xA0119960 %long   0x918875EE
data.set 0xA0119964 %long   0xDBC117BD
data.set 0xA0119968 %long   0xAF661DF5
data.set 0xA011996C %long   0xA8BB28F4
data.set 0xA0119970 %long   0x81EDFF49
data.set 0xA0119974 %long   0xE43A1716
data.set 0xA0119978 %long   0x8E583582
data.set 0xA011997C %long   0x5998DD97
data.set 0xA0119980 %long   0x67CD7E85
data.set 0xA0119984 %long   0x088AD87C
data.set 0xA0119988 %long   0x01CCD261
data.set 0xA011998C %long   0x1796040D
data.set 0xA0119990 %long   0x86BE9CCD
data.set 0xA0119994 %long   0xCAA287A5
data.set 0xA0119998 %long   0xC1065038
data.set 0xA011999C %long   0x97038116
data.set 0xA01199A0 %long   0x1AC4F6BF
data.set 0xA01199A4 %long   0x9FFCEC46
data.set 0xA01199A8 %long   0xD395D194
data.set 0xA01199AC %long   0xDC56BB98
data.set 0xA01199B0 %long   0x0758E4F9
data.set 0xA01199B4 %long   0xAC0A10FE
data.set 0xA01199B8 %long   0xFB7D6E7E
data.set 0xA01199BC %long   0xD14743D0
data.set 0xA01199C0 %long   0x8D92A7EE
data.set 0xA01199C4 %long   0x64672AE7
data.set 0xA01199C8 %long   0xDEDFD1FE
data.set 0xA01199CC %long   0x7736A9BD
data.set 0xA01199D0 %long   0x0854A217
data.set 0xA01199D4 %long   0x3E9F757D
data.set 0xA01199D8 %long   0xD8D4B4B8
data.set 0xA01199DC %long   0xE4EAB75C
data.set 0xA01199E0 %long   0x0510A15C
data.set 0xA01199E4 %long   0x6461C1D4
data.set 0xA01199E8 %long   0x12E8918E
data.set 0xA01199EC %long   0x3F15B1E0
data.set 0xA01199F0 %long   0xE5E5FED9
data.set 0xA01199F4 %long   0x0E5072EB
data.set 0xA01199F8 %long   0x977F78A6
data.set 0xA01199FC %long   0xD147A5E8
data.set 0xA0119A00 %long   0x8FE44C7D
data.set 0xA0119A04 %long   0xFAA733E0
data.set 0xA0119A08 %long   0x4B7E16C2
data.set 0xA0119A0C %long   0x4E2C2990
data.set 0xA0119A10 %long   0xAB93C37D
data.set 0xA0119A14 %long   0x478A3547
data.set 0xA0119A18 %long   0xB328D4F8
data.set 0xA0119A1C %long   0xE5350921
data.set 0xA0119A20 %long   0x08C5AA2B
data.set 0xA0119A24 %long   0xE2EAC038
data.set 0xA0119A28 %long   0x95F74E49
data.set 0xA0119A2C %long   0x96DF0E75
data.set 0xA0119A30 %long   0x46ABB203
data.set 0xA0119A34 %long   0x87A6A65C
data.set 0xA0119A38 %long   0xFA9D1DCF
data.set 0xA0119A3C %long   0x2AC28C56
data.set 0xA0119A40 %long   0x6145296F
data.set 0xA0119A44 %long   0xB0168F0E
data.set 0xA0119A48 %long   0x8C56F2C2
data.set 0xA0119A4C %long   0x130AC45E
data.set 0xA0119A50 %long   0x2F255D2B
data.set 0xA0119A54 %long   0xED9CB79B
data.set 0xA0119A58 %long   0xFF68614B
data.set 0xA0119A5C %long   0x20C5484A
data.set 0xA0119A60 %long   0x99286207
data.set 0xA0119A64 %long   0x6156AC4A
data.set 0xA0119A68 %long   0xD452AE52
data.set 0xA0119A6C %long   0x37D269FC
data.set 0xA0119A70 %long   0x293588EB
data.set 0xA0119A74 %long   0x0072970B
data.set 0xA0119A78 %long   0xF88DC40B
data.set 0xA0119A7C %long   0x4A4D84DE
data.set 0xA0119A80 %long   0xEC441B4F
data.set 0xA0119A84 %long   0xC7D2AD09
data.set 0xA0119A88 %long   0x4BADEA88
data.set 0xA0119A8C %long   0x939670D0
data.set 0xA0119A90 %long   0x349E8CDB
data.set 0xA0119A94 %long   0x7A237440
data.set 0xA0119A98 %long   0x92BCAD93
data.set 0xA0119A9C %long   0xDA155494
data.set 0xA0119AA0 %long   0xFCC39F9D
data.set 0xA0119AA4 %long   0x332E7132
data.set 0xA0119AA8 %long   0x62AB80F8
data.set 0xA0119AAC %long   0xF1CAC2AA
data.set 0xA0119AB0 %long   0xF3312993
data.set 0xA0119AB4 %long   0xE71B6074
data.set 0xA0119AB8 %long   0x5B8CEC94
data.set 0xA0119ABC %long   0x978A629A
data.set 0xA0119AC0 %long   0xA50769FF
data.set 0xA0119AC4 %long   0xBA95DCCB
data.set 0xA0119AC8 %long   0xBBE0A640
data.set 0xA0119ACC %long   0xC467324A
data.set 0xA0119AD0 %long   0xAFC6489C
data.set 0xA0119AD4 %long   0x6D744C78
data.set 0xA0119AD8 %long   0xB0014F3C
data.set 0xA0119ADC %long   0x36AB03C1
data.set 0xA0119AE0 %long   0x487B7C36
data.set 0xA0119AE4 %long   0xAEC3A9BA
data.set 0xA0119AE8 %long   0x6304A71C
data.set 0xA0119AEC %long   0xC1BFEF54
data.set 0xA0119AF0 %long   0x3C8F22D2
data.set 0xA0119AF4 %long   0x0F559006
data.set 0xA0119AF8 %long   0x507682CC
data.set 0xA0119AFC %long   0xA8A713F2
data.set 0xA0119B00 %long   0x4595C106
data.set 0xA0119B04 %long   0x1870CCC6
data.set 0xA0119B08 %long   0xC6B15BAB
data.set 0xA0119B0C %long   0x4C9CE929
data.set 0xA0119B10 %long   0x59C0541F
data.set 0xA0119B14 %long   0x7932FCC8
data.set 0xA0119B18 %long   0x8FAC5773
data.set 0xA0119B1C %long   0x1967AA8C
data.set 0xA0119B20 %long   0x3D3FF299
data.set 0xA0119B24 %long   0x75CE0576
data.set 0xA0119B28 %long   0x50194838
data.set 0xA0119B2C %long   0x5F6FCB38
data.set 0xA0119B30 %long   0x174E4845
data.set 0xA0119B34 %long   0x98DF38A3
data.set 0xA0119B38 %long   0xB55F071B
data.set 0xA0119B3C %long   0x07667B63
data.set 0xA0119B40 %long   0xE929C253
data.set 0xA0119B44 %long   0xF7EBC5B4
data.set 0xA0119B48 %long   0x79C580FA
data.set 0xA0119B4C %long   0xCE3E9525
data.set 0xA0119B50 %long   0xBEA11F4A
data.set 0xA0119B54 %long   0x07E310F1
data.set 0xA0119B58 %long   0x208F0630
data.set 0xA0119B5C %long   0xDC19111C
data.set 0xA0119B60 %long   0x1608B611
data.set 0xA0119B64 %long   0xCC345C76
data.set 0xA0119B68 %long   0x81137EAE
data.set 0xA0119B6C %long   0x92F1B642
data.set 0xA0119B70 %long   0x7B41E7BA
data.set 0xA0119B74 %long   0xAE543D17
data.set 0xA0119B78 %long   0x15CED149
data.set 0xA0119B7C %long   0x193F0F3D
data.set 0xA0119B80 %long   0x0D452F9E
data.set 0xA0119B84 %long   0x0FEF582D
data.set 0xA0119B88 %long   0xF0BA4BB3
data.set 0xA0119B8C %long   0xECF1FB49
data.set 0xA0119B90 %long   0x0AEF769F
data.set 0xA0119B94 %long   0x90F5D2F9
data.set 0xA0119B98 %long   0xEE87C174
data.set 0xA0119B9C %long   0x777F2B5B
data.set 0xA0119BA0 %long   0x4D2370A8
data.set 0xA0119BA4 %long   0xCF32BBB5
data.set 0xA0119BA8 %long   0xFC8BDA76
data.set 0xA0119BAC %long   0xAE864794
data.set 0xA0119BB0 %long   0x7B807DFA
data.set 0xA0119BB4 %long   0xC47EAD6A
data.set 0xA0119BB8 %long   0x8A3C0B21
data.set 0xA0119BBC %long   0xC6F59A0E
data.set 0xA0119BC0 %long   0x327A83BE
data.set 0xA0119BC4 %long   0x0B69DA61
data.set 0xA0119BC8 %long   0xEE3374AC
data.set 0xA0119BCC %long   0xE604F410
data.set 0xA0119BD0 %long   0xEAC259B2
data.set 0xA0119BD4 %long   0xC3D50D5D
data.set 0xA0119BD8 %long   0x91F78928
data.set 0xA0119BDC %long   0x359C21E0
data.set 0xA0119BE0 %long   0xCD0770B3
data.set 0xA0119BE4 %long   0xEDE07F9C
data.set 0xA0119BE8 %long   0xB5B349B8
data.set 0xA0119BEC %long   0x509CC82B
data.set 0xA0119BF0 %long   0xF6A52876
data.set 0xA0119BF4 %long   0xFBA60F4F
data.set 0xA0119BF8 %long   0x693762A7
data.set 0xA0119BFC %long   0x97215C66
data.set 0xA0119C00 %long   0x203E5C4B
data.set 0xA0119C04 %long   0xB15C73AB
data.set 0xA0119C08 %long   0xFBBD6971
data.set 0xA0119C0C %long   0xDA54B9CD
data.set 0xA0119C10 %long   0x7C13EED3
data.set 0xA0119C14 %long   0x639A1C05
data.set 0xA0119C18 %long   0x40A17A9E
data.set 0xA0119C1C %long   0x07F1981D
data.set 0xA0119C20 %long   0xA72DF5EE
data.set 0xA0119C24 %long   0xB3415589
data.set 0xA0119C28 %long   0xA49A9ED7
data.set 0xA0119C2C %long   0x61266D6B
data.set 0xA0119C30 %long   0xF9432D6C
data.set 0xA0119C34 %long   0x26EA86E4
data.set 0xA0119C38 %long   0xC9693AAE
data.set 0xA0119C3C %long   0x05244416
data.set 0xA0119C40 %long   0xC0F3BAFB
data.set 0xA0119C44 %long   0xB713803E
data.set 0xA0119C48 %long   0xA7FE3646
data.set 0xA0119C4C %long   0xE74CDF94
data.set 0xA0119C50 %long   0xCA186559
data.set 0xA0119C54 %long   0x260D069A
data.set 0xA0119C58 %long   0x5FE6D1F2
data.set 0xA0119C5C %long   0x9E61C46E
data.set 0xA0119C60 %long   0xDB64A366
data.set 0xA0119C64 %long   0x597E6CD3
data.set 0xA0119C68 %long   0x0A2AFA85
data.set 0xA0119C6C %long   0x7BD87E57
data.set 0xA0119C70 %long   0x5908CB67
data.set 0xA0119C74 %long   0x761BE681
data.set 0xA0119C78 %long   0xA2AB74ED
data.set 0xA0119C7C %long   0x32ECBC48
data.set 0xA0119C80 %long   0xB5C77CD2
data.set 0xA0119C84 %long   0x580B6D9E
data.set 0xA0119C88 %long   0xD2F5C504
data.set 0xA0119C8C %long   0x9FA3E8B4
data.set 0xA0119C90 %long   0x84F7B633
data.set 0xA0119C94 %long   0xE7B4C0FC
data.set 0xA0119C98 %long   0xF454E614
data.set 0xA0119C9C %long   0x2B71A4B0
data.set 0xA0119CA0 %long   0xF239AF21
data.set 0xA0119CA4 %long   0xA9E9FDD7
data.set 0xA0119CA8 %long   0x3C73B778
data.set 0xA0119CAC %long   0x911CF31A
data.set 0xA0119CB0 %long   0x8439340A
data.set 0xA0119CB4 %long   0x9F05EC4C
data.set 0xA0119CB8 %long   0xEC7EA8D8
data.set 0xA0119CBC %long   0xD3718595
data.set 0xA0119CC0 %long   0xF6EDA3A6
data.set 0xA0119CC4 %long   0x351A8565
data.set 0xA0119CC8 %long   0xA32ED4B7
data.set 0xA0119CCC %long   0x8F97EA60
data.set 0xA0119CD0 %long   0xD46430C3
data.set 0xA0119CD4 %long   0xB548C493
data.set 0xA0119CD8 %long   0x86CD5A81
data.set 0xA0119CDC %long   0x157B4F80
data.set 0xA0119CE0 %long   0x0CC846BD
data.set 0xA0119CE4 %long   0xF4509596
data.set 0xA0119CE8 %long   0xC73CA857
data.set 0xA0119CEC %long   0x31224628
data.set 0xA0119CF0 %long   0x04177BE0
data.set 0xA0119CF4 %long   0xA56F6D5E
data.set 0xA0119CF8 %long   0x59EA62B9
data.set 0xA0119CFC %long   0x9234C087
data.set 0xA0119D00 %long   0x6C710224
data.set 0xA0119D04 %long   0xD48241DF
data.set 0xA0119D08 %long   0x5C64B536
data.set 0xA0119D0C %long   0xD44C3D9A
data.set 0xA0119D10 %long   0xFA12E09F
data.set 0xA0119D14 %long   0x817436C9
data.set 0xA0119D18 %long   0xD3C2EDE0
data.set 0xA0119D1C %long   0x1165D12A
data.set 0xA0119D20 %long   0x86179A88
data.set 0xA0119D24 %long   0x4B94676B
data.set 0xA0119D28 %long   0x48744AD8
data.set 0xA0119D2C %long   0xACB6221C
data.set 0xA0119D30 %long   0x0CF19DAD
data.set 0xA0119D34 %long   0x2D756130
data.set 0xA0119D38 %long   0x5D4E6AFB
data.set 0xA0119D3C %long   0x7D7B2345
data.set 0xA0119D40 %long   0x86ED6BA5
data.set 0xA0119D44 %long   0xFDBD2E98
data.set 0xA0119D48 %long   0x462AA521
data.set 0xA0119D4C %long   0x2603CCA0
data.set 0xA0119D50 %long   0x488BF8AA
data.set 0xA0119D54 %long   0x47C9C95F
data.set 0xA0119D58 %long   0x1F6253FD
data.set 0xA0119D5C %long   0xB32920C0
data.set 0xA0119D60 %long   0xBC146D78
data.set 0xA0119D64 %long   0xDE7ABDBE
data.set 0xA0119D68 %long   0xBA967DBE
data.set 0xA0119D6C %long   0x71986F54
data.set 0xA0119D70 %long   0xF27FBD6E
data.set 0xA0119D74 %long   0x0BAB4D9F
data.set 0xA0119D78 %long   0x252F3175
data.set 0xA0119D7C %long   0xC6031ACA
data.set 0xA0119D80 %long   0x14747C27
data.set 0xA0119D84 %long   0x84333A40
data.set 0xA0119D88 %long   0x8DDFBACB
data.set 0xA0119D8C %long   0xDC105372
data.set 0xA0119D90 %long   0xB58B5FA7
data.set 0xA0119D94 %long   0x8FC5683E
data.set 0xA0119D98 %long   0x25009E7C
data.set 0xA0119D9C %long   0x3E243D74
data.set 0xA0119DA0 %long   0x8C38E662
data.set 0xA0119DA4 %long   0x69F406B1
data.set 0xA0119DA8 %long   0x2A9AC664
data.set 0xA0119DAC %long   0x7E756C23
data.set 0xA0119DB0 %long   0x88FE3E37
data.set 0xA0119DB4 %long   0xA3559A35
data.set 0xA0119DB8 %long   0x89DC96D1
data.set 0xA0119DBC %long   0x72911D4F
data.set 0xA0119DC0 %long   0x039A2EF6
data.set 0xA0119DC4 %long   0x5A55C15A
data.set 0xA0119DC8 %long   0xDB451986
data.set 0xA0119DCC %long   0x584439CE
data.set 0xA0119DD0 %long   0xE19A15C2
data.set 0xA0119DD4 %long   0x74FA2AD6
data.set 0xA0119DD8 %long   0x2A59DDF1
data.set 0xA0119DDC %long   0xC432F2CF
data.set 0xA0119DE0 %long   0x158631BC
data.set 0xA0119DE4 %long   0xBA5557C3
data.set 0xA0119DE8 %long   0x562E1208
data.set 0xA0119DEC %long   0x98A6ED5E
data.set 0xA0119DF0 %long   0x33EB3B64
data.set 0xA0119DF4 %long   0x4E17CBE0
data.set 0xA0119DF8 %long   0x220F7AD8
data.set 0xA0119DFC %long   0x5D7B3F64
data.set 0xA0119E00 %long   0x01473EFB
data.set 0xA0119E04 %long   0xC646720E
data.set 0xA0119E08 %long   0xFE344395
data.set 0xA0119E0C %long   0xFA185AA8
data.set 0xA0119E10 %long   0xD87AE05C
data.set 0xA0119E14 %long   0x170DBE0F
data.set 0xA0119E18 %long   0x2AD79376
data.set 0xA0119E1C %long   0xF6B64F58
data.set 0xA0119E20 %long   0x6A7AC862
data.set 0xA0119E24 %long   0xD3E580AE
data.set 0xA0119E28 %long   0x9F710B2E
data.set 0xA0119E2C %long   0x5B401243
data.set 0xA0119E30 %long   0x66626B0A
data.set 0xA0119E34 %long   0x3EFCB0C2
data.set 0xA0119E38 %long   0x64D6B7C3
data.set 0xA0119E3C %long   0xC07FF31E
data.set 0xA0119E40 %long   0xB625386D
data.set 0xA0119E44 %long   0x3C784B0F
data.set 0xA0119E48 %long   0x028A49DF
data.set 0xA0119E4C %long   0x69017FEE
data.set 0xA0119E50 %long   0xB502AFFD
data.set 0xA0119E54 %long   0x6D7C4AA8
data.set 0xA0119E58 %long   0x1478D9E4
data.set 0xA0119E5C %long   0xF99FF370
data.set 0xA0119E60 %long   0x55863C0C
data.set 0xA0119E64 %long   0x5017486A
data.set 0xA0119E68 %long   0x9E09DF3D
data.set 0xA0119E6C %long   0x42D8B7F6
data.set 0xA0119E70 %long   0xE272F3E4
data.set 0xA0119E74 %long   0x82ACEE8F
data.set 0xA0119E78 %long   0xB4B85B74
data.set 0xA0119E7C %long   0x04B30CC1
data.set 0xA0119E80 %long   0x821BC10C
data.set 0xA0119E84 %long   0x556FCB0E
data.set 0xA0119E88 %long   0x93FC845D
data.set 0xA0119E8C %long   0xCE1CEA3D
data.set 0xA0119E90 %long   0x19A3F195
data.set 0xA0119E94 %long   0xB7F9D77E
data.set 0xA0119E98 %long   0xFF7AFEBC
data.set 0xA0119E9C %long   0xADB1DDB7
data.set 0xA0119EA0 %long   0x9CA7B95D
data.set 0xA0119EA4 %long   0x45BCBD66
data.set 0xA0119EA8 %long   0x5CFBE3A1
data.set 0xA0119EAC %long   0xFAADFD13
data.set 0xA0119EB0 %long   0xE27286D8
data.set 0xA0119EB4 %long   0xA5B09B87
data.set 0xA0119EB8 %long   0xFF203827
data.set 0xA0119EBC %long   0x29FA2343
data.set 0xA0119EC0 %long   0xE3CF69CD
data.set 0xA0119EC4 %long   0xE68A508A
data.set 0xA0119EC8 %long   0x526B34FB
data.set 0xA0119ECC %long   0x28E70828
data.set 0xA0119ED0 %long   0xD4B040AE
data.set 0xA0119ED4 %long   0xA9A75796
data.set 0xA0119ED8 %long   0x1147AB04
data.set 0xA0119EDC %long   0x3C21721E
data.set 0xA0119EE0 %long   0x7EE8DBB1
data.set 0xA0119EE4 %long   0xCD52776F
data.set 0xA0119EE8 %long   0x95458AC3
data.set 0xA0119EEC %long   0x0BC47A53
data.set 0xA0119EF0 %long   0x7FEE9705
data.set 0xA0119EF4 %long   0xFAA750CB
data.set 0xA0119EF8 %long   0x29462267
data.set 0xA0119EFC %long   0x86E7E741
data.set 0xA0119F00 %long   0xF89C9D70
data.set 0xA0119F04 %long   0xAF56446C
data.set 0xA0119F08 %long   0xD53E3E3E
data.set 0xA0119F0C %long   0x8CFF5397
data.set 0xA0119F10 %long   0x2888C863
data.set 0xA0119F14 %long   0xF726221F
data.set 0xA0119F18 %long   0x0C6B1302
data.set 0xA0119F1C %long   0x3E86CA71
data.set 0xA0119F20 %long   0x95602F78
data.set 0xA0119F24 %long   0x22F918E8
data.set 0xA0119F28 %long   0x04E99742
data.set 0xA0119F2C %long   0x7FEC14B2
data.set 0xA0119F30 %long   0x0CB7DCE2
data.set 0xA0119F34 %long   0x967FDD3A
data.set 0xA0119F38 %long   0x77AAADAB
data.set 0xA0119F3C %long   0x49C5C4F0
data.set 0xA0119F40 %long   0x5BD02595
data.set 0xA0119F44 %long   0xEEE1D5DC
data.set 0xA0119F48 %long   0xCD6F4BED
data.set 0xA0119F4C %long   0x224F188A
data.set 0xA0119F50 %long   0xB0EE8525
data.set 0xA0119F54 %long   0x8F3C684D
data.set 0xA0119F58 %long   0xC079EDEC
data.set 0xA0119F5C %long   0xFDC4D0BC
data.set 0xA0119F60 %long   0xED700611
data.set 0xA0119F64 %long   0xAB770515
data.set 0xA0119F68 %long   0xCE249185
data.set 0xA0119F6C %long   0x01D15EDC
data.set 0xA0119F70 %long   0x7EECB519
data.set 0xA0119F74 %long   0x61354E1E
data.set 0xA0119F78 %long   0x6ACA134E
data.set 0xA0119F7C %long   0xE93FE71C
data.set 0xA0119F80 %long   0x866000A4
data.set 0xA0119F84 %long   0xC5604ACF
data.set 0xA0119F88 %long   0x8FAA7906
data.set 0xA0119F8C %long   0x4B14B475
data.set 0xA0119F90 %long   0xE85328AB
data.set 0xA0119F94 %long   0xAC03A9BA
data.set 0xA0119F98 %long   0x762D2E9C
data.set 0xA0119F9C %long   0x057A524B
data.set 0xA0119FA0 %long   0x2D2172E6
data.set 0xA0119FA4 %long   0x0DC924E9
data.set 0xA0119FA8 %long   0x711D1B7A
data.set 0xA0119FAC %long   0x66DF9EE3
data.set 0xA0119FB0 %long   0xFF658D0A
data.set 0xA0119FB4 %long   0x0CE21B7B
data.set 0xA0119FB8 %long   0xA1199B9E
data.set 0xA0119FBC %long   0x3980D7CB
data.set 0xA0119FC0 %long   0x75CD47F8
data.set 0xA0119FC4 %long   0x4FC07419
data.set 0xA0119FC8 %long   0x3D52F617
data.set 0xA0119FCC %long   0x44F43CF8
data.set 0xA0119FD0 %long   0xA36AEBCD
data.set 0xA0119FD4 %long   0x12AB0B10
data.set 0xA0119FD8 %long   0x20076C33
data.set 0xA0119FDC %long   0x58007960
data.set 0xA0119FE0 %long   0xAE3DCCFE
data.set 0xA0119FE4 %long   0xACA33ADD
data.set 0xA0119FE8 %long   0xD9792CE6
data.set 0xA0119FEC %long   0x78683217
data.set 0xA0119FF0 %long   0x81D7BB46
data.set 0xA0119FF4 %long   0xF64CEB10
data.set 0xA0119FF8 %long   0x91CB1536
data.set 0xA0119FFC %long   0xDF16E431
data.set 0xA011A000 %long   0xF621E1F8
data.set 0xA011A004 %long   0xD9BD1241
data.set 0xA011A008 %long   0xED4A3B7C
data.set 0xA011A00C %long   0xB886A345
data.set 0xA011A010 %long   0xB9F94395
data.set 0xA011A014 %long   0xDBF4980A
data.set 0xA011A018 %long   0x46FC3CBF
data.set 0xA011A01C %long   0x34ED4FBB
data.set 0xA011A020 %long   0x214C6D6E
data.set 0xA011A024 %long   0x6F964184
data.set 0xA011A028 %long   0x1102C6E1
data.set 0xA011A02C %long   0x1E10B2C6
data.set 0xA011A030 %long   0x6F9E7BE1
data.set 0xA011A034 %long   0xB30D0EAB
data.set 0xA011A038 %long   0xE54F463D
data.set 0xA011A03C %long   0xB9516494
data.set 0xA011A040 %long   0xE6CD67E0
data.set 0xA011A044 %long   0x5B1AEDAE
data.set 0xA011A048 %long   0xA4B1B6D5
data.set 0xA011A04C %long   0xBB2BF5D3
data.set 0xA011A050 %long   0xE901FEA9
data.set 0xA011A054 %long   0x8CD54D14
data.set 0xA011A058 %long   0x91A04727
data.set 0xA011A05C %long   0x7800123E
data.set 0xA011A060 %long   0x2E56784E
data.set 0xA011A064 %long   0x0ACDE1FC
data.set 0xA011A068 %long   0x36F40651
data.set 0xA011A06C %long   0x8412CED2
data.set 0xA011A070 %long   0xDE94AD75
data.set 0xA011A074 %long   0x49D18DC0
data.set 0xA011A078 %long   0x94B61F13
data.set 0xA011A07C %long   0x9A0611E1
data.set 0xA011A080 %long   0xD854A958
data.set 0xA011A084 %long   0x36F220D8
data.set 0xA011A088 %long   0xAFE97495
data.set 0xA011A08C %long   0x8A674AB5
data.set 0xA011A090 %long   0xA0DAE394
data.set 0xA011A094 %long   0x444722AA
data.set 0xA011A098 %long   0x654AEA68
data.set 0xA011A09C %long   0x1D9C9853
data.set 0xA011A0A0 %long   0xAF6C87FF
data.set 0xA011A0A4 %long   0xD936D1E5
data.set 0xA011A0A8 %long   0xC8B97490
data.set 0xA011A0AC %long   0x6E568CD1
data.set 0xA011A0B0 %long   0x90651E62
data.set 0xA011A0B4 %long   0xEB79F5D1
data.set 0xA011A0B8 %long   0x1A9A3BE8
data.set 0xA011A0BC %long   0xE084ECA2
data.set 0xA011A0C0 %long   0x82EF4223
data.set 0xA011A0C4 %long   0x8FFDA421
data.set 0xA011A0C8 %long   0x100715B6
data.set 0xA011A0CC %long   0xB085492F
data.set 0xA011A0D0 %long   0xC852CAFD
data.set 0xA011A0D4 %long   0x669951D4
data.set 0xA011A0D8 %long   0x3F623DA7
data.set 0xA011A0DC %long   0x69795519
data.set 0xA011A0E0 %long   0xA136104E
data.set 0xA011A0E4 %long   0xB41FBF0E
data.set 0xA011A0E8 %long   0xA7706BAF
data.set 0xA011A0EC %long   0x97B97D39
data.set 0xA011A0F0 %long   0xC9C8CFC6
data.set 0xA011A0F4 %long   0x2279629A
data.set 0xA011A0F8 %long   0x3B58C178
data.set 0xA011A0FC %long   0x3759A833
data.set 0xA011A100 %long   0x9241E6D4
data.set 0xA011A104 %long   0x2C5F21E9
data.set 0xA011A108 %long   0x88F4B2DD
data.set 0xA011A10C %long   0x711CCB05
data.set 0xA011A110 %long   0xD13DFA68
data.set 0xA011A114 %long   0xFA254888
data.set 0xA011A118 %long   0x3E109FA3
data.set 0xA011A11C %long   0xF7AEC4B5
data.set 0xA011A120 %long   0x43DCC1A3
data.set 0xA011A124 %long   0x832BC337
data.set 0xA011A128 %long   0x357CAEEB
data.set 0xA011A12C %long   0x98C7A807
data.set 0xA011A130 %long   0x6E82CD1E
data.set 0xA011A134 %long   0x83D0FEA3
data.set 0xA011A138 %long   0x84E7211C
data.set 0xA011A13C %long   0x8F55C6B5
data.set 0xA011A140 %long   0x5115CFD3
data.set 0xA011A144 %long   0x9C6A5D1E
data.set 0xA011A148 %long   0x3710AEA2
data.set 0xA011A14C %long   0xD7EA4491
data.set 0xA011A150 %long   0x5AAD8F54
data.set 0xA011A154 %long   0xCDAB0627
data.set 0xA011A158 %long   0xFEBD387E
data.set 0xA011A15C %long   0x63147491
data.set 0xA011A160 %long   0x2268C9C5
data.set 0xA011A164 %long   0x3D76FDFB
data.set 0xA011A168 %long   0xBE195B42
data.set 0xA011A16C %long   0x8A1A1DBF
data.set 0xA011A170 %long   0x5EC8609F
data.set 0xA011A174 %long   0x443AD5CC
data.set 0xA011A178 %long   0xCB523557
data.set 0xA011A17C %long   0x2B9AE3DF
data.set 0xA011A180 %long   0x83853D31
data.set 0xA011A184 %long   0xEDB493C3
data.set 0xA011A188 %long   0xB080DB52
data.set 0xA011A18C %long   0x9FA96E72
data.set 0xA011A190 %long   0x7C848D24
data.set 0xA011A194 %long   0xC84EA96B
data.set 0xA011A198 %long   0x6C0CF64B
data.set 0xA011A19C %long   0x6B040B29
data.set 0xA011A1A0 %long   0x010B38ED
data.set 0xA011A1A4 %long   0x30AD5A6C
data.set 0xA011A1A8 %long   0xA297BEC1
data.set 0xA011A1AC %long   0x1ED38578
data.set 0xA011A1B0 %long   0xF6EDEADA
data.set 0xA011A1B4 %long   0x8D3E2FB1
data.set 0xA011A1B8 %long   0xC0772697
data.set 0xA011A1BC %long   0x4371DF92
data.set 0xA011A1C0 %long   0xFDA829D8
data.set 0xA011A1C4 %long   0xE4B16C6D
data.set 0xA011A1C8 %long   0x427CB93E
data.set 0xA011A1CC %long   0x592BAE26
data.set 0xA011A1D0 %long   0x1B27239C
data.set 0xA011A1D4 %long   0x8B8F9A62
data.set 0xA011A1D8 %long   0x43D3CC77
data.set 0xA011A1DC %long   0xDC10346F
data.set 0xA011A1E0 %long   0xF39D5A54
data.set 0xA011A1E4 %long   0xA8DC4451
data.set 0xA011A1E8 %long   0x5A9EAA94
data.set 0xA011A1EC %long   0x29DEA060
data.set 0xA011A1F0 %long   0x33161BCE
data.set 0xA011A1F4 %long   0x11A64A09
data.set 0xA011A1F8 %long   0x97ED3359
data.set 0xA011A1FC %long   0x025FC326
data.set 0xA011A200 %long   0x6C3F82BA
data.set 0xA011A204 %long   0x1833D3A9
data.set 0xA011A208 %long   0x83AC7EF8
data.set 0xA011A20C %long   0xADAFA2FE
data.set 0xA011A210 %long   0x10209DBF
data.set 0xA011A214 %long   0x331DAE39
data.set 0xA011A218 %long   0x5A47E5C7
data.set 0xA011A21C %long   0x92992154
data.set 0xA011A220 %long   0x2AC15E3F
data.set 0xA011A224 %long   0x8FD3AB7D
data.set 0xA011A228 %long   0x471789E4
data.set 0xA011A22C %long   0xB082615B
data.set 0xA011A230 %long   0x8176E29E
data.set 0xA011A234 %long   0x8CA9322E
data.set 0xA011A238 %long   0x6AC4D2BC
data.set 0xA011A23C %long   0x54909607
data.set 0xA011A240 %long   0xFA22FF39
data.set 0xA011A244 %long   0xDC846909
data.set 0xA011A248 %long   0x99E65856
data.set 0xA011A24C %long   0x089745B0
data.set 0xA011A250 %long   0x7D7852BF
data.set 0xA011A254 %long   0xF02E566A
data.set 0xA011A258 %long   0xE22FEFF2
data.set 0xA011A25C %long   0xC52DB207
data.set 0xA011A260 %long   0x0CC87967
data.set 0xA011A264 %long   0x0AEC0088
data.set 0xA011A268 %long   0x65719C64
data.set 0xA011A26C %long   0x6204B590
data.set 0xA011A270 %long   0x1846AFDD
data.set 0xA011A274 %long   0xE61EC08C
data.set 0xA011A278 %long   0x436EA12C
data.set 0xA011A27C %long   0x7E9CA065
data.set 0xA011A280 %long   0xFD4B638E
data.set 0xA011A284 %long   0x2B665C89
data.set 0xA011A288 %long   0xAB5D8A5D
data.set 0xA011A28C %long   0xD0F86EAA
data.set 0xA011A290 %long   0x666447C7
data.set 0xA011A294 %long   0x209646A6
data.set 0xA011A298 %long   0xDED5CADE
data.set 0xA011A29C %long   0xBD7E03E8
data.set 0xA011A2A0 %long   0xCA419D5A
data.set 0xA011A2A4 %long   0xE50C4338
data.set 0xA011A2A8 %long   0x85601E46
data.set 0xA011A2AC %long   0x88785F6A
data.set 0xA011A2B0 %long   0x157A82D8
data.set 0xA011A2B4 %long   0xBEE3A4C4
data.set 0xA011A2B8 %long   0x83FA23DC
data.set 0xA011A2BC %long   0xD7EBA9D5
data.set 0xA011A2C0 %long   0xA641FCB0
data.set 0xA011A2C4 %long   0x64264C60
data.set 0xA011A2C8 %long   0xB0C7FCD3
data.set 0xA011A2CC %long   0x3BB01269
data.set 0xA011A2D0 %long   0x60CA9C84
data.set 0xA011A2D4 %long   0x0140ED65
data.set 0xA011A2D8 %long   0x781854E5
data.set 0xA011A2DC %long   0x5F04A8A7
data.set 0xA011A2E0 %long   0x299BF61A
data.set 0xA011A2E4 %long   0x2FFE7493
data.set 0xA011A2E8 %long   0xCF043C5A
data.set 0xA011A2EC %long   0x13BECF0F
data.set 0xA011A2F0 %long   0x31CEE7D3
data.set 0xA011A2F4 %long   0x3F98E400
data.set 0xA011A2F8 %long   0xFABC7953
data.set 0xA011A2FC %long   0x3B880DE3
data.set 0xA011A300 %long   0x8146290A
data.set 0xA011A304 %long   0x7F101CCD
data.set 0xA011A308 %long   0x59CEB50D
data.set 0xA011A30C %long   0x03AFAD7A
data.set 0xA011A310 %long   0x9A8380BC
data.set 0xA011A314 %long   0x198A0A02
data.set 0xA011A318 %long   0x245E8298
data.set 0xA011A31C %long   0xDDFABCE0
data.set 0xA011A320 %long   0x73A0DB35
data.set 0xA011A324 %long   0xA139014D
data.set 0xA011A328 %long   0x200ABEC1
data.set 0xA011A32C %long   0xD2D8F1FE
data.set 0xA011A330 %long   0x2A770E6D
data.set 0xA011A334 %long   0xE3F3F7D2
data.set 0xA011A338 %long   0x6178EEA5
data.set 0xA011A33C %long   0x858DBDA6
data.set 0xA011A340 %long   0x83F2D0E3
data.set 0xA011A344 %long   0x1BDB253E
data.set 0xA011A348 %long   0x5A309B29
data.set 0xA011A34C %long   0xECFBCB4A
data.set 0xA011A350 %long   0x9AD42CD4
data.set 0xA011A354 %long   0xCD39E15B
data.set 0xA011A358 %long   0x864EF97D
data.set 0xA011A35C %long   0x2C00CA2F
data.set 0xA011A360 %long   0x70AC4C12
data.set 0xA011A364 %long   0x81E052BA
data.set 0xA011A368 %long   0x61E496E5
data.set 0xA011A36C %long   0x5A2B4D63
data.set 0xA011A370 %long   0xCCCBC7BE
data.set 0xA011A374 %long   0x0BB7D93F
data.set 0xA011A378 %long   0xE882C9EC
data.set 0xA011A37C %long   0x309D1FAC
data.set 0xA011A380 %long   0x668E8AF1
data.set 0xA011A384 %long   0x26E6F14B
data.set 0xA011A388 %long   0x96FF5A4F
data.set 0xA011A38C %long   0x6098A0CD
data.set 0xA011A390 %long   0x842A7296
data.set 0xA011A394 %long   0x796767FC
data.set 0xA011A398 %long   0x37527252
data.set 0xA011A39C %long   0x07C18EF4
data.set 0xA011A3A0 %long   0x9F401F53
data.set 0xA011A3A4 %long   0xC4AFBF36
data.set 0xA011A3A8 %long   0xAB342E71
data.set 0xA011A3AC %long   0x4C3449E6
data.set 0xA011A3B0 %long   0xDD7E6222
data.set 0xA011A3B4 %long   0xDB282EBB
data.set 0xA011A3B8 %long   0xC05C5E0E
data.set 0xA011A3BC %long   0x9A2DC2A6
data.set 0xA011A3C0 %long   0x41AA897A
data.set 0xA011A3C4 %long   0x5A8515D2
data.set 0xA011A3C8 %long   0x84B5B9EB
data.set 0xA011A3CC %long   0x7D051A61
data.set 0xA011A3D0 %long   0x8EBABF34
data.set 0xA011A3D4 %long   0xE90A3A65
data.set 0xA011A3D8 %long   0x1F0F5D31
data.set 0xA011A3DC %long   0x9B5E29C4
data.set 0xA011A3E0 %long   0x37A59CDD
data.set 0xA011A3E4 %long   0xE08837CC
data.set 0xA011A3E8 %long   0x5BBD6A38
data.set 0xA011A3EC %long   0xA34E7889
data.set 0xA011A3F0 %long   0xF416C199
data.set 0xA011A3F4 %long   0xFF341E39
data.set 0xA011A3F8 %long   0x456CB29E
data.set 0xA011A3FC %long   0xD54E814D
data.set 0xA011A400 %long   0x2BADC5DB
data.set 0xA011A404 %long   0xAE55FF0A
data.set 0xA011A408 %long   0xE264303C
data.set 0xA011A40C %long   0x7B96BD7F
data.set 0xA011A410 %long   0x6D612721
data.set 0xA011A414 %long   0xDD054B5D
data.set 0xA011A418 %long   0xACBD4CD5
data.set 0xA011A41C %long   0xD6DA0689
data.set 0xA011A420 %long   0x4B539013
data.set 0xA011A424 %long   0xACA0A7C1
data.set 0xA011A428 %long   0x5558A9DA
data.set 0xA011A42C %long   0x2AB66C67
data.set 0xA011A430 %long   0xA17ACD08
data.set 0xA011A434 %long   0xE2FBF088
data.set 0xA011A438 %long   0xF75905BC
data.set 0xA011A43C %long   0x94125471
data.set 0xA011A440 %long   0x2FD9A3CE
data.set 0xA011A444 %long   0xD3A1AAFA
data.set 0xA011A448 %long   0x9250BC2A
data.set 0xA011A44C %long   0xAA83F629
data.set 0xA011A450 %long   0xE1CA0A21
data.set 0xA011A454 %long   0x2EE8EFAE
data.set 0xA011A458 %long   0x985901C1
data.set 0xA011A45C %long   0x93FC2A4D
data.set 0xA011A460 %long   0x001AA600
data.set 0xA011A464 %long   0xC9F8BAEA
data.set 0xA011A468 %long   0x1E0E579F
data.set 0xA011A46C %long   0x795545E8
data.set 0xA011A470 %long   0x858AF575
data.set 0xA011A474 %long   0xFC46C74E
data.set 0xA011A478 %long   0x7821F2B5
data.set 0xA011A47C %long   0xFA311F52
data.set 0xA011A480 %long   0x17975169
data.set 0xA011A484 %long   0xD6ED1903
data.set 0xA011A488 %long   0x2197FA2D
data.set 0xA011A48C %long   0x34029AE0
data.set 0xA011A490 %long   0x73C85C8D
data.set 0xA011A494 %long   0xED3CDED3
data.set 0xA011A498 %long   0xC83C3F7C
data.set 0xA011A49C %long   0x328BE5A1
data.set 0xA011A4A0 %long   0x70CD3D49
data.set 0xA011A4A4 %long   0x31A8436D
data.set 0xA011A4A8 %long   0xECCDB1C6
data.set 0xA011A4AC %long   0xA03905C0
data.set 0xA011A4B0 %long   0x5D4D253B
data.set 0xA011A4B4 %long   0x20C74A4A
data.set 0xA011A4B8 %long   0x92B8B8E7
data.set 0xA011A4BC %long   0x7A0B37F8
data.set 0xA011A4C0 %long   0x1D75048F
data.set 0xA011A4C4 %long   0xB4ACEBB1
data.set 0xA011A4C8 %long   0x289FBABF
data.set 0xA011A4CC %long   0x4DE7A1FA
data.set 0xA011A4D0 %long   0x71B1BACF
data.set 0xA011A4D4 %long   0xA31FC9EB
data.set 0xA011A4D8 %long   0xA652D714
data.set 0xA011A4DC %long   0xB7D91BDF
data.set 0xA011A4E0 %long   0xBE2860B9
data.set 0xA011A4E4 %long   0xCC4FFC90
data.set 0xA011A4E8 %long   0xE40F160C
data.set 0xA011A4EC %long   0x4F44D98C
data.set 0xA011A4F0 %long   0x84D32CBC
data.set 0xA011A4F4 %long   0x3D8D7F48
data.set 0xA011A4F8 %long   0xD2CB4AA1
data.set 0xA011A4FC %long   0xCB4B0A61
data.set 0xA011A500 %long   0xE1DA81BC
data.set 0xA011A504 %long   0x207D271E
data.set 0xA011A508 %long   0x0114F2B3
data.set 0xA011A50C %long   0x57F53686
data.set 0xA011A510 %long   0x99722BD9
data.set 0xA011A514 %long   0x61D3D21A
data.set 0xA011A518 %long   0xC01B870B
data.set 0xA011A51C %long   0x2DAC0CF9
data.set 0xA011A520 %long   0x77806236
data.set 0xA011A524 %long   0xD8457A2A
data.set 0xA011A528 %long   0xB65FC983
data.set 0xA011A52C %long   0x89698265
data.set 0xA011A530 %long   0x84DAA342
data.set 0xA011A534 %long   0x20F3F955
data.set 0xA011A538 %long   0x22AE9306
data.set 0xA011A53C %long   0xD27B6D27
data.set 0xA011A540 %long   0x69682393
data.set 0xA011A544 %long   0x66467F7D
data.set 0xA011A548 %long   0x26AD235A
data.set 0xA011A54C %long   0xC4D84390
data.set 0xA011A550 %long   0xA42E706D
data.set 0xA011A554 %long   0x109069D0
data.set 0xA011A558 %long   0xEA93FAC4
data.set 0xA011A55C %long   0x8DE2D5D1
data.set 0xA011A560 %long   0x5DE5B259
data.set 0xA011A564 %long   0xB1A6ABBF
data.set 0xA011A568 %long   0x3C2A907B
data.set 0xA011A56C %long   0x8CE48E72
data.set 0xA011A570 %long   0x19F949A9
data.set 0xA011A574 %long   0x298169D4
data.set 0xA011A578 %long   0x74BE724B
data.set 0xA011A57C %long   0x4CD44CEE
data.set 0xA011A580 %long   0xCAAF5DDA
data.set 0xA011A584 %long   0x4DE35527
data.set 0xA011A588 %long   0x5689E6FD
data.set 0xA011A58C %long   0x0D5FA7B8
data.set 0xA011A590 %long   0x66326B9A
data.set 0xA011A594 %long   0xC9EA75C7
data.set 0xA011A598 %long   0x0699113E
data.set 0xA011A59C %long   0xC1AE9915
data.set 0xA011A5A0 %long   0x0154B121
data.set 0xA011A5A4 %long   0xC35AAE1B
data.set 0xA011A5A8 %long   0xFD255637
data.set 0xA011A5AC %long   0x6685D0FF
data.set 0xA011A5B0 %long   0xAE3C069E
data.set 0xA011A5B4 %long   0x4385DEFB
data.set 0xA011A5B8 %long   0x2405777D
data.set 0xA011A5BC %long   0xEF4F7206
data.set 0xA011A5C0 %long   0xC7B607BD
data.set 0xA011A5C4 %long   0xF37B42E0
data.set 0xA011A5C8 %long   0xDBFB366F
data.set 0xA011A5CC %long   0x3E90A643
data.set 0xA011A5D0 %long   0x839E3339
data.set 0xA011A5D4 %long   0x8B9974A2
data.set 0xA011A5D8 %long   0x496E95B7
data.set 0xA011A5DC %long   0xDA4D6265
data.set 0xA011A5E0 %long   0x6795B564
data.set 0xA011A5E4 %long   0x771750BF
data.set 0xA011A5E8 %long   0x07D633B2
data.set 0xA011A5EC %long   0xC8ECD173
data.set 0xA011A5F0 %long   0xAAB5C2D2
data.set 0xA011A5F4 %long   0x50AF691E
data.set 0xA011A5F8 %long   0xADB02C7F
data.set 0xA011A5FC %long   0x0275C9CC
data.set 0xA011A600 %long   0xA45D46D8
data.set 0xA011A604 %long   0x761EA0EB
data.set 0xA011A608 %long   0x803B8B38
data.set 0xA011A60C %long   0xFFD8DF55
data.set 0xA011A610 %long   0xF5C1FB6A
data.set 0xA011A614 %long   0x5A938784
data.set 0xA011A618 %long   0xCED9DB8C
data.set 0xA011A61C %long   0xE8939648
data.set 0xA011A620 %long   0xBE944FE8
data.set 0xA011A624 %long   0x1FD2CFEB
data.set 0xA011A628 %long   0x9D97C55E
data.set 0xA011A62C %long   0x3DB560DF
data.set 0xA011A630 %long   0x12496A88
data.set 0xA011A634 %long   0x31A68365
data.set 0xA011A638 %long   0x8FAC0ACD
data.set 0xA011A63C %long   0xF78E0A30
data.set 0xA011A640 %long   0x18490E8C
data.set 0xA011A644 %long   0xC2B4FC16
data.set 0xA011A648 %long   0x4F764A38
data.set 0xA011A64C %long   0xDF2C1471
data.set 0xA011A650 %long   0x35A14A4B
data.set 0xA011A654 %long   0x2C11CC1E
data.set 0xA011A658 %long   0x560A59C2
data.set 0xA011A65C %long   0xE5B8ABBE
data.set 0xA011A660 %long   0xAFD69A56
data.set 0xA011A664 %long   0x45B63CD3
data.set 0xA011A668 %long   0xE4660AC5
data.set 0xA011A66C %long   0x88DEBF28
data.set 0xA011A670 %long   0xD56902A0
data.set 0xA011A674 %long   0x33628D54
data.set 0xA011A678 %long   0xF6AC9F49
data.set 0xA011A67C %long   0xEC23648A
data.set 0xA011A680 %long   0x815221FA
data.set 0xA011A684 %long   0x3A9C3D8D
data.set 0xA011A688 %long   0x73E52100
data.set 0xA011A68C %long   0x7D5DB945
data.set 0xA011A690 %long   0xA5D55269
data.set 0xA011A694 %long   0x585E8525
data.set 0xA011A698 %long   0x261FAB3C
data.set 0xA011A69C %long   0xF11E8731
data.set 0xA011A6A0 %long   0xAE70558A
data.set 0xA011A6A4 %long   0x5627FC74
data.set 0xA011A6A8 %long   0xBA4E2DE9
data.set 0xA011A6AC %long   0x44594E8B
data.set 0xA011A6B0 %long   0x8D61D82E
data.set 0xA011A6B4 %long   0xCAF2B63C
data.set 0xA011A6B8 %long   0x54C9AD95
data.set 0xA011A6BC %long   0x913148F7
data.set 0xA011A6C0 %long   0xF596D2E5
data.set 0xA011A6C4 %long   0xE2372135
data.set 0xA011A6C8 %long   0xD6DC6BD6
data.set 0xA011A6CC %long   0x46865490
data.set 0xA011A6D0 %long   0xA137D25F
data.set 0xA011A6D4 %long   0x36C80869
data.set 0xA011A6D8 %long   0xA30F9E70
data.set 0xA011A6DC %long   0x0971CAAA
data.set 0xA011A6E0 %long   0xA23E1487
data.set 0xA011A6E4 %long   0x8FB57294
data.set 0xA011A6E8 %long   0x5F1CED7C
data.set 0xA011A6EC %long   0x86ED2156
data.set 0xA011A6F0 %long   0xC06486FA
data.set 0xA011A6F4 %long   0x6859EF9A
data.set 0xA011A6F8 %long   0x8F2BC993
data.set 0xA011A6FC %long   0xA7F7E6C2
data.set 0xA011A700 %long   0xF5C18569
data.set 0xA011A704 %long   0xF7A08CA1
data.set 0xA011A708 %long   0xD6AC9B88
data.set 0xA011A70C %long   0x481062F3
data.set 0xA011A710 %long   0xE6192AEA
data.set 0xA011A714 %long   0x1E1617A1
data.set 0xA011A718 %long   0xE050BFE2
data.set 0xA011A71C %long   0x131F1253
data.set 0xA011A720 %long   0x57B783A1
data.set 0xA011A724 %long   0xED89CDEC
data.set 0xA011A728 %long   0x3EBD896F
data.set 0xA011A72C %long   0xEB9473DB
data.set 0xA011A730 %long   0xF7188C66
data.set 0xA011A734 %long   0x15377DA6
data.set 0xA011A738 %long   0xE288690A
data.set 0xA011A73C %long   0x09AD83FA
data.set 0xA011A740 %long   0xAB07C6C9
data.set 0xA011A744 %long   0x5CEAEB38
data.set 0xA011A748 %long   0x93F2775E
data.set 0xA011A74C %long   0x94171F88
data.set 0xA011A750 %long   0xFD7EE75E
data.set 0xA011A754 %long   0x3397ABDF
data.set 0xA011A758 %long   0xF6867312
data.set 0xA011A75C %long   0x896549B2
data.set 0xA011A760 %long   0x52E72385
data.set 0xA011A764 %long   0x9ECF6BA3
data.set 0xA011A768 %long   0xE852310F
data.set 0xA011A76C %long   0x88C73DA1
data.set 0xA011A770 %long   0x717BF35E
data.set 0xA011A774 %long   0xD47BDFAE
data.set 0xA011A778 %long   0x5F6114F2
data.set 0xA011A77C %long   0x0AD24323
data.set 0xA011A780 %long   0x37127F0E
data.set 0xA011A784 %long   0xF10B3196
data.set 0xA011A788 %long   0x4A5E716E
data.set 0xA011A78C %long   0xEFAB0332
data.set 0xA011A790 %long   0x5F7D096C
data.set 0xA011A794 %long   0xF3035DB0
data.set 0xA011A798 %long   0x08B5C194
data.set 0xA011A79C %long   0x99A3D814
data.set 0xA011A7A0 %long   0xFE9EE7BC
data.set 0xA011A7A4 %long   0x12D90CB5
data.set 0xA011A7A8 %long   0x703FE211
data.set 0xA011A7AC %long   0x1A35F0B5
data.set 0xA011A7B0 %long   0x838E974A
data.set 0xA011A7B4 %long   0x3417F250
data.set 0xA011A7B8 %long   0xDD8341C0
data.set 0xA011A7BC %long   0xE97B0842
data.set 0xA011A7C0 %long   0x6709DC93
data.set 0xA011A7C4 %long   0xC87D6467
data.set 0xA011A7C8 %long   0x8C062516
data.set 0xA011A7CC %long   0x0373DBA2
data.set 0xA011A7D0 %long   0x0CF33D08
data.set 0xA011A7D4 %long   0xC706B00E
data.set 0xA011A7D8 %long   0x311AA1DC
data.set 0xA011A7DC %long   0x7F6CD2BC
data.set 0xA011A7E0 %long   0x4AE19C48
data.set 0xA011A7E4 %long   0x2C60EE32
data.set 0xA011A7E8 %long   0x8E6718DD
data.set 0xA011A7EC %long   0x3D54A68D
data.set 0xA011A7F0 %long   0x27250402
data.set 0xA011A7F4 %long   0x4110AE7F
data.set 0xA011A7F8 %long   0x8DD51803
data.set 0xA011A7FC %long   0x8D9B76F5
data.set 0xA011A800 %long   0xF5EC6847
data.set 0xA011A804 %long   0xEFE785CB
data.set 0xA011A808 %long   0xAB16201B
data.set 0xA011A80C %long   0xD3A4B29E
data.set 0xA011A810 %long   0x77541F33
data.set 0xA011A814 %long   0x4CF1A007
data.set 0xA011A818 %long   0x13DF9F84
data.set 0xA011A81C %long   0xF4CBA90B
data.set 0xA011A820 %long   0xDB18E1D5
data.set 0xA011A824 %long   0x95F666C2
data.set 0xA011A828 %long   0xB70AC687
data.set 0xA011A82C %long   0x92E5769F
data.set 0xA011A830 %long   0xB2918D80
data.set 0xA011A834 %long   0x68FD4F05
data.set 0xA011A838 %long   0xDB7384C9
data.set 0xA011A83C %long   0xA2598D60
data.set 0xA011A840 %long   0x564BA475
data.set 0xA011A844 %long   0x551F131D
data.set 0xA011A848 %long   0x27716DEC
data.set 0xA011A84C %long   0x6E956FFD
data.set 0xA011A850 %long   0xC92A4C6C
data.set 0xA011A854 %long   0x4D11D474
data.set 0xA011A858 %long   0xDD1C29A9
data.set 0xA011A85C %long   0xE83A0CEF
data.set 0xA011A860 %long   0x9B4AB577
data.set 0xA011A864 %long   0xAD4F33ED
data.set 0xA011A868 %long   0x8CCD7E84
data.set 0xA011A86C %long   0x8DA5BE8C
data.set 0xA011A870 %long   0x4024B201
data.set 0xA011A874 %long   0x9DF0D05C
data.set 0xA011A878 %long   0x918F2404
data.set 0xA011A87C %long   0xDAADD767
data.set 0xA011A880 %long   0xF13B11DE
data.set 0xA011A884 %long   0x82C695EC
data.set 0xA011A888 %long   0x86F63C7F
data.set 0xA011A88C %long   0xD174F720
data.set 0xA011A890 %long   0x18E7CB5B
data.set 0xA011A894 %long   0x11CF6AED
data.set 0xA011A898 %long   0x918EC72C
data.set 0xA011A89C %long   0x8EEFE8FF
data.set 0xA011A8A0 %long   0x0575A703
data.set 0xA011A8A4 %long   0x9231BE37
data.set 0xA011A8A8 %long   0xB58C8ED8
data.set 0xA011A8AC %long   0x96968C0F
data.set 0xA011A8B0 %long   0x42196D5F
data.set 0xA011A8B4 %long   0xACBA20A3
data.set 0xA011A8B8 %long   0xD4A71F92
data.set 0xA011A8BC %long   0xDA7B8823
data.set 0xA011A8C0 %long   0x58675583
data.set 0xA011A8C4 %long   0x12DF42B2
data.set 0xA011A8C8 %long   0x46CE5CD6
data.set 0xA011A8CC %long   0x7AA64165
data.set 0xA011A8D0 %long   0xBEA080C6
data.set 0xA011A8D4 %long   0xE711F99F
data.set 0xA011A8D8 %long   0xB0B283C2
data.set 0xA011A8DC %long   0xB0859137
data.set 0xA011A8E0 %long   0x03B3064D
data.set 0xA011A8E4 %long   0x309E2F1E
data.set 0xA011A8E8 %long   0x4CB74019
data.set 0xA011A8EC %long   0xE1D1654A
data.set 0xA011A8F0 %long   0xDBB43072
data.set 0xA011A8F4 %long   0x98A1458B
data.set 0xA011A8F8 %long   0x35093A6D
data.set 0xA011A8FC %long   0xB9151122
data.set 0xA011A900 %long   0x20DC0BB5
data.set 0xA011A904 %long   0xB3D5C7D9
data.set 0xA011A908 %long   0x8DE60327
data.set 0xA011A90C %long   0x8D72AB97
data.set 0xA011A910 %long   0x087C243D
data.set 0xA011A914 %long   0x3BBC08A3
data.set 0xA011A918 %long   0x9C9EFCEC
data.set 0xA011A91C %long   0x642C527E
data.set 0xA011A920 %long   0x3643BE0C
data.set 0xA011A924 %long   0x05DA5DE1
data.set 0xA011A928 %long   0xDC2E8E7F
data.set 0xA011A92C %long   0xECDBF15F
data.set 0xA011A930 %long   0x5D51AA9A
data.set 0xA011A934 %long   0xB8B6B33A
data.set 0xA011A938 %long   0x35F2A947
data.set 0xA011A93C %long   0x06E148BA
data.set 0xA011A940 %long   0x99F3B534
data.set 0xA011A944 %long   0x5584A803
data.set 0xA011A948 %long   0x86B3BC13
data.set 0xA011A94C %long   0x2AF185CF
data.set 0xA011A950 %long   0xDD5FDDE6
data.set 0xA011A954 %long   0x14B6B8D9
data.set 0xA011A958 %long   0x74CF0689
data.set 0xA011A95C %long   0x7E10FCB3
data.set 0xA011A960 %long   0x11543910
data.set 0xA011A964 %long   0x175A99A4
data.set 0xA011A968 %long   0x264B8371
data.set 0xA011A96C %long   0xDD545885
data.set 0xA011A970 %long   0x76E4F6C5
data.set 0xA011A974 %long   0xAF7C07E1
data.set 0xA011A978 %long   0xD7FB98FD
data.set 0xA011A97C %long   0x5AFA44AA
data.set 0xA011A980 %long   0x047CD301
data.set 0xA011A984 %long   0xE804378B
data.set 0xA011A988 %long   0xB364FEBC
data.set 0xA011A98C %long   0x8E9799C8
data.set 0xA011A990 %long   0xB4FA4DF3
data.set 0xA011A994 %long   0xA4AC22C8
data.set 0xA011A998 %long   0x5F3E6F6D
data.set 0xA011A99C %long   0x1156A808
data.set 0xA011A9A0 %long   0x804F19BF
data.set 0xA011A9A4 %long   0x592BA5FB
data.set 0xA011A9A8 %long   0x523E8ED0
data.set 0xA011A9AC %long   0xB99AFA64
data.set 0xA011A9B0 %long   0x433F4CBC
data.set 0xA011A9B4 %long   0xE738ACAC
data.set 0xA011A9B8 %long   0x0E7E3A77
data.set 0xA011A9BC %long   0x42356A9F
data.set 0xA011A9C0 %long   0x284EE956
data.set 0xA011A9C4 %long   0x1E0F919E
data.set 0xA011A9C8 %long   0x169A8A66
data.set 0xA011A9CC %long   0x7D7D865E
data.set 0xA011A9D0 %long   0x3B8A36A0
data.set 0xA011A9D4 %long   0xECEF15E6
data.set 0xA011A9D8 %long   0x6BB24C62
data.set 0xA011A9DC %long   0x7854705D
data.set 0xA011A9E0 %long   0x8E2E3177
data.set 0xA011A9E4 %long   0xDB28FD68
data.set 0xA011A9E8 %long   0xFECFAC87
data.set 0xA011A9EC %long   0x99B7E0FF
data.set 0xA011A9F0 %long   0xD9A02DED
data.set 0xA011A9F4 %long   0xE2A99D69
data.set 0xA011A9F8 %long   0xF9AC4A0E
data.set 0xA011A9FC %long   0x9B5AE09C
data.set 0xA011AA00 %long   0x08EBCCD9
data.set 0xA011AA04 %long   0xA0309A24
data.set 0xA011AA08 %long   0xD9363F98
data.set 0xA011AA0C %long   0xC41B4E2A
data.set 0xA011AA10 %long   0xD3F1EFC4
data.set 0xA011AA14 %long   0xF8C6A1AB
data.set 0xA011AA18 %long   0xF49EDFE8
data.set 0xA011AA1C %long   0x72C2B949
data.set 0xA011AA20 %long   0x93879852
data.set 0xA011AA24 %long   0x41E512CD
data.set 0xA011AA28 %long   0x7179A20B
data.set 0xA011AA2C %long   0xFDFB79F0
data.set 0xA011AA30 %long   0x2278619C
data.set 0xA011AA34 %long   0xDAF63CD6
data.set 0xA011AA38 %long   0x82319A69
data.set 0xA011AA3C %long   0x1EC13AF7
data.set 0xA011AA40 %long   0x8E41A70E
data.set 0xA011AA44 %long   0xF243E85E
data.set 0xA011AA48 %long   0x5D926DCC
data.set 0xA011AA4C %long   0xFF293A31
data.set 0xA011AA50 %long   0x94F01310
data.set 0xA011AA54 %long   0xD0A6C6EE
data.set 0xA011AA58 %long   0x525503E9
data.set 0xA011AA5C %long   0xBEF346B7
data.set 0xA011AA60 %long   0x31102BE7
data.set 0xA011AA64 %long   0x09C64B21
data.set 0xA011AA68 %long   0x92ABA64A
data.set 0xA011AA6C %long   0xBDA50C15
data.set 0xA011AA70 %long   0xECCF72E1
data.set 0xA011AA74 %long   0xF074E6BF
data.set 0xA011AA78 %long   0x359289EA
data.set 0xA011AA7C %long   0x250B374D
data.set 0xA011AA80 %long   0xF27DCC37
data.set 0xA011AA84 %long   0xF149EFAE
data.set 0xA011AA88 %long   0x5388759B
data.set 0xA011AA8C %long   0x421CCE21
data.set 0xA011AA90 %long   0x103C854C
data.set 0xA011AA94 %long   0x6CBFAC0E
data.set 0xA011AA98 %long   0xB1A73208
data.set 0xA011AA9C %long   0xA241652C
data.set 0xA011AAA0 %long   0xB771759C
data.set 0xA011AAA4 %long   0xE6731562
data.set 0xA011AAA8 %long   0x1170CD54
data.set 0xA011AAAC %long   0x89148B69
data.set 0xA011AAB0 %long   0x4708E1C8
data.set 0xA011AAB4 %long   0x0E4B80F1
data.set 0xA011AAB8 %long   0x97C9EC60
data.set 0xA011AABC %long   0xD62CD81C
data.set 0xA011AAC0 %long   0xB9913747
data.set 0xA011AAC4 %long   0xE31326C6
data.set 0xA011AAC8 %long   0x637BCE30
data.set 0xA011AACC %long   0x43EA1523
data.set 0xA011AAD0 %long   0x54275F43
data.set 0xA011AAD4 %long   0xA5D6BFD2
data.set 0xA011AAD8 %long   0xF584A599
data.set 0xA011AADC %long   0x38F0E668
data.set 0xA011AAE0 %long   0x4AAF53F0
data.set 0xA011AAE4 %long   0x874680DA
data.set 0xA011AAE8 %long   0x8154CD00
data.set 0xA011AAEC %long   0xBA342875
data.set 0xA011AAF0 %long   0x1A5BD10F
data.set 0xA011AAF4 %long   0xA84DE9AD
data.set 0xA011AAF8 %long   0xC7ED73CA
data.set 0xA011AAFC %long   0x34310A15
data.set 0xA011AB00 %long   0x4685FF12
data.set 0xA011AB04 %long   0x9BD5EA5B
data.set 0xA011AB08 %long   0x49DDD416
data.set 0xA011AB0C %long   0x9AB44B5C
data.set 0xA011AB10 %long   0x52885A1A
data.set 0xA011AB14 %long   0x59B73A72
data.set 0xA011AB18 %long   0x3B43E58F
data.set 0xA011AB1C %long   0x444E1AB6
data.set 0xA011AB20 %long   0x4604B2CF
data.set 0xA011AB24 %long   0x7D8AE413
data.set 0xA011AB28 %long   0xEEEA801E
data.set 0xA011AB2C %long   0x271B1E55
data.set 0xA011AB30 %long   0x20A835AC
data.set 0xA011AB34 %long   0xA0FCD715
data.set 0xA011AB38 %long   0x6E8439E0
data.set 0xA011AB3C %long   0x1355D8CA
data.set 0xA011AB40 %long   0xC2FF005F
data.set 0xA011AB44 %long   0x47918669
data.set 0xA011AB48 %long   0x418305D0
data.set 0xA011AB4C %long   0xE52E55E1
data.set 0xA011AB50 %long   0xF958A3BE
data.set 0xA011AB54 %long   0x757266C1
data.set 0xA011AB58 %long   0xBC1914E8
data.set 0xA011AB5C %long   0x96B5D4CA
data.set 0xA011AB60 %long   0x873EBEF6
data.set 0xA011AB64 %long   0x94B92B7D
data.set 0xA011AB68 %long   0x6FABDFAB
data.set 0xA011AB6C %long   0x2380A01A
data.set 0xA011AB70 %long   0xB7F3BCD0
data.set 0xA011AB74 %long   0x2A332390
data.set 0xA011AB78 %long   0x6936DC66
data.set 0xA011AB7C %long   0x4E679BF0
data.set 0xA011AB80 %long   0x4EDEB38D
data.set 0xA011AB84 %long   0xD544DB2C
data.set 0xA011AB88 %long   0x9FDC40DD
data.set 0xA011AB8C %long   0x60B3E676
data.set 0xA011AB90 %long   0xA49B0905
data.set 0xA011AB94 %long   0xB6D0EA50
data.set 0xA011AB98 %long   0xD350FA10
data.set 0xA011AB9C %long   0x42878B09
data.set 0xA011ABA0 %long   0x64CB3196
data.set 0xA011ABA4 %long   0x4DDD2045
data.set 0xA011ABA8 %long   0x89855738
data.set 0xA011ABAC %long   0x5A64A4E1
data.set 0xA011ABB0 %long   0xA806BDE1
data.set 0xA011ABB4 %long   0x0A60A8BA
data.set 0xA011ABB8 %long   0xFF5522B8
data.set 0xA011ABBC %long   0xA350FE9E
data.set 0xA011ABC0 %long   0xAE855929
data.set 0xA011ABC4 %long   0x41D9E2FE
data.set 0xA011ABC8 %long   0xEA6AB1FA
data.set 0xA011ABCC %long   0x6BCD1F9C
data.set 0xA011ABD0 %long   0xDF75AABD
data.set 0xA011ABD4 %long   0x7E90A9B6
data.set 0xA011ABD8 %long   0xD37144AA
data.set 0xA011ABDC %long   0xEFA8E0CE
data.set 0xA011ABE0 %long   0xEBF55625
data.set 0xA011ABE4 %long   0xA3FC8A25
data.set 0xA011ABE8 %long   0x4A6132FA
data.set 0xA011ABEC %long   0x0B8B1591
data.set 0xA011ABF0 %long   0xCC16882D
data.set 0xA011ABF4 %long   0x97422574
data.set 0xA011ABF8 %long   0x6C45B998
data.set 0xA011ABFC %long   0xCE2F8AA3
data.set 0xA011AC00 %long   0x77DC6BD9
data.set 0xA011AC04 %long   0x7FAD9BCD
data.set 0xA011AC08 %long   0x01FC7443
data.set 0xA011AC0C %long   0x01D618E3
data.set 0xA011AC10 %long   0xE5B7171C
data.set 0xA011AC14 %long   0x9079E548
data.set 0xA011AC18 %long   0x907CB1FC
data.set 0xA011AC1C %long   0xAF91403A
data.set 0xA011AC20 %long   0x7C93008B
data.set 0xA011AC24 %long   0x20D9296E
data.set 0xA011AC28 %long   0x5762371E
data.set 0xA011AC2C %long   0xDC507F49
data.set 0xA011AC30 %long   0xFD76C427
data.set 0xA011AC34 %long   0xB8B27478
data.set 0xA011AC38 %long   0x266AA395
data.set 0xA011AC3C %long   0x1E027929
data.set 0xA011AC40 %long   0x9E1B08E7
data.set 0xA011AC44 %long   0xF62C3E3F
data.set 0xA011AC48 %long   0xE2852947
data.set 0xA011AC4C %long   0xF77C00D4
data.set 0xA011AC50 %long   0x9AA5EEEB
data.set 0xA011AC54 %long   0x276E7A97
data.set 0xA011AC58 %long   0x900909AA
data.set 0xA011AC5C %long   0x9EE49DC1
data.set 0xA011AC60 %long   0x8EE24115
data.set 0xA011AC64 %long   0xF5FB9AB8
data.set 0xA011AC68 %long   0xA82311F6
data.set 0xA011AC6C %long   0x40C56A89
data.set 0xA011AC70 %long   0x77CF0111
data.set 0xA011AC74 %long   0x73565308
data.set 0xA011AC78 %long   0x19EE49FE
data.set 0xA011AC7C %long   0x3222929C
data.set 0xA011AC80 %long   0x465D5CD3
data.set 0xA011AC84 %long   0xBDA4B179
data.set 0xA011AC88 %long   0x6AE09527
data.set 0xA011AC8C %long   0xED63816B
data.set 0xA011AC90 %long   0x5792FDBF
data.set 0xA011AC94 %long   0x401B9884
data.set 0xA011AC98 %long   0xAB5F0EC5
data.set 0xA011AC9C %long   0x1BF17E92
data.set 0xA011ACA0 %long   0xC6F3E971
data.set 0xA011ACA4 %long   0x22E2B1E3
data.set 0xA011ACA8 %long   0x1C16F1FE
data.set 0xA011ACAC %long   0x1DE7C095
data.set 0xA011ACB0 %long   0xEB963E69
data.set 0xA011ACB4 %long   0x2AD8C35D
data.set 0xA011ACB8 %long   0x45429BC0
data.set 0xA011ACBC %long   0x0D05D99E
data.set 0xA011ACC0 %long   0x513DECB6
data.set 0xA011ACC4 %long   0x8AABEFA4
data.set 0xA011ACC8 %long   0x6C5FD84D
data.set 0xA011ACCC %long   0x30563791
data.set 0xA011ACD0 %long   0x37D90455
data.set 0xA011ACD4 %long   0x05CB498F
data.set 0xA011ACD8 %long   0xD48F12FF
data.set 0xA011ACDC %long   0x51008418
data.set 0xA011ACE0 %long   0x5619609E
data.set 0xA011ACE4 %long   0x82144AF2
data.set 0xA011ACE8 %long   0x4C8F90F4
data.set 0xA011ACEC %long   0x7A9F7CD5
data.set 0xA011ACF0 %long   0x862C0F7D
data.set 0xA011ACF4 %long   0xD4A690EA
data.set 0xA011ACF8 %long   0xAF351427
data.set 0xA011ACFC %long   0x9E24B2D8
data.set 0xA011AD00 %long   0x28B69C04
data.set 0xA011AD04 %long   0x8E71EF71
data.set 0xA011AD08 %long   0x5077D23A
data.set 0xA011AD0C %long   0x94645B1B
data.set 0xA011AD10 %long   0xCD55B303
data.set 0xA011AD14 %long   0xDECD2C43
data.set 0xA011AD18 %long   0x6D03B0A5
data.set 0xA011AD1C %long   0x20D66AF4
data.set 0xA011AD20 %long   0xB1157C34
data.set 0xA011AD24 %long   0x76EFFD6F
data.set 0xA011AD28 %long   0xE2871B43
data.set 0xA011AD2C %long   0x1774DE31
data.set 0xA011AD30 %long   0x33D9B146
data.set 0xA011AD34 %long   0xAF18F4FF
data.set 0xA011AD38 %long   0x3F5FB775
data.set 0xA011AD3C %long   0xB0BF73D8
data.set 0xA011AD40 %long   0xD31AD73A
data.set 0xA011AD44 %long   0x56C1F52E
data.set 0xA011AD48 %long   0x2E88D407
data.set 0xA011AD4C %long   0xCC4626D5
data.set 0xA011AD50 %long   0x147E05F7
data.set 0xA011AD54 %long   0x495A6FE9
data.set 0xA011AD58 %long   0x7BE4E58E
data.set 0xA011AD5C %long   0xE7F0A66F
data.set 0xA011AD60 %long   0xA74BA409
data.set 0xA011AD64 %long   0x903E2072
data.set 0xA011AD68 %long   0x792A4169
data.set 0xA011AD6C %long   0x7E629DEC
data.set 0xA011AD70 %long   0xE6171460
data.set 0xA011AD74 %long   0xED97846C
data.set 0xA011AD78 %long   0x4E2E16EF
data.set 0xA011AD7C %long   0xA0E36D6B
data.set 0xA011AD80 %long   0xF9F7F3DE
data.set 0xA011AD84 %long   0x871794CE
data.set 0xA011AD88 %long   0x1DEFA127
data.set 0xA011AD8C %long   0x2E680DDD
data.set 0xA011AD90 %long   0x06A67C1A
data.set 0xA011AD94 %long   0x57553C59
data.set 0xA011AD98 %long   0x8C8C3A07
data.set 0xA011AD9C %long   0x371E7704
data.set 0xA011ADA0 %long   0x4E7A5440
data.set 0xA011ADA4 %long   0xB9D1B8C5
data.set 0xA011ADA8 %long   0x0DCC3163
data.set 0xA011ADAC %long   0x5C715A5B
data.set 0xA011ADB0 %long   0x15114E86
data.set 0xA011ADB4 %long   0xE4B6358D
data.set 0xA011ADB8 %long   0x97B29B71
data.set 0xA011ADBC %long   0x86D2E71D
data.set 0xA011ADC0 %long   0x7F0BB71F
data.set 0xA011ADC4 %long   0x657B8755
data.set 0xA011ADC8 %long   0xE8E435EC
data.set 0xA011ADCC %long   0xA9A09EE8
data.set 0xA011ADD0 %long   0xB10DB6AF
data.set 0xA011ADD4 %long   0x1D9B1F89
data.set 0xA011ADD8 %long   0x48917BD7
data.set 0xA011ADDC %long   0x1CB1CBD6
data.set 0xA011ADE0 %long   0xF8EE5BDE
data.set 0xA011ADE4 %long   0x09E9BDC4
data.set 0xA011ADE8 %long   0xE88B1610
data.set 0xA011ADEC %long   0x298C4C0A
data.set 0xA011ADF0 %long   0x8FC3BE4B
data.set 0xA011ADF4 %long   0xD283C502
data.set 0xA011ADF8 %long   0xDB1C7DFA
data.set 0xA011ADFC %long   0x02A4315C
data.set 0xA011AE00 %long   0x15449166
data.set 0xA011AE04 %long   0xDCB8B71D
data.set 0xA011AE08 %long   0xCCB29C92
data.set 0xA011AE0C %long   0x12767165
data.set 0xA011AE10 %long   0xA5C3D261
data.set 0xA011AE14 %long   0x6FC99A59
data.set 0xA011AE18 %long   0x3B55643F
data.set 0xA011AE1C %long   0xC45FDE5E
data.set 0xA011AE20 %long   0x20B1B0CB
data.set 0xA011AE24 %long   0xB835845B
data.set 0xA011AE28 %long   0x94C6CA48
data.set 0xA011AE2C %long   0x2EBBA8E8
data.set 0xA011AE30 %long   0x2464A02A
data.set 0xA011AE34 %long   0xC5B025CF
data.set 0xA011AE38 %long   0x77E7A0BE
data.set 0xA011AE3C %long   0x077AC398
data.set 0xA011AE40 %long   0x0392235A
data.set 0xA011AE44 %long   0x48F8C743
data.set 0xA011AE48 %long   0xDAC0B6CA
data.set 0xA011AE4C %long   0x1F54C270
data.set 0xA011AE50 %long   0xDD8A7B21
data.set 0xA011AE54 %long   0xB224E9E8
data.set 0xA011AE58 %long   0x330E92DA
data.set 0xA011AE5C %long   0x8184CA3F
data.set 0xA011AE60 %long   0x5C60682F
data.set 0xA011AE64 %long   0x6A313A4A
data.set 0xA011AE68 %long   0xAA43BC33
data.set 0xA011AE6C %long   0xE35C581E
data.set 0xA011AE70 %long   0xD66EA1A6
data.set 0xA011AE74 %long   0x9F0CA9CE
data.set 0xA011AE78 %long   0x9FAD68C6
data.set 0xA011AE7C %long   0xFEE1EC1C
data.set 0xA011AE80 %long   0x28493306
data.set 0xA011AE84 %long   0x0421D4A7
data.set 0xA011AE88 %long   0x29EA461E
data.set 0xA011AE8C %long   0xA1E742A7
data.set 0xA011AE90 %long   0x4EACE4F8
data.set 0xA011AE94 %long   0x05392835
data.set 0xA011AE98 %long   0x4728B6B7
data.set 0xA011AE9C %long   0xF071EF7E
data.set 0xA011AEA0 %long   0xCFF3AD05
data.set 0xA011AEA4 %long   0xB5FAFBD5
data.set 0xA011AEA8 %long   0x52F05886
data.set 0xA011AEAC %long   0xAEEB396A
data.set 0xA011AEB0 %long   0x4997DA81
data.set 0xA011AEB4 %long   0xD947CEB2
data.set 0xA011AEB8 %long   0xFD565820
data.set 0xA011AEBC %long   0x1CACD8DC
data.set 0xA011AEC0 %long   0x63229687
data.set 0xA011AEC4 %long   0xD80A207D
data.set 0xA011AEC8 %long   0x01CA600A
data.set 0xA011AECC %long   0xA20900A7
data.set 0xA011AED0 %long   0xE686234F
data.set 0xA011AED4 %long   0x4B3C8E93
data.set 0xA011AED8 %long   0x4018A234
data.set 0xA011AEDC %long   0x71F600C8
data.set 0xA011AEE0 %long   0xEA3572A3
data.set 0xA011AEE4 %long   0xCF275183
data.set 0xA011AEE8 %long   0x054A4698
data.set 0xA011AEEC %long   0x92ACFCF3
data.set 0xA011AEF0 %long   0xB76BABCC
data.set 0xA011AEF4 %long   0x7F27DBAE
data.set 0xA011AEF8 %long   0x6DE84F1E
data.set 0xA011AEFC %long   0x095EBC90
data.set 0xA011AF00 %long   0x9486A404
data.set 0xA011AF04 %long   0x5625F515
data.set 0xA011AF08 %long   0xDD680AF6
data.set 0xA011AF0C %long   0xA35AE161
data.set 0xA011AF10 %long   0x6DC113AD
data.set 0xA011AF14 %long   0xBAAE1248
data.set 0xA011AF18 %long   0xD98F434B
data.set 0xA011AF1C %long   0x8A85F97B
data.set 0xA011AF20 %long   0x080A9FD4
data.set 0xA011AF24 %long   0x6C1779FB
data.set 0xA011AF28 %long   0x98EDEE1B
data.set 0xA011AF2C %long   0xAAF5F625
data.set 0xA011AF30 %long   0x3B07F1E6
data.set 0xA011AF34 %long   0xF1A08973
data.set 0xA011AF38 %long   0x4C6A2AA0
data.set 0xA011AF3C %long   0x75BBF136
data.set 0xA011AF40 %long   0xB4C07511
data.set 0xA011AF44 %long   0xC14BC91B
data.set 0xA011AF48 %long   0x4B7BA36C
data.set 0xA011AF4C %long   0x70447773
data.set 0xA011AF50 %long   0x223E439E
data.set 0xA011AF54 %long   0xE961B077
data.set 0xA011AF58 %long   0x40960FBB
data.set 0xA011AF5C %long   0xEDADABB3
data.set 0xA011AF60 %long   0xEBF1E83C
data.set 0xA011AF64 %long   0x9D3B1186
data.set 0xA011AF68 %long   0x4425BA2C
data.set 0xA011AF6C %long   0xB1A4E750
data.set 0xA011AF70 %long   0x19215480
data.set 0xA011AF74 %long   0x0C7D724E
data.set 0xA011AF78 %long   0x1A4EBEAF
data.set 0xA011AF7C %long   0x0AA69519
data.set 0xA011AF80 %long   0xC8D8C404
data.set 0xA011AF84 %long   0x9F8CBFAD
data.set 0xA011AF88 %long   0x06754FBF
data.set 0xA011AF8C %long   0x4D99CF99
data.set 0xA011AF90 %long   0xE7526EA2
data.set 0xA011AF94 %long   0xC2711E56
data.set 0xA011AF98 %long   0xDBA0D73D
data.set 0xA011AF9C %long   0x6F9DE2BD
data.set 0xA011AFA0 %long   0x1272EEB6
data.set 0xA011AFA4 %long   0x345A7E8E
data.set 0xA011AFA8 %long   0x4A51870B
data.set 0xA011AFAC %long   0xC8CEAEE4
data.set 0xA011AFB0 %long   0x4F8AE98B
data.set 0xA011AFB4 %long   0x9E9E69AC
data.set 0xA011AFB8 %long   0x0E7D1EF6
data.set 0xA011AFBC %long   0x6FA3C8AB
data.set 0xA011AFC0 %long   0x9C51106D
data.set 0xA011AFC4 %long   0xAB0C9913
data.set 0xA011AFC8 %long   0xAF9CAEC5
data.set 0xA011AFCC %long   0xDD33DA0D
data.set 0xA011AFD0 %long   0x2F1C18EF
data.set 0xA011AFD4 %long   0x808098C1
data.set 0xA011AFD8 %long   0x039BE90D
data.set 0xA011AFDC %long   0x19BEEBD5
data.set 0xA011AFE0 %long   0xEF96D4BD
data.set 0xA011AFE4 %long   0xFE7F5AC2
data.set 0xA011AFE8 %long   0x617B9402
data.set 0xA011AFEC %long   0xA812096C
data.set 0xA011AFF0 %long   0x73172A4A
data.set 0xA011AFF4 %long   0x454EC6B9
data.set 0xA011AFF8 %long   0x1ED83B21
data.set 0xA011AFFC %long   0xC089B7A7
data.set 0xA011B000 %long   0xF63C5B17
data.set 0xA011B004 %long   0x7D26EC70
data.set 0xA011B008 %long   0x9700C8CF
data.set 0xA011B00C %long   0x1FD4CEE4
data.set 0xA011B010 %long   0xBAFD4128
data.set 0xA011B014 %long   0x9A3C57EB
data.set 0xA011B018 %long   0xF296694A
data.set 0xA011B01C %long   0xE729ACBB
data.set 0xA011B020 %long   0x52816EC4
data.set 0xA011B024 %long   0x18BED3F9
data.set 0xA011B028 %long   0x652EDBA1
data.set 0xA011B02C %long   0x6923EE9A
data.set 0xA011B030 %long   0xF00D9925
data.set 0xA011B034 %long   0x58EB43EC
data.set 0xA011B038 %long   0xF464A1ED
data.set 0xA011B03C %long   0x2A61C710
data.set 0xA011B040 %long   0x7BEAA9E4
data.set 0xA011B044 %long   0x9921C276
data.set 0xA011B048 %long   0xCF37E5E0
data.set 0xA011B04C %long   0x8E7DF017
data.set 0xA011B050 %long   0x07F0A7D8
data.set 0xA011B054 %long   0xF65F7953
data.set 0xA011B058 %long   0x02ABB9CA
data.set 0xA011B05C %long   0xC6A4D992
data.set 0xA011B060 %long   0xA50C94AF
data.set 0xA011B064 %long   0x48D8243B
data.set 0xA011B068 %long   0x0A3F7C21
data.set 0xA011B06C %long   0x91CD6878
data.set 0xA011B070 %long   0x2D2661F9
data.set 0xA011B074 %long   0x745E575D
data.set 0xA011B078 %long   0xD0E89112
data.set 0xA011B07C %long   0xAA476D30
data.set 0xA011B080 %long   0xBC8E7384
data.set 0xA011B084 %long   0xDE3F9E3A
data.set 0xA011B088 %long   0xABD9CB16
data.set 0xA011B08C %long   0x0980786B
data.set 0xA011B090 %long   0x9FE8CEC9
data.set 0xA011B094 %long   0xC28179AA
data.set 0xA011B098 %long   0xBFF5ED04
data.set 0xA011B09C %long   0x71EE3F7A
data.set 0xA011B0A0 %long   0xEAD4B244
data.set 0xA011B0A4 %long   0x33E1F947
data.set 0xA011B0A8 %long   0xEB1FFB46
data.set 0xA011B0AC %long   0x23FF6262
data.set 0xA011B0B0 %long   0x9128B3C7
data.set 0xA011B0B4 %long   0x093BC703
data.set 0xA011B0B8 %long   0xC5B50FEB
data.set 0xA011B0BC %long   0x2988E4D5
data.set 0xA011B0C0 %long   0x89F5777F
data.set 0xA011B0C4 %long   0x2CD07A6F
data.set 0xA011B0C8 %long   0xBC1A6DAE
data.set 0xA011B0CC %long   0x8BD8DCB1
data.set 0xA011B0D0 %long   0xA1AEE750
data.set 0xA011B0D4 %long   0x1A056C10
data.set 0xA011B0D8 %long   0x692547E5
data.set 0xA011B0DC %long   0x2FAA48EC
data.set 0xA011B0E0 %long   0xEF6EA403
data.set 0xA011B0E4 %long   0x1A97C934
data.set 0xA011B0E8 %long   0x9B257181
data.set 0xA011B0EC %long   0xE6FADBF5
data.set 0xA011B0F0 %long   0xE20D8D22
data.set 0xA011B0F4 %long   0x553F89E0
data.set 0xA011B0F8 %long   0xE85A11E7
data.set 0xA011B0FC %long   0x2827E674
data.set 0xA011B100 %long   0x54FCFAA4
data.set 0xA011B104 %long   0xB1B4D608
data.set 0xA011B108 %long   0xFC860E2D
data.set 0xA011B10C %long   0xE6A457BE
data.set 0xA011B110 %long   0x19BD53A6
data.set 0xA011B114 %long   0x211D48E3
data.set 0xA011B118 %long   0xF7D71C9A
data.set 0xA011B11C %long   0x6B76D28E
data.set 0xA011B120 %long   0x330CCDE3
data.set 0xA011B124 %long   0x9D49AA26
data.set 0xA011B128 %long   0x38250425
data.set 0xA011B12C %long   0x65EE8A92
data.set 0xA011B130 %long   0x40DDBB7D
data.set 0xA011B134 %long   0x95E6FF74
data.set 0xA011B138 %long   0x5909CDFD
data.set 0xA011B13C %long   0x7BF45E5D
data.set 0xA011B140 %long   0xDF92DBBE
data.set 0xA011B144 %long   0x4EF4A0BA
data.set 0xA011B148 %long   0xFAED57B4
data.set 0xA011B14C %long   0x9CF3857A
data.set 0xA011B150 %long   0xFF76D944
data.set 0xA011B154 %long   0x17BD17A4
data.set 0xA011B158 %long   0x19D74FBF
data.set 0xA011B15C %long   0xD38F33B9
data.set 0xA011B160 %long   0x61FCA8FB
data.set 0xA011B164 %long   0x1539B2FB
data.set 0xA011B168 %long   0x0544A361
data.set 0xA011B16C %long   0xA803E8E5
data.set 0xA011B170 %long   0xBF5FEC26
data.set 0xA011B174 %long   0x7907ED51
data.set 0xA011B178 %long   0x1BB4BD9A
data.set 0xA011B17C %long   0x0D2C1CDA
data.set 0xA011B180 %long   0x01D905C4
data.set 0xA011B184 %long   0x3F68DF67
data.set 0xA011B188 %long   0x5AA78C5F
data.set 0xA011B18C %long   0xFFE31E9E
data.set 0xA011B190 %long   0xD6250512
data.set 0xA011B194 %long   0x1B9177B9
data.set 0xA011B198 %long   0xA1B991DD
data.set 0xA011B19C %long   0x54A1AF03
data.set 0xA011B1A0 %long   0x6F7F1DB2
data.set 0xA011B1A4 %long   0xB6574A44
data.set 0xA011B1A8 %long   0x8EC05BB6
data.set 0xA011B1AC %long   0xE765F1EB
data.set 0xA011B1B0 %long   0xC8569466
data.set 0xA011B1B4 %long   0x721E30B9
data.set 0xA011B1B8 %long   0xD3650143
data.set 0xA011B1BC %long   0xB75EB821
data.set 0xA011B1C0 %long   0xE535457E
data.set 0xA011B1C4 %long   0xDE4F2FE8
data.set 0xA011B1C8 %long   0x03EEC998
data.set 0xA011B1CC %long   0x2BEBC15D
data.set 0xA011B1D0 %long   0x4A2A0303
data.set 0xA011B1D4 %long   0x98F6EC02
data.set 0xA011B1D8 %long   0x7EBE0F8E
data.set 0xA011B1DC %long   0xCD745F16
data.set 0xA011B1E0 %long   0x4E66AC54
data.set 0xA011B1E4 %long   0xF03A9EC5
data.set 0xA011B1E8 %long   0x17755E26
data.set 0xA011B1EC %long   0xFB941061
data.set 0xA011B1F0 %long   0x9ACAEF3B
data.set 0xA011B1F4 %long   0xD7886EE5
data.set 0xA011B1F8 %long   0x8C1E5B90
data.set 0xA011B1FC %long   0x3875B47E
data.set 0xA011B200 %long   0xA9E95C82
data.set 0xA011B204 %long   0x2154220A
data.set 0xA011B208 %long   0xEE7195B5
data.set 0xA011B20C %long   0xF79A369C
data.set 0xA011B210 %long   0x04293136
data.set 0xA011B214 %long   0xF85902EC
data.set 0xA011B218 %long   0x28F2BA42
data.set 0xA011B21C %long   0x457D4097
data.set 0xA011B220 %long   0x7995576C
data.set 0xA011B224 %long   0xB29EC904
data.set 0xA011B228 %long   0x9916FA8B
data.set 0xA011B22C %long   0x12826F21
data.set 0xA011B230 %long   0x0A7B8F56
data.set 0xA011B234 %long   0x5C724E42
data.set 0xA011B238 %long   0x8FE9DFC4
data.set 0xA011B23C %long   0xA3BB2DE7
data.set 0xA011B240 %long   0xC6D54C82
data.set 0xA011B244 %long   0xF623B836
data.set 0xA011B248 %long   0x2104F81F
data.set 0xA011B24C %long   0xB581A58A
data.set 0xA011B250 %long   0x51B73D32
data.set 0xA011B254 %long   0x4C464D6E
data.set 0xA011B258 %long   0xE39D305D
data.set 0xA011B25C %long   0x16FC027B
data.set 0xA011B260 %long   0x3066DE32
data.set 0xA011B264 %long   0x493DDE51
data.set 0xA011B268 %long   0xABC868D7
data.set 0xA011B26C %long   0xF8AEEC26
data.set 0xA011B270 %long   0x43E88A22
data.set 0xA011B274 %long   0xB6252603
data.set 0xA011B278 %long   0x9FE06753
data.set 0xA011B27C %long   0xD9A2C752
data.set 0xA011B280 %long   0xCE675F9E
data.set 0xA011B284 %long   0xCB5861F4
data.set 0xA011B288 %long   0x552D06E9
data.set 0xA011B28C %long   0x449FAA0A
data.set 0xA011B290 %long   0x65ACC387
data.set 0xA011B294 %long   0x5183208B
data.set 0xA011B298 %long   0x3A943789
data.set 0xA011B29C %long   0x456F2BD7
data.set 0xA011B2A0 %long   0xD361C90B
data.set 0xA011B2A4 %long   0x3D3A2460
data.set 0xA011B2A8 %long   0xCD72B2C8
data.set 0xA011B2AC %long   0x3B849415
data.set 0xA011B2B0 %long   0x226A57C9
data.set 0xA011B2B4 %long   0x50C731E8
data.set 0xA011B2B8 %long   0x65EE820B
data.set 0xA011B2BC %long   0x842BF18C
data.set 0xA011B2C0 %long   0x4315C2D7
data.set 0xA011B2C4 %long   0x014D2C61
data.set 0xA011B2C8 %long   0x5E8EE00C
data.set 0xA011B2CC %long   0x3F250B2A
data.set 0xA011B2D0 %long   0x4ED3A0F3
data.set 0xA011B2D4 %long   0x850C14D0
data.set 0xA011B2D8 %long   0x564E7590
data.set 0xA011B2DC %long   0x649F811D
data.set 0xA011B2E0 %long   0x6EFC0DA0
data.set 0xA011B2E4 %long   0xED5BE831
data.set 0xA011B2E8 %long   0xBA6FFC14
data.set 0xA011B2EC %long   0xB4CDD123
data.set 0xA011B2F0 %long   0xE0E710CC
data.set 0xA011B2F4 %long   0xF7C3A525
data.set 0xA011B2F8 %long   0x70029546
data.set 0xA011B2FC %long   0x485AAEF5
data.set 0xA011B300 %long   0xB7B89939
data.set 0xA011B304 %long   0xAF36EA2D
data.set 0xA011B308 %long   0xCDF88540
data.set 0xA011B30C %long   0x47D77C6F
data.set 0xA011B310 %long   0x76BEF571
data.set 0xA011B314 %long   0x4D7FF17C
data.set 0xA011B318 %long   0xEF38BBFE
data.set 0xA011B31C %long   0x9106A199
data.set 0xA011B320 %long   0xF00691D6
data.set 0xA011B324 %long   0xA2B07952
data.set 0xA011B328 %long   0x96B24977
data.set 0xA011B32C %long   0x38EFCEBC
data.set 0xA011B330 %long   0x24E2F3F5
data.set 0xA011B334 %long   0xB2D05DC7
data.set 0xA011B338 %long   0xEBB3549D
data.set 0xA011B33C %long   0x18C25FB0
data.set 0xA011B340 %long   0xBD0CF3A0
data.set 0xA011B344 %long   0xF7E74EF2
data.set 0xA011B348 %long   0x2BE6322E
data.set 0xA011B34C %long   0xD0223D10
data.set 0xA011B350 %long   0x0414B392
data.set 0xA011B354 %long   0x008E4BB2
data.set 0xA011B358 %long   0x3FD63D80
data.set 0xA011B35C %long   0x8D4D4AE3
data.set 0xA011B360 %long   0x8D182820
data.set 0xA011B364 %long   0x11A75EA8
data.set 0xA011B368 %long   0x92ABD8F0
data.set 0xA011B36C %long   0xFD934E0D
data.set 0xA011B370 %long   0x67FEA39B
data.set 0xA011B374 %long   0x2ED6DCA1
data.set 0xA011B378 %long   0x6D8E62F7
data.set 0xA011B37C %long   0xBF9D33A6
data.set 0xA011B380 %long   0xD934C689
data.set 0xA011B384 %long   0x382A6579
data.set 0xA011B388 %long   0x91C8E82E
data.set 0xA011B38C %long   0x26FF0153
data.set 0xA011B390 %long   0xD8DC1419
data.set 0xA011B394 %long   0x8559E55E
data.set 0xA011B398 %long   0xA56C0519
data.set 0xA011B39C %long   0xE2F203A9
data.set 0xA011B3A0 %long   0xA5417A93
data.set 0xA011B3A4 %long   0xA9FD157A
data.set 0xA011B3A8 %long   0x45C0CAC1
data.set 0xA011B3AC %long   0x8FA9E415
data.set 0xA011B3B0 %long   0x83CD6C16
data.set 0xA011B3B4 %long   0x688022B4
data.set 0xA011B3B8 %long   0xEF0DD015
data.set 0xA011B3BC %long   0x2A73F1F9
data.set 0xA011B3C0 %long   0xD6CE1CFC
data.set 0xA011B3C4 %long   0x797A87CC
data.set 0xA011B3C8 %long   0xDF743571
data.set 0xA011B3CC %long   0xAF3390A8
data.set 0xA011B3D0 %long   0x0DF61591
data.set 0xA011B3D4 %long   0x15666BC0
data.set 0xA011B3D8 %long   0xB14F9AAB
data.set 0xA011B3DC %long   0x31F84204
data.set 0xA011B3E0 %long   0x65519F07
data.set 0xA011B3E4 %long   0xC3E2FF2A
data.set 0xA011B3E8 %long   0xC2DDC22C
data.set 0xA011B3EC %long   0x0DC1FD6A
data.set 0xA011B3F0 %long   0x599F8A2A
data.set 0xA011B3F4 %long   0x5D310AE5
data.set 0xA011B3F8 %long   0x92860990
data.set 0xA011B3FC %long   0xD994B50A
data.set 0xA011B400 %long   0x6CEA4EB6
data.set 0xA011B404 %long   0x13F5BBC3
data.set 0xA011B408 %long   0x0F9866F7
data.set 0xA011B40C %long   0xF6FC8403
data.set 0xA011B410 %long   0xACA018E3
data.set 0xA011B414 %long   0x752B9FF6
data.set 0xA011B418 %long   0x5A506CA3
data.set 0xA011B41C %long   0x3719D962
data.set 0xA011B420 %long   0xB8598C88
data.set 0xA011B424 %long   0x0C619FEE
data.set 0xA011B428 %long   0xB0C63A10
data.set 0xA011B42C %long   0xF160AE15
data.set 0xA011B430 %long   0x4D36F41D
data.set 0xA011B434 %long   0xAD9809E6
data.set 0xA011B438 %long   0x6F76490B
data.set 0xA011B43C %long   0x70F25EB4
data.set 0xA011B440 %long   0x54D9CFA4
data.set 0xA011B444 %long   0xD1A420B8
data.set 0xA011B448 %long   0x1CD31691
data.set 0xA011B44C %long   0x0C69EDAD
data.set 0xA011B450 %long   0x495E8EE1
data.set 0xA011B454 %long   0x4FFB955C
data.set 0xA011B458 %long   0x2CA81CD8
data.set 0xA011B45C %long   0x71074B3F
data.set 0xA011B460 %long   0xECF27269
data.set 0xA011B464 %long   0x39D6F305
data.set 0xA011B468 %long   0x74D4F1CD
data.set 0xA011B46C %long   0x16EBA6D1
data.set 0xA011B470 %long   0x88795140
data.set 0xA011B474 %long   0x848ABB86
data.set 0xA011B478 %long   0x584C7F9D
data.set 0xA011B47C %long   0xF39A18A6
data.set 0xA011B480 %long   0x6D2A940D
data.set 0xA011B484 %long   0x3BF17096
data.set 0xA011B488 %long   0x3A43E4BF
data.set 0xA011B48C %long   0x152D6420
data.set 0xA011B490 %long   0xACEDED59
data.set 0xA011B494 %long   0x7FF66D61
data.set 0xA011B498 %long   0x06AFAED9
data.set 0xA011B49C %long   0xCA9C28BB
data.set 0xA011B4A0 %long   0xB72C8036
data.set 0xA011B4A4 %long   0xFCAD341F
data.set 0xA011B4A8 %long   0xD115AA72
data.set 0xA011B4AC %long   0xE746FBAB
data.set 0xA011B4B0 %long   0xBD00CE21
data.set 0xA011B4B4 %long   0xA2C50772
data.set 0xA011B4B8 %long   0xB66F26D3
data.set 0xA011B4BC %long   0xF83A2918
data.set 0xA011B4C0 %long   0x5FE31DE2
data.set 0xA011B4C4 %long   0x690727AC
data.set 0xA011B4C8 %long   0x91E5427D
data.set 0xA011B4CC %long   0x38E93AEB
data.set 0xA011B4D0 %long   0x2439BDF3
data.set 0xA011B4D4 %long   0x32E37EE0
data.set 0xA011B4D8 %long   0x8B213F4B
data.set 0xA011B4DC %long   0x5D536A1C
data.set 0xA011B4E0 %long   0x248BD601
data.set 0xA011B4E4 %long   0xD7D7983A
data.set 0xA011B4E8 %long   0xB2D481D4
data.set 0xA011B4EC %long   0xEFC2D218
data.set 0xA011B4F0 %long   0xA4CC7697
data.set 0xA011B4F4 %long   0xFA7B05C5
data.set 0xA011B4F8 %long   0x25A10700
data.set 0xA011B4FC %long   0x14CB2E23
data.set 0xA011B500 %long   0x60CA9754
data.set 0xA011B504 %long   0xB01103B1
data.set 0xA011B508 %long   0x7FA8B0A1
data.set 0xA011B50C %long   0x766A8D30
data.set 0xA011B510 %long   0x9B8F882E
data.set 0xA011B514 %long   0x8CD28056
data.set 0xA011B518 %long   0x636EF950
data.set 0xA011B51C %long   0x3DFB3412
data.set 0xA011B520 %long   0x29C49F7B
data.set 0xA011B524 %long   0xF2EDF2B4
data.set 0xA011B528 %long   0xAB92C0D2
data.set 0xA011B52C %long   0x5BB8AE84
data.set 0xA011B530 %long   0x76C48350
data.set 0xA011B534 %long   0xF5CA515E
data.set 0xA011B538 %long   0xE2D40FA4
data.set 0xA011B53C %long   0xFF7A9F71
data.set 0xA011B540 %long   0xD6194D01
data.set 0xA011B544 %long   0x8BE171C6
data.set 0xA011B548 %long   0x488C525F
data.set 0xA011B54C %long   0xE95E54AE
data.set 0xA011B550 %long   0x2982BCDB
data.set 0xA011B554 %long   0xCF1D015E
data.set 0xA011B558 %long   0xF7D6204A
data.set 0xA011B55C %long   0x42D77FC5
data.set 0xA011B560 %long   0x3F413503
data.set 0xA011B564 %long   0x8F247CF1
data.set 0xA011B568 %long   0xB366C185
data.set 0xA011B56C %long   0xE1795CEA
data.set 0xA011B570 %long   0xEB2C2EE8
data.set 0xA011B574 %long   0x4FD44A1D
data.set 0xA011B578 %long   0x76984E01
data.set 0xA011B57C %long   0xFD71D2FD
data.set 0xA011B580 %long   0x34CAFA11
data.set 0xA011B584 %long   0x17D2060F
data.set 0xA011B588 %long   0xDD395F31
data.set 0xA011B58C %long   0xE893FCA3
data.set 0xA011B590 %long   0xB47A3ACB
data.set 0xA011B594 %long   0x4DAC71DE
data.set 0xA011B598 %long   0xCFB9AE08
data.set 0xA011B59C %long   0x04E6B444
data.set 0xA011B5A0 %long   0x682832C9
data.set 0xA011B5A4 %long   0x18B57D8E
data.set 0xA011B5A8 %long   0x40EAB129
data.set 0xA011B5AC %long   0xF005FA78
data.set 0xA011B5B0 %long   0x0808DACF
data.set 0xA011B5B4 %long   0xD93F7AD7
data.set 0xA011B5B8 %long   0xD9B7361D
data.set 0xA011B5BC %long   0xA3768CB1
data.set 0xA011B5C0 %long   0x09871BAF
data.set 0xA011B5C4 %long   0x9C6B1F32
data.set 0xA011B5C8 %long   0x480DDD98
data.set 0xA011B5CC %long   0x42E707AA
data.set 0xA011B5D0 %long   0x2523F465
data.set 0xA011B5D4 %long   0x943B6413
data.set 0xA011B5D8 %long   0x77A5BC7E
data.set 0xA011B5DC %long   0xEB9AB9DC
data.set 0xA011B5E0 %long   0x168F761A
data.set 0xA011B5E4 %long   0xCAC28BB3
data.set 0xA011B5E8 %long   0x599FE5D5
data.set 0xA011B5EC %long   0x5C2FABBD
data.set 0xA011B5F0 %long   0x42FF7354
data.set 0xA011B5F4 %long   0x3232971A
data.set 0xA011B5F8 %long   0x2DB13DAB
data.set 0xA011B5FC %long   0x06A2835D
data.set 0xA011B600 %long   0x595E0288
data.set 0xA011B604 %long   0xD6882B49
data.set 0xA011B608 %long   0x55C0BC61
data.set 0xA011B60C %long   0x90EB8CAA
data.set 0xA011B610 %long   0xE8E2EDA3
data.set 0xA011B614 %long   0xDD8F4573
data.set 0xA011B618 %long   0x9EBC3037
data.set 0xA011B61C %long   0xFC306866
data.set 0xA011B620 %long   0xB3C095F0
data.set 0xA011B624 %long   0x21112EAA
data.set 0xA011B628 %long   0xE1657CFD
data.set 0xA011B62C %long   0xEEB34B2E
data.set 0xA011B630 %long   0x16687D8E
data.set 0xA011B634 %long   0x43C686B9
data.set 0xA011B638 %long   0x0DE7A5A6
data.set 0xA011B63C %long   0x62D1AA16
data.set 0xA011B640 %long   0x6E8750CE
data.set 0xA011B644 %long   0xFBF41925
data.set 0xA011B648 %long   0x8B3F0932
data.set 0xA011B64C %long   0xCA712768
data.set 0xA011B650 %long   0xEB81F680
data.set 0xA011B654 %long   0x6E92769D
data.set 0xA011B658 %long   0x7194B99D
data.set 0xA011B65C %long   0x1762A4FE
data.set 0xA011B660 %long   0x9CE35D59
data.set 0xA011B664 %long   0x81D26DF5
data.set 0xA011B668 %long   0xDAF13650
data.set 0xA011B66C %long   0x305CD07A
data.set 0xA011B670 %long   0x0DAB5203
data.set 0xA011B674 %long   0x140376C8
data.set 0xA011B678 %long   0x0A62B938
data.set 0xA011B67C %long   0x7D9ECAC6
data.set 0xA011B680 %long   0x5E7BF3E5
data.set 0xA011B684 %long   0x7227DF7B
data.set 0xA011B688 %long   0x50D7767C
data.set 0xA011B68C %long   0x3BA67218
data.set 0xA011B690 %long   0x702B7C8B
data.set 0xA011B694 %long   0x7E8DBB35
data.set 0xA011B698 %long   0x8C45B608
data.set 0xA011B69C %long   0x49283192
data.set 0xA011B6A0 %long   0x7A0AE248
data.set 0xA011B6A4 %long   0xC22489EA
data.set 0xA011B6A8 %long   0xE2AFFA92
data.set 0xA011B6AC %long   0x29B673C7
data.set 0xA011B6B0 %long   0x10E4002E
data.set 0xA011B6B4 %long   0xB0C5C907
data.set 0xA011B6B8 %long   0x93244361
data.set 0xA011B6BC %long   0xF4499AB1
data.set 0xA011B6C0 %long   0x38239445
data.set 0xA011B6C4 %long   0x5CB1FC4C
data.set 0xA011B6C8 %long   0xD59F95B2
data.set 0xA011B6CC %long   0x99A2F5B9
data.set 0xA011B6D0 %long   0x66A96765
data.set 0xA011B6D4 %long   0xF5A73906
data.set 0xA011B6D8 %long   0xDC7E68D8
data.set 0xA011B6DC %long   0x0162D7A2
data.set 0xA011B6E0 %long   0xC8A2ED74
data.set 0xA011B6E4 %long   0xBAF33C0F
data.set 0xA011B6E8 %long   0x77CEB874
data.set 0xA011B6EC %long   0x41C02AFE
data.set 0xA011B6F0 %long   0x20D5111E
data.set 0xA011B6F4 %long   0x97291A2F
data.set 0xA011B6F8 %long   0x5A01D9B4
data.set 0xA011B6FC %long   0x6C8C0010
data.set 0xA011B700 %long   0x207A2E82
data.set 0xA011B704 %long   0x2D832907
data.set 0xA011B708 %long   0x02811E46
data.set 0xA011B70C %long   0x05985293
data.set 0xA011B710 %long   0xEAFD21EB
data.set 0xA011B714 %long   0x1ECD8A9F
data.set 0xA011B718 %long   0xBA106C0A
data.set 0xA011B71C %long   0xF3E9CB3B
data.set 0xA011B720 %long   0xA4D0134C
data.set 0xA011B724 %long   0x8B344B1A
data.set 0xA011B728 %long   0x45AE4EAB
data.set 0xA011B72C %long   0x0FB32B28
data.set 0xA011B730 %long   0x97A029B1
data.set 0xA011B734 %long   0xA9ABCB5E
data.set 0xA011B738 %long   0xCB243FCF
data.set 0xA011B73C %long   0xE638D7D9
data.set 0xA011B740 %long   0xA22666BD
data.set 0xA011B744 %long   0xEFEE0B57
data.set 0xA011B748 %long   0x4C993297
data.set 0xA011B74C %long   0x40F65638
data.set 0xA011B750 %long   0x02004679
data.set 0xA011B754 %long   0x0CF80D72
data.set 0xA011B758 %long   0xFC34F677
data.set 0xA011B75C %long   0xB95B027A
data.set 0xA011B760 %long   0xF6068FFC
data.set 0xA011B764 %long   0x7BD573CF
data.set 0xA011B768 %long   0x3C8852C4
data.set 0xA011B76C %long   0x6CED5E5E
data.set 0xA011B770 %long   0x661342CC
data.set 0xA011B774 %long   0x374A7E4B
data.set 0xA011B778 %long   0x90BF4EC7
data.set 0xA011B77C %long   0xB6A41D6E
data.set 0xA011B780 %long   0xCCD5650C
data.set 0xA011B784 %long   0x23675C79
data.set 0xA011B788 %long   0x22001681
data.set 0xA011B78C %long   0x8BDD427F
data.set 0xA011B790 %long   0xCD2100FC
data.set 0xA011B794 %long   0x237274E2
data.set 0xA011B798 %long   0xC7C2A144
data.set 0xA011B79C %long   0xF1F1F461
data.set 0xA011B7A0 %long   0xB41868CE
data.set 0xA011B7A4 %long   0xF71B00B4
data.set 0xA011B7A8 %long   0x59D03951
data.set 0xA011B7AC %long   0x426B2A5C
data.set 0xA011B7B0 %long   0xA25C41EB
data.set 0xA011B7B4 %long   0x89BB551A
data.set 0xA011B7B8 %long   0x7BFBC1BE
data.set 0xA011B7BC %long   0xEB2A4C54
data.set 0xA011B7C0 %long   0xA66C15AD
data.set 0xA011B7C4 %long   0x54B9E58A
data.set 0xA011B7C8 %long   0xEC70624A
data.set 0xA011B7CC %long   0x05D24343
data.set 0xA011B7D0 %long   0x13DACCBC
data.set 0xA011B7D4 %long   0x83DB7512
data.set 0xA011B7D8 %long   0x8CE3D6BB
data.set 0xA011B7DC %long   0x89A154E8
data.set 0xA011B7E0 %long   0x66AFDCD7
data.set 0xA011B7E4 %long   0xE1117938
data.set 0xA011B7E8 %long   0x674D95A7
data.set 0xA011B7EC %long   0x76F9B83B
data.set 0xA011B7F0 %long   0x6CAFBD06
data.set 0xA011B7F4 %long   0xE2959C1C
data.set 0xA011B7F8 %long   0xA325F8BE
data.set 0xA011B7FC %long   0x3B5CE829
data.set 0xA011B800 %long   0x978F2345
data.set 0xA011B804 %long   0xC67BAA9B
data.set 0xA011B808 %long   0x4BDA72BC
data.set 0xA011B80C %long   0x0E01A212
data.set 0xA011B810 %long   0x9F586EFE
data.set 0xA011B814 %long   0xB421AB43
data.set 0xA011B818 %long   0x3DFED826
data.set 0xA011B81C %long   0x2EEBE6CA
data.set 0xA011B820 %long   0xA20C5DC8
data.set 0xA011B824 %long   0x84EF3560
data.set 0xA011B828 %long   0x9AE3E151
data.set 0xA011B82C %long   0xA3DA576B
data.set 0xA011B830 %long   0x8FCEE127
data.set 0xA011B834 %long   0xF3181C0C
data.set 0xA011B838 %long   0x92B0CF27
data.set 0xA011B83C %long   0x03C4AA61
data.set 0xA011B840 %long   0x204444BE
data.set 0xA011B844 %long   0xE4C4B5A3
data.set 0xA011B848 %long   0x0AD717FB
data.set 0xA011B84C %long   0x925C30C9
data.set 0xA011B850 %long   0xADD2D5D5
data.set 0xA011B854 %long   0x33B5532F
data.set 0xA011B858 %long   0x616F5A34
data.set 0xA011B85C %long   0x864F76FB
data.set 0xA011B860 %long   0x7FF266B0
data.set 0xA011B864 %long   0x76F1A763
data.set 0xA011B868 %long   0xAB6C6165
data.set 0xA011B86C %long   0xC1688B8F
data.set 0xA011B870 %long   0xBBEED484
data.set 0xA011B874 %long   0x62495014
data.set 0xA011B878 %long   0x432688FB
data.set 0xA011B87C %long   0xB99E2ABD
data.set 0xA011B880 %long   0xA43B185F
data.set 0xA011B884 %long   0x87C09403
data.set 0xA011B888 %long   0x9CBB0DE4
data.set 0xA011B88C %long   0xD1E7634E
data.set 0xA011B890 %long   0xED981A91
data.set 0xA011B894 %long   0xEFF4722D
data.set 0xA011B898 %long   0x88408F3B
data.set 0xA011B89C %long   0xB996F9AF
data.set 0xA011B8A0 %long   0x4E4C7936
data.set 0xA011B8A4 %long   0x3859969B
data.set 0xA011B8A8 %long   0xCD439897
data.set 0xA011B8AC %long   0xECE58D53
data.set 0xA011B8B0 %long   0xEDA6AA35
data.set 0xA011B8B4 %long   0xFACAA7E6
data.set 0xA011B8B8 %long   0xBE32330A
data.set 0xA011B8BC %long   0x48D23A1F
data.set 0xA011B8C0 %long   0x0EBC7229
data.set 0xA011B8C4 %long   0xFD90B887
data.set 0xA011B8C8 %long   0xD6EBB76C
data.set 0xA011B8CC %long   0x9D52AF53
data.set 0xA011B8D0 %long   0x66CD7B63
data.set 0xA011B8D4 %long   0xF423B9D9
data.set 0xA011B8D8 %long   0x83E8A0CD
data.set 0xA011B8DC %long   0x4C2A737C
data.set 0xA011B8E0 %long   0xD9D9436E
data.set 0xA011B8E4 %long   0x060831F3
data.set 0xA011B8E8 %long   0xB608E105
data.set 0xA011B8EC %long   0xAE2B02E5
data.set 0xA011B8F0 %long   0x1130A0BF
data.set 0xA011B8F4 %long   0xAE6EA1CE
data.set 0xA011B8F8 %long   0x5076270D
data.set 0xA011B8FC %long   0x4D4CE632
data.set 0xA011B900 %long   0x4101AF84
data.set 0xA011B904 %long   0xA6D9FB0E
data.set 0xA011B908 %long   0x82ED1CBB
data.set 0xA011B90C %long   0xF772473B
data.set 0xA011B910 %long   0xEAE2762B
data.set 0xA011B914 %long   0xD43BC1E0
data.set 0xA011B918 %long   0x0E4907EE
data.set 0xA011B91C %long   0x70FA56B0
data.set 0xA011B920 %long   0x496CFDEF
data.set 0xA011B924 %long   0xE677F83A
data.set 0xA011B928 %long   0x88F6FA2A
data.set 0xA011B92C %long   0x53E7DFFA
data.set 0xA011B930 %long   0xC4412F07
data.set 0xA011B934 %long   0x8D14A2D1
data.set 0xA011B938 %long   0x3D993A1E
data.set 0xA011B93C %long   0xE77A8D2C
data.set 0xA011B940 %long   0x37DD454B
data.set 0xA011B944 %long   0xAC23FF03
data.set 0xA011B948 %long   0x7B177A71
data.set 0xA011B94C %long   0x431ABA99
data.set 0xA011B950 %long   0xAFA23413
data.set 0xA011B954 %long   0xDE94832F
data.set 0xA011B958 %long   0xB07C18D0
data.set 0xA011B95C %long   0xA6102787
data.set 0xA011B960 %long   0x4C32C948
data.set 0xA011B964 %long   0x0054E858
data.set 0xA011B968 %long   0xB94B0401
data.set 0xA011B96C %long   0xEABECC3F
data.set 0xA011B970 %long   0x3AF452E9
data.set 0xA011B974 %long   0xCBF1A29C
data.set 0xA011B978 %long   0xA0C48A25
data.set 0xA011B97C %long   0x1CD32033
data.set 0xA011B980 %long   0x8B48C33E
data.set 0xA011B984 %long   0x237D4173
data.set 0xA011B988 %long   0x6CCB3510
data.set 0xA011B98C %long   0x7E01DAEA
data.set 0xA011B990 %long   0x598721D5
data.set 0xA011B994 %long   0xDEB47FF1
data.set 0xA011B998 %long   0x3DFBB8E5
data.set 0xA011B99C %long   0x648BCFC9
data.set 0xA011B9A0 %long   0x70BBE752
data.set 0xA011B9A4 %long   0x4F3DF855
data.set 0xA011B9A8 %long   0xFD62A6D0
data.set 0xA011B9AC %long   0x2C556244
data.set 0xA011B9B0 %long   0x2876F25D
data.set 0xA011B9B4 %long   0xE839A890
data.set 0xA011B9B8 %long   0x229F0DAB
data.set 0xA011B9BC %long   0xA923EE80
data.set 0xA011B9C0 %long   0x420F57DC
data.set 0xA011B9C4 %long   0x3975A990
data.set 0xA011B9C8 %long   0x5C511BDE
data.set 0xA011B9CC %long   0x6992C07E
data.set 0xA011B9D0 %long   0xD68E7814
data.set 0xA011B9D4 %long   0x3B51A183
data.set 0xA011B9D8 %long   0x52CB8578
data.set 0xA011B9DC %long   0x629F4C98
data.set 0xA011B9E0 %long   0x65B6FA9E
data.set 0xA011B9E4 %long   0x45502A31
data.set 0xA011B9E8 %long   0xAA0EA401
data.set 0xA011B9EC %long   0x934D603D
data.set 0xA011B9F0 %long   0xCEF161B5
data.set 0xA011B9F4 %long   0xEAB1C99D
data.set 0xA011B9F8 %long   0x10A04C47
data.set 0xA011B9FC %long   0x30F97E86
data.set 0xA011BA00 %long   0x26F39E86
data.set 0xA011BA04 %long   0x7B15A2EC
data.set 0xA011BA08 %long   0xA446BF5B
data.set 0xA011BA0C %long   0x28047CDB
data.set 0xA011BA10 %long   0xAA1A9115
data.set 0xA011BA14 %long   0x36EE7F14
data.set 0xA011BA18 %long   0xC6352CDE
data.set 0xA011BA1C %long   0x5D6EAA50
data.set 0xA011BA20 %long   0x85B6526C
data.set 0xA011BA24 %long   0xBDEF439B
data.set 0xA011BA28 %long   0x1C44C5D2
data.set 0xA011BA2C %long   0xF5061B55
data.set 0xA011BA30 %long   0x3812A960
data.set 0xA011BA34 %long   0xB6CA0691
data.set 0xA011BA38 %long   0x1A7CB512
data.set 0xA011BA3C %long   0x7DE44F28
data.set 0xA011BA40 %long   0xC355AA73
data.set 0xA011BA44 %long   0xC0E4AAEC
data.set 0xA011BA48 %long   0x2DE6EA46
data.set 0xA011BA4C %long   0x79C9789E
data.set 0xA011BA50 %long   0x48D16B76
data.set 0xA011BA54 %long   0xF847D356
data.set 0xA011BA58 %long   0xEBF512C6
data.set 0xA011BA5C %long   0xF005A404
data.set 0xA011BA60 %long   0x59E85BE7
data.set 0xA011BA64 %long   0xB9019C60
data.set 0xA011BA68 %long   0xB475C410
data.set 0xA011BA6C %long   0xAED3BA33
data.set 0xA011BA70 %long   0x2507F90D
data.set 0xA011BA74 %long   0xA12BF79C
data.set 0xA011BA78 %long   0x8FE484D6
data.set 0xA011BA7C %long   0xCA4BA984
data.set 0xA011BA80 %long   0xC75EC4C6
data.set 0xA011BA84 %long   0x1AA4882A
data.set 0xA011BA88 %long   0x69472C2D
data.set 0xA011BA8C %long   0x08D6F2D3
data.set 0xA011BA90 %long   0x469DFF4F
data.set 0xA011BA94 %long   0x0A2D03E0
data.set 0xA011BA98 %long   0x1333D3A7
data.set 0xA011BA9C %long   0xEE20F553
data.set 0xA011BAA0 %long   0x73E6FE90
data.set 0xA011BAA4 %long   0x16D4044D
data.set 0xA011BAA8 %long   0x2740C3EE
data.set 0xA011BAAC %long   0x5984B50B
data.set 0xA011BAB0 %long   0xD71B3080
data.set 0xA011BAB4 %long   0x0AF65BCA
data.set 0xA011BAB8 %long   0x642DFE4C
data.set 0xA011BABC %long   0x7091EE0C
data.set 0xA011BAC0 %long   0x7ACF128C
data.set 0xA011BAC4 %long   0xDD4DFEF4
data.set 0xA011BAC8 %long   0x9BA5423B
data.set 0xA011BACC %long   0x93635B3B
data.set 0xA011BAD0 %long   0x64083053
data.set 0xA011BAD4 %long   0x25AAE690
data.set 0xA011BAD8 %long   0x09A2C9F8
data.set 0xA011BADC %long   0x346570AA
data.set 0xA011BAE0 %long   0x3BB795A7
data.set 0xA011BAE4 %long   0x51BDAC1F
data.set 0xA011BAE8 %long   0xAD7ECEDB
data.set 0xA011BAEC %long   0x5D8EEEBE
data.set 0xA011BAF0 %long   0x5B407E00
data.set 0xA011BAF4 %long   0xA2A20B24
data.set 0xA011BAF8 %long   0x1C564734
data.set 0xA011BAFC %long   0x259514DF
data.set 0xA011BB00 %long   0x4733916C
data.set 0xA011BB04 %long   0xBBF78A73
data.set 0xA011BB08 %long   0x442378DD
data.set 0xA011BB0C %long   0xB735A235
data.set 0xA011BB10 %long   0x0CA18303
data.set 0xA011BB14 %long   0xBACC4635
data.set 0xA011BB18 %long   0x4ECB9858
data.set 0xA011BB1C %long   0xABE9AFDA
data.set 0xA011BB20 %long   0x7DF0F388
data.set 0xA011BB24 %long   0xACA4361D
data.set 0xA011BB28 %long   0x4409BE37
data.set 0xA011BB2C %long   0x1C8FC1B1
data.set 0xA011BB30 %long   0x22408221
data.set 0xA011BB34 %long   0x1606E5F2
data.set 0xA011BB38 %long   0x745C5CF9
data.set 0xA011BB3C %long   0x6C705AC0
data.set 0xA011BB40 %long   0x30BCB07B
data.set 0xA011BB44 %long   0x21DC7F53
data.set 0xA011BB48 %long   0x2A5F0E0F
data.set 0xA011BB4C %long   0x86F2B6A3
data.set 0xA011BB50 %long   0x3E4F0C8E
data.set 0xA011BB54 %long   0xBF6CB92D
data.set 0xA011BB58 %long   0xD36C4DE7
data.set 0xA011BB5C %long   0x4FAEAF5F
data.set 0xA011BB60 %long   0x04F3DC14
data.set 0xA011BB64 %long   0xBA64676F
data.set 0xA011BB68 %long   0xA095A6CB
data.set 0xA011BB6C %long   0x1C00A5A5
data.set 0xA011BB70 %long   0x79FA6F49
data.set 0xA011BB74 %long   0x1AB65CEF
data.set 0xA011BB78 %long   0xD3EBCAEC
data.set 0xA011BB7C %long   0xE5129C95
data.set 0xA011BB80 %long   0xB3A9EFF5
data.set 0xA011BB84 %long   0x359DA69B
data.set 0xA011BB88 %long   0xFE424D81
data.set 0xA011BB8C %long   0x73FA2CAA
data.set 0xA011BB90 %long   0x28C3E6AF
data.set 0xA011BB94 %long   0x1D6D9A0E
data.set 0xA011BB98 %long   0xD83B37C2
data.set 0xA011BB9C %long   0xA2BDDDF7
data.set 0xA011BBA0 %long   0x3DF72AF9
data.set 0xA011BBA4 %long   0x7B95E1FF
data.set 0xA011BBA8 %long   0x488A3B92
data.set 0xA011BBAC %long   0x9C8E2A8E
data.set 0xA011BBB0 %long   0x4F4AD52F
data.set 0xA011BBB4 %long   0x45A73A7E
data.set 0xA011BBB8 %long   0x0A92FE5A
data.set 0xA011BBBC %long   0x1D1407A0
data.set 0xA011BBC0 %long   0x0353488F
data.set 0xA011BBC4 %long   0x4FEDE904
data.set 0xA011BBC8 %long   0x1176CCE8
data.set 0xA011BBCC %long   0x755543FE
data.set 0xA011BBD0 %long   0xB2807A3C
data.set 0xA011BBD4 %long   0x1EB267AB
data.set 0xA011BBD8 %long   0xA8EC4A57
data.set 0xA011BBDC %long   0x7BCE89B2
data.set 0xA011BBE0 %long   0xEFC4E1F5
data.set 0xA011BBE4 %long   0x7301C9B4
data.set 0xA011BBE8 %long   0x4FEE11DF
data.set 0xA011BBEC %long   0x7D4C4D1D
data.set 0xA011BBF0 %long   0x57FBA7FA
data.set 0xA011BBF4 %long   0xDD71A40E
data.set 0xA011BBF8 %long   0x63BF1D04
data.set 0xA011BBFC %long   0x42AFAE7A
data.set 0xA011BC00 %long   0x9B3C8977
data.set 0xA011BC04 %long   0x4273969A
data.set 0xA011BC08 %long   0x6953CB20
data.set 0xA011BC0C %long   0x5CACB323
data.set 0xA011BC10 %long   0x25D1C3CD
data.set 0xA011BC14 %long   0x0C945C0D
data.set 0xA011BC18 %long   0xAC7C2F19
data.set 0xA011BC1C %long   0xBE6DAA18
data.set 0xA011BC20 %long   0x11F8F5D4
data.set 0xA011BC24 %long   0x536F0517
data.set 0xA011BC28 %long   0x000F1313
data.set 0xA011BC2C %long   0x4A38D4FB
data.set 0xA011BC30 %long   0xD72854DA
data.set 0xA011BC34 %long   0xC02DFD41
data.set 0xA011BC38 %long   0x23D17044
data.set 0xA011BC3C %long   0x78535740
data.set 0xA011BC40 %long   0xF4270E6A
data.set 0xA011BC44 %long   0x8DA86556
data.set 0xA011BC48 %long   0xC71DAE05
data.set 0xA011BC4C %long   0xD468C247
data.set 0xA011BC50 %long   0xFB983A61
data.set 0xA011BC54 %long   0x48C0B508
data.set 0xA011BC58 %long   0x799074E3
data.set 0xA011BC5C %long   0x0EA1A816
data.set 0xA011BC60 %long   0xF0EF3AC5
data.set 0xA011BC64 %long   0x9E6F8E05
data.set 0xA011BC68 %long   0x120F8C10
data.set 0xA011BC6C %long   0x0340D541
data.set 0xA011BC70 %long   0x7994CC3A
data.set 0xA011BC74 %long   0x44EA03D1
data.set 0xA011BC78 %long   0x773237E2
data.set 0xA011BC7C %long   0x9BD71930
data.set 0xA011BC80 %long   0x213C972D
data.set 0xA011BC84 %long   0xAF98A4DA
data.set 0xA011BC88 %long   0xF2E2E2FC
data.set 0xA011BC8C %long   0x533C7EDA
data.set 0xA011BC90 %long   0x2195AAE3
data.set 0xA011BC94 %long   0xF19B734B
data.set 0xA011BC98 %long   0x49B40152
data.set 0xA011BC9C %long   0xD1540C0F
data.set 0xA011BCA0 %long   0x6DB37991
data.set 0xA011BCA4 %long   0x03FB3864
data.set 0xA011BCA8 %long   0x8A674790
data.set 0xA011BCAC %long   0xF88715B5
data.set 0xA011BCB0 %long   0x7B9D2167
data.set 0xA011BCB4 %long   0x570789A1
data.set 0xA011BCB8 %long   0x5763C231
data.set 0xA011BCBC %long   0xC115CFEB
data.set 0xA011BCC0 %long   0xF51A9BFA
data.set 0xA011BCC4 %long   0x9591A621
data.set 0xA011BCC8 %long   0x4D8BDEF6
data.set 0xA011BCCC %long   0xE76734E9
data.set 0xA011BCD0 %long   0xDFB5CBAC
data.set 0xA011BCD4 %long   0x7E2746DA
data.set 0xA011BCD8 %long   0xFEB030B8
data.set 0xA011BCDC %long   0x94839B73
data.set 0xA011BCE0 %long   0x43B15851
data.set 0xA011BCE4 %long   0xBA222455
data.set 0xA011BCE8 %long   0xFDF050D1
data.set 0xA011BCEC %long   0xF32461A4
data.set 0xA011BCF0 %long   0x00B6E3D7
data.set 0xA011BCF4 %long   0x68DC247F
data.set 0xA011BCF8 %long   0x7DD44B92
data.set 0xA011BCFC %long   0xB5D9C2A7
data.set 0xA011BD00 %long   0x0C5C22A9
data.set 0xA011BD04 %long   0x9112EF5F
data.set 0xA011BD08 %long   0x7ACA958D
data.set 0xA011BD0C %long   0x47537606
data.set 0xA011BD10 %long   0x15B568A3
data.set 0xA011BD14 %long   0x1C5D89A5
data.set 0xA011BD18 %long   0x327DB436
data.set 0xA011BD1C %long   0x2DF77335
data.set 0xA011BD20 %long   0x401DB454
data.set 0xA011BD24 %long   0xCC853A0D
data.set 0xA011BD28 %long   0xBC145777
data.set 0xA011BD2C %long   0x206D65CC
data.set 0xA011BD30 %long   0xA8C53C4D
data.set 0xA011BD34 %long   0x4AA0130B
data.set 0xA011BD38 %long   0xBAB769E5
data.set 0xA011BD3C %long   0xE6EEC266
data.set 0xA011BD40 %long   0x276D5DFE
data.set 0xA011BD44 %long   0x93D29983
data.set 0xA011BD48 %long   0x8B05DEAA
data.set 0xA011BD4C %long   0x1D4B073E
data.set 0xA011BD50 %long   0x6AAA7707
data.set 0xA011BD54 %long   0xD377C42E
data.set 0xA011BD58 %long   0xD89774DB
data.set 0xA011BD5C %long   0xF2D20A53
data.set 0xA011BD60 %long   0x8FB8BFD5
data.set 0xA011BD64 %long   0xBA5062B8
data.set 0xA011BD68 %long   0xBE05E880
data.set 0xA011BD6C %long   0x9D2F0F6B
data.set 0xA011BD70 %long   0x0BDD6413
data.set 0xA011BD74 %long   0x0D15D985
data.set 0xA011BD78 %long   0x86C9DB9C
data.set 0xA011BD7C %long   0x11C53BCC
data.set 0xA011BD80 %long   0x7316981F
data.set 0xA011BD84 %long   0xAD875F9B
data.set 0xA011BD88 %long   0x202D20B0
data.set 0xA011BD8C %long   0x60EC8A9E
data.set 0xA011BD90 %long   0x8AF6AD04
data.set 0xA011BD94 %long   0x3354AD05
data.set 0xA011BD98 %long   0x67185821
data.set 0xA011BD9C %long   0x14114D8D
data.set 0xA011BDA0 %long   0x76C5FF2C
data.set 0xA011BDA4 %long   0xADE27297
data.set 0xA011BDA8 %long   0x59146E79
data.set 0xA011BDAC %long   0x0EA1F7E3
data.set 0xA011BDB0 %long   0xC72C1403
data.set 0xA011BDB4 %long   0xB7A407E3
data.set 0xA011BDB8 %long   0x94863888
data.set 0xA011BDBC %long   0x0B2B70B7
data.set 0xA011BDC0 %long   0x0FE65452
data.set 0xA011BDC4 %long   0xF12A04E5
data.set 0xA011BDC8 %long   0x19B00465
data.set 0xA011BDCC %long   0x52205AB5
data.set 0xA011BDD0 %long   0xFCA5FB69
data.set 0xA011BDD4 %long   0x81F3E317
data.set 0xA011BDD8 %long   0x6EF686F2
data.set 0xA011BDDC %long   0x24A702C0
data.set 0xA011BDE0 %long   0x02457FF4
data.set 0xA011BDE4 %long   0x460B8942
data.set 0xA011BDE8 %long   0xC48BB299
data.set 0xA011BDEC %long   0x9E585D59
data.set 0xA011BDF0 %long   0xB28E657C
data.set 0xA011BDF4 %long   0xFA1F28EB
data.set 0xA011BDF8 %long   0xDBEE3482
data.set 0xA011BDFC %long   0x323E0D51
data.set 0xA011BE00 %long   0x8B28C35D
data.set 0xA011BE04 %long   0xBD08C02A
data.set 0xA011BE08 %long   0xB02543CA
data.set 0xA011BE0C %long   0xD5D6DCB4
data.set 0xA011BE10 %long   0x795771A6
data.set 0xA011BE14 %long   0x57822704
data.set 0xA011BE18 %long   0x74E262CA
data.set 0xA011BE1C %long   0x772957F7
data.set 0xA011BE20 %long   0x4FC1DE27
data.set 0xA011BE24 %long   0xEE277466
data.set 0xA011BE28 %long   0xEE772D9B
data.set 0xA011BE2C %long   0x56DC347B
data.set 0xA011BE30 %long   0x0A747D76
data.set 0xA011BE34 %long   0x35D3B57E
data.set 0xA011BE38 %long   0xCE304502
data.set 0xA011BE3C %long   0xAC82D26D
data.set 0xA011BE40 %long   0x4FE5256D
data.set 0xA011BE44 %long   0x1A788056
data.set 0xA011BE48 %long   0x279C01BD
data.set 0xA011BE4C %long   0x62E4C43F
data.set 0xA011BE50 %long   0x11D43679
data.set 0xA011BE54 %long   0xAA081840
data.set 0xA011BE58 %long   0x4509AAEB
data.set 0xA011BE5C %long   0xC02BABAE
data.set 0xA011BE60 %long   0x6A3DFF50
data.set 0xA011BE64 %long   0x42B8830A
data.set 0xA011BE68 %long   0xA03055B4
data.set 0xA011BE6C %long   0x4E2ADDDE
data.set 0xA011BE70 %long   0xDF5A4887
data.set 0xA011BE74 %long   0x2EDCE4A9
data.set 0xA011BE78 %long   0x6D913057
data.set 0xA011BE7C %long   0x7B59C0AA
data.set 0xA011BE80 %long   0xFA6DF07A
data.set 0xA011BE84 %long   0xECFC4F58
data.set 0xA011BE88 %long   0x2347673A
data.set 0xA011BE8C %long   0x850F1827
data.set 0xA011BE90 %long   0x43074C41
data.set 0xA011BE94 %long   0x0786BD2D
data.set 0xA011BE98 %long   0xA06091B5
data.set 0xA011BE9C %long   0xF042E5C5
data.set 0xA011BEA0 %long   0x312F4EE6
data.set 0xA011BEA4 %long   0xD0ECB5F1
data.set 0xA011BEA8 %long   0x8E8B688D
data.set 0xA011BEAC %long   0xD6EAFCD2
data.set 0xA011BEB0 %long   0xA147D3F7
data.set 0xA011BEB4 %long   0x0A64F198
data.set 0xA011BEB8 %long   0x680CF05A
data.set 0xA011BEBC %long   0x35B38837
data.set 0xA011BEC0 %long   0x5AF488D2
data.set 0xA011BEC4 %long   0x03ABF0F9
data.set 0xA011BEC8 %long   0x5B998097
data.set 0xA011BECC %long   0x2869C5DC
data.set 0xA011BED0 %long   0x75845972
data.set 0xA011BED4 %long   0xF524A1EE
data.set 0xA011BED8 %long   0xC0E96EB3
data.set 0xA011BEDC %long   0x0CE741AB
data.set 0xA011BEE0 %long   0xE239D75C
data.set 0xA011BEE4 %long   0x155A80E1
data.set 0xA011BEE8 %long   0x748FE8E7
data.set 0xA011BEEC %long   0x36B0E950
data.set 0xA011BEF0 %long   0x3625150A
data.set 0xA011BEF4 %long   0xC92A6E2E
data.set 0xA011BEF8 %long   0x68381CF6
data.set 0xA011BEFC %long   0x8C50A25F
data.set 0xA011BF00 %long   0xE55EC037
data.set 0xA011BF04 %long   0xE80C8133
data.set 0xA011BF08 %long   0x3FA40D8C
data.set 0xA011BF0C %long   0x5EFD827E
data.set 0xA011BF10 %long   0x2E4BDB26
data.set 0xA011BF14 %long   0x2B671670
data.set 0xA011BF18 %long   0x2DAD4E0B
data.set 0xA011BF1C %long   0x4B72F22A
data.set 0xA011BF20 %long   0x12C777E4
data.set 0xA011BF24 %long   0x8C90F837
data.set 0xA011BF28 %long   0x3507B0C7
data.set 0xA011BF2C %long   0x2BFF22DC
data.set 0xA011BF30 %long   0x6ED72F61
data.set 0xA011BF34 %long   0x6B0F9767
data.set 0xA011BF38 %long   0x15314E90
data.set 0xA011BF3C %long   0x8A5C12F7
data.set 0xA011BF40 %long   0x81424FA1
data.set 0xA011BF44 %long   0x91DDCBB7
data.set 0xA011BF48 %long   0xA4CF91B4
data.set 0xA011BF4C %long   0x4F056BE2
data.set 0xA011BF50 %long   0x636DCC77
data.set 0xA011BF54 %long   0x46BAA156
data.set 0xA011BF58 %long   0xF4E7EF6A
data.set 0xA011BF5C %long   0x41BD304D
data.set 0xA011BF60 %long   0x545C8F84
data.set 0xA011BF64 %long   0x19CD1E9A
data.set 0xA011BF68 %long   0x3880B236
data.set 0xA011BF6C %long   0xBE3CF908
data.set 0xA011BF70 %long   0xE53A99C5
data.set 0xA011BF74 %long   0x1F3E4AF9
data.set 0xA011BF78 %long   0xD01E1009
data.set 0xA011BF7C %long   0x8CDA0AC1
data.set 0xA011BF80 %long   0x60335565
data.set 0xA011BF84 %long   0x2878C7B2
data.set 0xA011BF88 %long   0x34FCB902
data.set 0xA011BF8C %long   0xA13969BD
data.set 0xA011BF90 %long   0x6C5EFC6B
data.set 0xA011BF94 %long   0xDAD58922
data.set 0xA011BF98 %long   0xE6348085
data.set 0xA011BF9C %long   0x483168F6
data.set 0xA011BFA0 %long   0xBCC52272
data.set 0xA011BFA4 %long   0x5542CFC4
data.set 0xA011BFA8 %long   0x0579069E
data.set 0xA011BFAC %long   0x36A1C807
data.set 0xA011BFB0 %long   0xBEFF1C84
data.set 0xA011BFB4 %long   0xEA743C36
data.set 0xA011BFB8 %long   0x5D227C02
data.set 0xA011BFBC %long   0xF3833EF1
data.set 0xA011BFC0 %long   0x7E71DBA5
data.set 0xA011BFC4 %long   0xA550C4F9
data.set 0xA011BFC8 %long   0xA8602926
data.set 0xA011BFCC %long   0x7BB20914
data.set 0xA011BFD0 %long   0x5C088441
data.set 0xA011BFD4 %long   0x35A3420E
data.set 0xA011BFD8 %long   0x30BB3D4E
data.set 0xA011BFDC %long   0x9D9892A1
data.set 0xA011BFE0 %long   0x08A474A1
data.set 0xA011BFE4 %long   0x75733026
data.set 0xA011BFE8 %long   0x4BA00D26
data.set 0xA011BFEC %long   0x9DD19AB2
data.set 0xA011BFF0 %long   0x242E3762
data.set 0xA011BFF4 %long   0xE6ECD953
data.set 0xA011BFF8 %long   0x017B56FE
data.set 0xA011BFFC %long   0x133EC59A
data.set 0xA011C000 %long   0xA5119BE1
data.set 0xA011C004 %long   0x307DF3B2
data.set 0xA011C008 %long   0x22E74318
data.set 0xA011C00C %long   0x9D9D9575
data.set 0xA011C010 %long   0x094D30DD
data.set 0xA011C014 %long   0x1F4750F2
data.set 0xA011C018 %long   0xB26CC352
data.set 0xA011C01C %long   0xC6A59590
data.set 0xA011C020 %long   0x0E992BDA
data.set 0xA011C024 %long   0xF805D627
data.set 0xA011C028 %long   0x401FB835
data.set 0xA011C02C %long   0xC3528307
data.set 0xA011C030 %long   0x8C988250
data.set 0xA011C034 %long   0x78D834B8
data.set 0xA011C038 %long   0x58A7AE63
data.set 0xA011C03C %long   0x5337DA56
data.set 0xA011C040 %long   0x207B80C3
data.set 0xA011C044 %long   0x1AC6B7DA
data.set 0xA011C048 %long   0x5D981BCB
data.set 0xA011C04C %long   0x3F9C29B1
data.set 0xA011C050 %long   0xCBDE92EA
data.set 0xA011C054 %long   0x1E0E54C1
data.set 0xA011C058 %long   0x98C883E4
data.set 0xA011C05C %long   0xDF62F371
data.set 0xA011C060 %long   0x8B7A3A56
data.set 0xA011C064 %long   0x5EFAD6E6
data.set 0xA011C068 %long   0xB4895759
data.set 0xA011C06C %long   0xC74DF71C
data.set 0xA011C070 %long   0x0B4E4AB5
data.set 0xA011C074 %long   0x268DDB7D
data.set 0xA011C078 %long   0x3CC21817
data.set 0xA011C07C %long   0x18096BBC
data.set 0xA011C080 %long   0xE8BB67DE
data.set 0xA011C084 %long   0x0475B41B
data.set 0xA011C088 %long   0x68BF0285
data.set 0xA011C08C %long   0x6FEB4BE2
data.set 0xA011C090 %long   0xE43A14B5
data.set 0xA011C094 %long   0xB0A1BA03
data.set 0xA011C098 %long   0xEB3B6C3C
data.set 0xA011C09C %long   0x69EB68D3
data.set 0xA011C0A0 %long   0x2FD407B6
data.set 0xA011C0A4 %long   0x3C3C2A56
data.set 0xA011C0A8 %long   0x30B1FBA1
data.set 0xA011C0AC %long   0x2A76FB6C
data.set 0xA011C0B0 %long   0xD330FB80
data.set 0xA011C0B4 %long   0x119B960B
data.set 0xA011C0B8 %long   0xDC26A03E
data.set 0xA011C0BC %long   0x8FB44E36
data.set 0xA011C0C0 %long   0x859C51CA
data.set 0xA011C0C4 %long   0x13EACAC2
data.set 0xA011C0C8 %long   0xEEC05920
data.set 0xA011C0CC %long   0x7D496C1C
data.set 0xA011C0D0 %long   0x2CEB80AD
data.set 0xA011C0D4 %long   0x7431321C
data.set 0xA011C0D8 %long   0x98AFD288
data.set 0xA011C0DC %long   0x3C7E6ED1
data.set 0xA011C0E0 %long   0x32EEAD9E
data.set 0xA011C0E4 %long   0xDFA5AE77
data.set 0xA011C0E8 %long   0xE222FC02
data.set 0xA011C0EC %long   0x07C1B38C
data.set 0xA011C0F0 %long   0xBB0DEEDB
data.set 0xA011C0F4 %long   0xED8C24DE
data.set 0xA011C0F8 %long   0xA79FBB4E
data.set 0xA011C0FC %long   0x5A5F3F55
data.set 0xA011C100 %long   0x3E40B07A
data.set 0xA011C104 %long   0x0C866BA6
data.set 0xA011C108 %long   0x0AEC352D
data.set 0xA011C10C %long   0xDA0E5752
data.set 0xA011C110 %long   0x9DC4BD1F
data.set 0xA011C114 %long   0xD729D020
data.set 0xA011C118 %long   0xD417C172
data.set 0xA011C11C %long   0xB31EFE35
data.set 0xA011C120 %long   0x27155BDB
data.set 0xA011C124 %long   0xAC2924C7
data.set 0xA011C128 %long   0xDCF3ACC5
data.set 0xA011C12C %long   0x29C00E3A
data.set 0xA011C130 %long   0x2469F41B
data.set 0xA011C134 %long   0x25884C4D
data.set 0xA011C138 %long   0xBD040CAF
data.set 0xA011C13C %long   0x41845FB6
data.set 0xA011C140 %long   0x9E804507
data.set 0xA011C144 %long   0xABDD7C1D
data.set 0xA011C148 %long   0xB584471C
data.set 0xA011C14C %long   0x1C39D10C
data.set 0xA011C150 %long   0x00E22B45
data.set 0xA011C154 %long   0xF31D8D82
data.set 0xA011C158 %long   0x8B3EB883
data.set 0xA011C15C %long   0x0C821285
data.set 0xA011C160 %long   0x3B59C51A
data.set 0xA011C164 %long   0xFD186883
data.set 0xA011C168 %long   0xF96D9967
data.set 0xA011C16C %long   0xF6093A9B
data.set 0xA011C170 %long   0xB2B109C3
data.set 0xA011C174 %long   0xDC411FDC
data.set 0xA011C178 %long   0x253C2013
data.set 0xA011C17C %long   0xD196583F
data.set 0xA011C180 %long   0xA8119C00
data.set 0xA011C184 %long   0xC1EB97E9
data.set 0xA011C188 %long   0x096159A0
data.set 0xA011C18C %long   0xAEBD5BA3
data.set 0xA011C190 %long   0x288C1D63
data.set 0xA011C194 %long   0x87099322
data.set 0xA011C198 %long   0x7E805835
data.set 0xA011C19C %long   0x6265FA51
data.set 0xA011C1A0 %long   0x4DDB463B
data.set 0xA011C1A4 %long   0xC6957B29
data.set 0xA011C1A8 %long   0xEC9017AF
data.set 0xA011C1AC %long   0xECC7D71D
data.set 0xA011C1B0 %long   0x8CF3D123
data.set 0xA011C1B4 %long   0x401A90AE
data.set 0xA011C1B8 %long   0x195F6BDB
data.set 0xA011C1BC %long   0x198AEA4B
data.set 0xA011C1C0 %long   0x2FAFDCA7
data.set 0xA011C1C4 %long   0x0E1BB578
data.set 0xA011C1C8 %long   0xE078C158
data.set 0xA011C1CC %long   0xAC84CEEE
data.set 0xA011C1D0 %long   0x491A93C2
data.set 0xA011C1D4 %long   0x7A4284C6
data.set 0xA011C1D8 %long   0x1BE47195
data.set 0xA011C1DC %long   0xAFB749C5
data.set 0xA011C1E0 %long   0x9FCF06D8
data.set 0xA011C1E4 %long   0x2E20D63D
data.set 0xA011C1E8 %long   0xD7FA5D3B
data.set 0xA011C1EC %long   0xBE2453B0
data.set 0xA011C1F0 %long   0xDB21B352
data.set 0xA011C1F4 %long   0xD8A69983
data.set 0xA011C1F8 %long   0xA32CB681
data.set 0xA011C1FC %long   0xEA3D56E2
data.set 0xA011C200 %long   0x090E10D7
data.set 0xA011C204 %long   0x8ED7BC40
data.set 0xA011C208 %long   0x4ED75D0E
data.set 0xA011C20C %long   0xF8F6FFE7
data.set 0xA011C210 %long   0x76ED5ED7
data.set 0xA011C214 %long   0x52A6DB90
data.set 0xA011C218 %long   0x6E578DF2
data.set 0xA011C21C %long   0x666FB917
data.set 0xA011C220 %long   0x7571AC5C
data.set 0xA011C224 %long   0xA70D85B2
data.set 0xA011C228 %long   0xA7A5C4EA
data.set 0xA011C22C %long   0x856584CC
data.set 0xA011C230 %long   0x8786BFAA
data.set 0xA011C234 %long   0xA59FEE99
data.set 0xA011C238 %long   0x6F14715B
data.set 0xA011C23C %long   0xF38E97B8
data.set 0xA011C240 %long   0x65CCAD74
data.set 0xA011C244 %long   0xBA4A97F6
data.set 0xA011C248 %long   0x483AF319
data.set 0xA011C24C %long   0xF320839E
data.set 0xA011C250 %long   0xFE06AA38
data.set 0xA011C254 %long   0xE7EBDDE7
data.set 0xA011C258 %long   0xF7FC73CC
data.set 0xA011C25C %long   0x2ED24EFC
data.set 0xA011C260 %long   0x66136F47
data.set 0xA011C264 %long   0x3172B303
data.set 0xA011C268 %long   0x2613F60D
data.set 0xA011C26C %long   0x05106F60
data.set 0xA011C270 %long   0x97A91923
data.set 0xA011C274 %long   0x6699DD08
data.set 0xA011C278 %long   0x9EF54BDA
data.set 0xA011C27C %long   0xB24EE26B
data.set 0xA011C280 %long   0xB00CFE34
data.set 0xA011C284 %long   0xA4296E2F
data.set 0xA011C288 %long   0xAAE2B339
data.set 0xA011C28C %long   0x38427BD7
data.set 0xA011C290 %long   0x5097CBDB
data.set 0xA011C294 %long   0x6B43ED81
data.set 0xA011C298 %long   0x51E909AC
data.set 0xA011C29C %long   0x09216D93
data.set 0xA011C2A0 %long   0x865492AD
data.set 0xA011C2A4 %long   0x1C8CE235
data.set 0xA011C2A8 %long   0xCC0D8AD2
data.set 0xA011C2AC %long   0x34CC42CC
data.set 0xA011C2B0 %long   0xDA526FEA
data.set 0xA011C2B4 %long   0xE0B4C14C
data.set 0xA011C2B8 %long   0x47C8AE87
data.set 0xA011C2BC %long   0x54F3DAAC
data.set 0xA011C2C0 %long   0x1473E2C7
data.set 0xA011C2C4 %long   0x936AEE2E
data.set 0xA011C2C8 %long   0x034CA0BB
data.set 0xA011C2CC %long   0x315ABD40
data.set 0xA011C2D0 %long   0xDB735FBC
data.set 0xA011C2D4 %long   0x6A52DC45
data.set 0xA011C2D8 %long   0x9DB163F7
data.set 0xA011C2DC %long   0x87194E79
data.set 0xA011C2E0 %long   0x62041E40
data.set 0xA011C2E4 %long   0x9E28F621
data.set 0xA011C2E8 %long   0x32E5BAF4
data.set 0xA011C2EC %long   0x231D132F
data.set 0xA011C2F0 %long   0xA18D0C44
data.set 0xA011C2F4 %long   0xE4A3B435
data.set 0xA011C2F8 %long   0xDD6607FA
data.set 0xA011C2FC %long   0x4E649DA1
data.set 0xA011C300 %long   0xFEAB5E16
data.set 0xA011C304 %long   0xE4D77B18
data.set 0xA011C308 %long   0xDD435188
data.set 0xA011C30C %long   0x5348FAE5
data.set 0xA011C310 %long   0xB2C82A13
data.set 0xA011C314 %long   0xE541CB9D
data.set 0xA011C318 %long   0x32155C88
data.set 0xA011C31C %long   0x76208CD0
data.set 0xA011C320 %long   0x72E5A49A
data.set 0xA011C324 %long   0x2293817C
data.set 0xA011C328 %long   0x10D214C5
data.set 0xA011C32C %long   0x5D88C397
data.set 0xA011C330 %long   0x71DAD7DB
data.set 0xA011C334 %long   0xF2AFFF1B
data.set 0xA011C338 %long   0xD57B8593
data.set 0xA011C33C %long   0x6B5FC057
data.set 0xA011C340 %long   0x7EA12A48
data.set 0xA011C344 %long   0x407FCCE1
data.set 0xA011C348 %long   0xEBA2016C
data.set 0xA011C34C %long   0x59102EF1
data.set 0xA011C350 %long   0x170C0A16
data.set 0xA011C354 %long   0xC116CEAC
data.set 0xA011C358 %long   0xEF89922D
data.set 0xA011C35C %long   0x353853D3
data.set 0xA011C360 %long   0x7D63DFB4
data.set 0xA011C364 %long   0xC08315FB
data.set 0xA011C368 %long   0x1D753E86
data.set 0xA011C36C %long   0xF15C9BA5
data.set 0xA011C370 %long   0xC05AD8E1
data.set 0xA011C374 %long   0x88F55535
data.set 0xA011C378 %long   0xAEDCC046
data.set 0xA011C37C %long   0x65F3C933
data.set 0xA011C380 %long   0x465999D2
data.set 0xA011C384 %long   0xC27D2592
data.set 0xA011C388 %long   0x8E09FDF5
data.set 0xA011C38C %long   0x76CF5B17
data.set 0xA011C390 %long   0x71D60130
data.set 0xA011C394 %long   0x110F9E69
data.set 0xA011C398 %long   0x3D6EC8AD
data.set 0xA011C39C %long   0xEE9F27E8
data.set 0xA011C3A0 %long   0x789DFBA2
data.set 0xA011C3A4 %long   0x49960A93
data.set 0xA011C3A8 %long   0x28F9563C
data.set 0xA011C3AC %long   0xF38B11FB
data.set 0xA011C3B0 %long   0xC6724232
data.set 0xA011C3B4 %long   0xFA869C65
data.set 0xA011C3B8 %long   0xFB0E4789
data.set 0xA011C3BC %long   0x07482A81
data.set 0xA011C3C0 %long   0x550A8546
data.set 0xA011C3C4 %long   0xBF08413E
data.set 0xA011C3C8 %long   0x9E4010E9
data.set 0xA011C3CC %long   0xAAE67E63
data.set 0xA011C3D0 %long   0x034FB078
data.set 0xA011C3D4 %long   0xCECC4EDD
data.set 0xA011C3D8 %long   0xDC3FF61C
data.set 0xA011C3DC %long   0xE6C917D7
data.set 0xA011C3E0 %long   0xD5966F84
data.set 0xA011C3E4 %long   0xF2ABE49B
data.set 0xA011C3E8 %long   0xEBC0F03A
data.set 0xA011C3EC %long   0xFCC0DAE2
data.set 0xA011C3F0 %long   0x7550FA6D
data.set 0xA011C3F4 %long   0x95B2054C
data.set 0xA011C3F8 %long   0xB45FB52E
data.set 0xA011C3FC %long   0x51BA97E4
data.set 0xA011C400 %long   0x5CD8B063
data.set 0xA011C404 %long   0x419E7E43
data.set 0xA011C408 %long   0xF51837DF
data.set 0xA011C40C %long   0xA12FD2C8
data.set 0xA011C410 %long   0x7FCE316A
data.set 0xA011C414 %long   0x770D8174
data.set 0xA011C418 %long   0x4B88E284
data.set 0xA011C41C %long   0x13EDCAEF
data.set 0xA011C420 %long   0x82E815FB
data.set 0xA011C424 %long   0xEE08824F
data.set 0xA011C428 %long   0xADDDDA40
data.set 0xA011C42C %long   0x38C6C520
data.set 0xA011C430 %long   0x64AFA014
data.set 0xA011C434 %long   0x3D4C1023
data.set 0xA011C438 %long   0x3A5D1EEB
data.set 0xA011C43C %long   0x0BF61441
data.set 0xA011C440 %long   0xB84D2B84
data.set 0xA011C444 %long   0xE16C8309
data.set 0xA011C448 %long   0xBCDDBC67
data.set 0xA011C44C %long   0x8B611A81
data.set 0xA011C450 %long   0x56626AB3
data.set 0xA011C454 %long   0x0E11CCEA
data.set 0xA011C458 %long   0x31D7F144
data.set 0xA011C45C %long   0x8840DFB5
data.set 0xA011C460 %long   0xD494DF51
data.set 0xA011C464 %long   0xE87FF0C7
data.set 0xA011C468 %long   0xAF02401F
data.set 0xA011C46C %long   0xE8EDF580
data.set 0xA011C470 %long   0xEBFEAF5D
data.set 0xA011C474 %long   0x7577048F
data.set 0xA011C478 %long   0xD1A57F43
data.set 0xA011C47C %long   0xDEA5455D
data.set 0xA011C480 %long   0x037B064C
data.set 0xA011C484 %long   0x655CCA9B
data.set 0xA011C488 %long   0x544699DB
data.set 0xA011C48C %long   0x4A0C9CBF
data.set 0xA011C490 %long   0x7F62031C
data.set 0xA011C494 %long   0xC00A5939
data.set 0xA011C498 %long   0x89497FCD
data.set 0xA011C49C %long   0xB69BA86E
data.set 0xA011C4A0 %long   0x2DDFCEE4
data.set 0xA011C4A4 %long   0xD76A4CA7
data.set 0xA011C4A8 %long   0x7800F14E
data.set 0xA011C4AC %long   0xF79CBF0B
data.set 0xA011C4B0 %long   0xC6EFC52D
data.set 0xA011C4B4 %long   0xD06143C0
data.set 0xA011C4B8 %long   0xEF903F8C
data.set 0xA011C4BC %long   0x580021FD
data.set 0xA011C4C0 %long   0x6D9BF938
data.set 0xA011C4C4 %long   0x8DF76D59
data.set 0xA011C4C8 %long   0x2ABAB908
data.set 0xA011C4CC %long   0x9FD81A08
data.set 0xA011C4D0 %long   0xB6B6E439
data.set 0xA011C4D4 %long   0x65C1C6CE
data.set 0xA011C4D8 %long   0x567131F2
data.set 0xA011C4DC %long   0xC2457399
data.set 0xA011C4E0 %long   0xE75A0C5D
data.set 0xA011C4E4 %long   0xB66A7FC1
data.set 0xA011C4E8 %long   0xCF2C9241
data.set 0xA011C4EC %long   0xB4B0EFA3
data.set 0xA011C4F0 %long   0x825F64E3
data.set 0xA011C4F4 %long   0xA6901F79
data.set 0xA011C4F8 %long   0xAA00FA48
data.set 0xA011C4FC %long   0x00B9C789
data.set 0xA011C500 %long   0x073AD865
data.set 0xA011C504 %long   0x1D55FE47
data.set 0xA011C508 %long   0x08ED9DD9
data.set 0xA011C50C %long   0x3BFAEEC6
data.set 0xA011C510 %long   0x4D23BD6C
data.set 0xA011C514 %long   0x8D3946C3
data.set 0xA011C518 %long   0xC470ED49
data.set 0xA011C51C %long   0x1E0847F0
data.set 0xA011C520 %long   0x7774549F
data.set 0xA011C524 %long   0x6BC9FF2A
data.set 0xA011C528 %long   0x3C947CA9
data.set 0xA011C52C %long   0x609F9D51
data.set 0xA011C530 %long   0x12C1B0D9
data.set 0xA011C534 %long   0x94CC4703
data.set 0xA011C538 %long   0xC08FAF87
data.set 0xA011C53C %long   0xF65D5069
data.set 0xA011C540 %long   0x5DE11F07
data.set 0xA011C544 %long   0x532C7C0F
data.set 0xA011C548 %long   0x580DBFBF
data.set 0xA011C54C %long   0x38FE9716
data.set 0xA011C550 %long   0x4EE8C360
data.set 0xA011C554 %long   0xC19F7E2E
data.set 0xA011C558 %long   0xC6EEFEA2
data.set 0xA011C55C %long   0x9F8C96FB
data.set 0xA011C560 %long   0x4D79BD94
data.set 0xA011C564 %long   0xCB34922C
data.set 0xA011C568 %long   0x35CBE133
data.set 0xA011C56C %long   0x68E78BC9
data.set 0xA011C570 %long   0x56BD34F4
data.set 0xA011C574 %long   0xD695DC84
data.set 0xA011C578 %long   0x51C18C89
data.set 0xA011C57C %long   0x73C44A7C
data.set 0xA011C580 %long   0x3D154802
data.set 0xA011C584 %long   0x2D3776C7
data.set 0xA011C588 %long   0xDEC837E2
data.set 0xA011C58C %long   0x950A3C63
data.set 0xA011C590 %long   0xE7D684BE
data.set 0xA011C594 %long   0x3DAEA938
data.set 0xA011C598 %long   0x730BEE5C
data.set 0xA011C59C %long   0x87B59615
data.set 0xA011C5A0 %long   0x3554F4F3
data.set 0xA011C5A4 %long   0xE5D5902D
data.set 0xA011C5A8 %long   0x58B4873B
data.set 0xA011C5AC %long   0x76E095D5
data.set 0xA011C5B0 %long   0x3F4570B9
data.set 0xA011C5B4 %long   0xAA1479E0
data.set 0xA011C5B8 %long   0x336376D2
data.set 0xA011C5BC %long   0x687C6316
data.set 0xA011C5C0 %long   0x531F9F9D
data.set 0xA011C5C4 %long   0xCFE0A5AC
data.set 0xA011C5C8 %long   0x0348E1D6
data.set 0xA011C5CC %long   0x33A00D55
data.set 0xA011C5D0 %long   0x1638540A
data.set 0xA011C5D4 %long   0xE3F55015
data.set 0xA011C5D8 %long   0x42523B47
data.set 0xA011C5DC %long   0xBA540CB9
data.set 0xA011C5E0 %long   0x767420E8
data.set 0xA011C5E4 %long   0x5DCC276B
data.set 0xA011C5E8 %long   0xEAD5B7D4
data.set 0xA011C5EC %long   0x6690537C
data.set 0xA011C5F0 %long   0x95416F26
data.set 0xA011C5F4 %long   0xCDB99F1D
data.set 0xA011C5F8 %long   0x88ED67BC
data.set 0xA011C5FC %long   0xC7BB63A9
data.set 0xA011C600 %long   0x7F2C2E08
data.set 0xA011C604 %long   0xFAF8EB91
data.set 0xA011C608 %long   0xEE1CD045
data.set 0xA011C60C %long   0xD27BE256
data.set 0xA011C610 %long   0x13E319F8
data.set 0xA011C614 %long   0x668EE7CE
data.set 0xA011C618 %long   0x035B5620
data.set 0xA011C61C %long   0x2D672EC8
data.set 0xA011C620 %long   0xF0D8FBB9
data.set 0xA011C624 %long   0x232C9DBE
data.set 0xA011C628 %long   0xCE381B7B
data.set 0xA011C62C %long   0xC2D5A183
data.set 0xA011C630 %long   0x55C16A26
data.set 0xA011C634 %long   0x8B9B6A92
data.set 0xA011C638 %long   0xBBA0A66A
data.set 0xA011C63C %long   0x838CE5F6
data.set 0xA011C640 %long   0x5AE6EDCF
data.set 0xA011C644 %long   0x08A0C080
data.set 0xA011C648 %long   0x84058953
data.set 0xA011C64C %long   0x16027CE1
data.set 0xA011C650 %long   0x1792151B
data.set 0xA011C654 %long   0xD9AB4D6D
data.set 0xA011C658 %long   0x1A830BEF
data.set 0xA011C65C %long   0x6FC826BB
data.set 0xA011C660 %long   0x3FFB3865
data.set 0xA011C664 %long   0xC4161C93
data.set 0xA011C668 %long   0xC2CDFFF1
data.set 0xA011C66C %long   0x49FEE0CA
data.set 0xA011C670 %long   0x8FDF2A91
data.set 0xA011C674 %long   0xFD28818C
data.set 0xA011C678 %long   0x0E208F08
data.set 0xA011C67C %long   0x7906FD91
data.set 0xA011C680 %long   0x3A607CE2
data.set 0xA011C684 %long   0x91CADD76
data.set 0xA011C688 %long   0x2FF6F777
data.set 0xA011C68C %long   0x63B4BC70
data.set 0xA011C690 %long   0x32C25731
data.set 0xA011C694 %long   0x2D3DE0D7
data.set 0xA011C698 %long   0xE3518E78
data.set 0xA011C69C %long   0xD5B9A351
data.set 0xA011C6A0 %long   0x573B05B5
data.set 0xA011C6A4 %long   0x420CFCA3
data.set 0xA011C6A8 %long   0x47AD6F5C
data.set 0xA011C6AC %long   0x388B3BA7
data.set 0xA011C6B0 %long   0xD8ED2509
data.set 0xA011C6B4 %long   0x74A9E1E6
data.set 0xA011C6B8 %long   0x78963536
data.set 0xA011C6BC %long   0xCB4F079A
data.set 0xA011C6C0 %long   0xEFE6AA70
data.set 0xA011C6C4 %long   0x0EA33A03
data.set 0xA011C6C8 %long   0xD454B292
data.set 0xA011C6CC %long   0x03C8A260
data.set 0xA011C6D0 %long   0xA4260EF4
data.set 0xA011C6D4 %long   0x17DD48BB
data.set 0xA011C6D8 %long   0xBA8FBB46
data.set 0xA011C6DC %long   0xB7904532
data.set 0xA011C6E0 %long   0x487F67BE
data.set 0xA011C6E4 %long   0xD0330726
data.set 0xA011C6E8 %long   0xDC5BEC52
data.set 0xA011C6EC %long   0x3997E387
data.set 0xA011C6F0 %long   0x07C37BF7
data.set 0xA011C6F4 %long   0x90C0BF16
data.set 0xA011C6F8 %long   0xED3C5525
data.set 0xA011C6FC %long   0xAC163E47
data.set 0xA011C700 %long   0x5AA6B1FD
data.set 0xA011C704 %long   0x99BACA4B
data.set 0xA011C708 %long   0x1ECDFC6D
data.set 0xA011C70C %long   0xC8FB4923
data.set 0xA011C710 %long   0xFD79CDDB
data.set 0xA011C714 %long   0x94812EFA
data.set 0xA011C718 %long   0x904B6441
data.set 0xA011C71C %long   0x8334375A
data.set 0xA011C720 %long   0x9B8F1FBF
data.set 0xA011C724 %long   0x69BDA3B1
data.set 0xA011C728 %long   0x2AE1389C
data.set 0xA011C72C %long   0x6CAD6A1D
data.set 0xA011C730 %long   0x4DA62F5B
data.set 0xA011C734 %long   0xDC2DE64E
data.set 0xA011C738 %long   0x2C80C0F7
data.set 0xA011C73C %long   0xDA74CF2E
data.set 0xA011C740 %long   0x99D02C9C
data.set 0xA011C744 %long   0xD24DA3EF
data.set 0xA011C748 %long   0xB4DB3983
data.set 0xA011C74C %long   0xFFFD57EF
data.set 0xA011C750 %long   0x29C09BFA
data.set 0xA011C754 %long   0x7AE2D9F6
data.set 0xA011C758 %long   0xD0D158E6
data.set 0xA011C75C %long   0x4A02D8CC
data.set 0xA011C760 %long   0x5291F3F5
data.set 0xA011C764 %long   0xA3178547
data.set 0xA011C768 %long   0x761474D6
data.set 0xA011C76C %long   0xEBF8E309
data.set 0xA011C770 %long   0xA7F91CFA
data.set 0xA011C774 %long   0x22A3DB65
data.set 0xA011C778 %long   0x098D99A8
data.set 0xA011C77C %long   0x3E969C73
data.set 0xA011C780 %long   0x09F46A87
data.set 0xA011C784 %long   0x22A98E9D
data.set 0xA011C788 %long   0x2C9ABE49
data.set 0xA011C78C %long   0x32C10AF8
data.set 0xA011C790 %long   0x0819EEE2
data.set 0xA011C794 %long   0xA395F23A
data.set 0xA011C798 %long   0x83FBFB70
data.set 0xA011C79C %long   0x3389445A
data.set 0xA011C7A0 %long   0xD8C447AA
data.set 0xA011C7A4 %long   0x4D29E4C5
data.set 0xA011C7A8 %long   0x13ED5318
data.set 0xA011C7AC %long   0x37FE8ADD
data.set 0xA011C7B0 %long   0x137D9B55
data.set 0xA011C7B4 %long   0x4AFDCCF3
data.set 0xA011C7B8 %long   0x6FAED2AC
data.set 0xA011C7BC %long   0x82B2CF9C
data.set 0xA011C7C0 %long   0x4529B095
data.set 0xA011C7C4 %long   0x198915AE
data.set 0xA011C7C8 %long   0xC0FF8431
data.set 0xA011C7CC %long   0x726D0DFD
data.set 0xA011C7D0 %long   0xE73EA542
data.set 0xA011C7D4 %long   0x1EA2B9FE
data.set 0xA011C7D8 %long   0x7F2D8BEB
data.set 0xA011C7DC %long   0x14F4036F
data.set 0xA011C7E0 %long   0x90DCC1CF
data.set 0xA011C7E4 %long   0x13731349
data.set 0xA011C7E8 %long   0xEF5F31E5
data.set 0xA011C7EC %long   0xC664FBC4
data.set 0xA011C7F0 %long   0x270D3A6B
data.set 0xA011C7F4 %long   0x514FE7D7
data.set 0xA011C7F8 %long   0xE031718D
data.set 0xA011C7FC %long   0x2627683A
data.set 0xA011C800 %long   0x4AE0E289
data.set 0xA011C804 %long   0x4F8C6957
data.set 0xA011C808 %long   0xC67EB879
data.set 0xA011C80C %long   0x2E1A957D
data.set 0xA011C810 %long   0x9C4EFDC5
data.set 0xA011C814 %long   0x43312870
data.set 0xA011C818 %long   0x6D4357A9
data.set 0xA011C81C %long   0x9898E180
data.set 0xA011C820 %long   0x04AC75F9
data.set 0xA011C824 %long   0x661E3853
data.set 0xA011C828 %long   0x30193E34
data.set 0xA011C82C %long   0x7D39F6F6
data.set 0xA011C830 %long   0xBBB15F28
data.set 0xA011C834 %long   0xA257CDDF
data.set 0xA011C838 %long   0xB46731B5
data.set 0xA011C83C %long   0xB6AB44E3
data.set 0xA011C840 %long   0xA002F0A8
data.set 0xA011C844 %long   0x461C61A9
data.set 0xA011C848 %long   0x85706ACB
data.set 0xA011C84C %long   0x8A16DFA0
data.set 0xA011C850 %long   0x21A4305C
data.set 0xA011C854 %long   0xEA465DA0
data.set 0xA011C858 %long   0xAC200183
data.set 0xA011C85C %long   0x7BA53BB7
data.set 0xA011C860 %long   0x35DF1F1E
data.set 0xA011C864 %long   0x33DE42FD
data.set 0xA011C868 %long   0x2651B87D
data.set 0xA011C86C %long   0xBD7CEDD9
data.set 0xA011C870 %long   0x532BD974
data.set 0xA011C874 %long   0xE870E68A
data.set 0xA011C878 %long   0x436023CA
data.set 0xA011C87C %long   0xEA882B6E
data.set 0xA011C880 %long   0xEB8C31D1
data.set 0xA011C884 %long   0x4EB7E610
data.set 0xA011C888 %long   0x50C0324F
data.set 0xA011C88C %long   0x8F6A62BC
data.set 0xA011C890 %long   0x612045FC
data.set 0xA011C894 %long   0x6C00570E
data.set 0xA011C898 %long   0xFA76E8AC
data.set 0xA011C89C %long   0x7C82C7C7
data.set 0xA011C8A0 %long   0x4AFCFAEC
data.set 0xA011C8A4 %long   0x95D9F500
data.set 0xA011C8A8 %long   0x93A993B3
data.set 0xA011C8AC %long   0x2F2172AA
data.set 0xA011C8B0 %long   0xC6C7234D
data.set 0xA011C8B4 %long   0xEC4C3566
data.set 0xA011C8B8 %long   0x33D4340B
data.set 0xA011C8BC %long   0x94C268FE
data.set 0xA011C8C0 %long   0x5681971C
data.set 0xA011C8C4 %long   0x3B22D3E6
data.set 0xA011C8C8 %long   0xEDDC89A9
data.set 0xA011C8CC %long   0x11283734
data.set 0xA011C8D0 %long   0x9BCC0918
data.set 0xA011C8D4 %long   0xC65A132C
data.set 0xA011C8D8 %long   0x858494C5
data.set 0xA011C8DC %long   0xF8A8E37E
data.set 0xA011C8E0 %long   0x2E4C18C3
data.set 0xA011C8E4 %long   0x4651144C
data.set 0xA011C8E8 %long   0x674AD419
data.set 0xA011C8EC %long   0x52B09997
data.set 0xA011C8F0 %long   0x1355D44E
data.set 0xA011C8F4 %long   0x02EEB37D
data.set 0xA011C8F8 %long   0xF8BD424D
data.set 0xA011C8FC %long   0x5BFD6771
data.set 0xA011C900 %long   0x89A12918
data.set 0xA011C904 %long   0xC6937686
data.set 0xA011C908 %long   0xBA7CADCE
data.set 0xA011C90C %long   0x1A093608
data.set 0xA011C910 %long   0xDF1AA224
data.set 0xA011C914 %long   0xC19E8F62
data.set 0xA011C918 %long   0x54207A8F
data.set 0xA011C91C %long   0xFE3954C2
data.set 0xA011C920 %long   0x98CECC6A
data.set 0xA011C924 %long   0x2F22B501
data.set 0xA011C928 %long   0xCE6AE35F
data.set 0xA011C92C %long   0x5C79A1A2
data.set 0xA011C930 %long   0xF5E13E2D
data.set 0xA011C934 %long   0x18407AC0
data.set 0xA011C938 %long   0x58911161
data.set 0xA011C93C %long   0x2108184C
data.set 0xA011C940 %long   0xFD515538
data.set 0xA011C944 %long   0x9EB0105C
data.set 0xA011C948 %long   0x1D510F83
data.set 0xA011C94C %long   0x8C2023C8
data.set 0xA011C950 %long   0x8BA322EE
data.set 0xA011C954 %long   0xC05914D1
data.set 0xA011C958 %long   0x75F26123
data.set 0xA011C95C %long   0xDD168480
data.set 0xA011C960 %long   0x452B848B
data.set 0xA011C964 %long   0x65D10006
data.set 0xA011C968 %long   0x2C08E995
data.set 0xA011C96C %long   0xFE773702
data.set 0xA011C970 %long   0x01C7C9CA
data.set 0xA011C974 %long   0xA5C325F9
data.set 0xA011C978 %long   0x346E97D4
data.set 0xA011C97C %long   0xD94CE0FF
data.set 0xA011C980 %long   0x62D77C72
data.set 0xA011C984 %long   0x1674FB1D
data.set 0xA011C988 %long   0x3CE927B5
data.set 0xA011C98C %long   0xB3659B60
data.set 0xA011C990 %long   0x94B64FCD
data.set 0xA011C994 %long   0xB4914468
data.set 0xA011C998 %long   0x7C5BCE26
data.set 0xA011C99C %long   0x1401A6F9
data.set 0xA011C9A0 %long   0xA9FB5E7E
data.set 0xA011C9A4 %long   0x2963FFA9
data.set 0xA011C9A8 %long   0xC7EB0351
data.set 0xA011C9AC %long   0x1EA58368
data.set 0xA011C9B0 %long   0x3EEDEBFE
data.set 0xA011C9B4 %long   0x8CD2152B
data.set 0xA011C9B8 %long   0xEB545DDD
data.set 0xA011C9BC %long   0xB5D927AE
data.set 0xA011C9C0 %long   0x6272F71C
data.set 0xA011C9C4 %long   0xC42691D6
data.set 0xA011C9C8 %long   0x587C6B0D
data.set 0xA011C9CC %long   0x64329157
data.set 0xA011C9D0 %long   0xF484CD10
data.set 0xA011C9D4 %long   0xA3181B46
data.set 0xA011C9D8 %long   0x0D1AD050
data.set 0xA011C9DC %long   0x7B661AC2
data.set 0xA011C9E0 %long   0x078D0943
data.set 0xA011C9E4 %long   0xD1991156
data.set 0xA011C9E8 %long   0x7379D186
data.set 0xA011C9EC %long   0xB495BA76
data.set 0xA011C9F0 %long   0x2B8F1CF0
data.set 0xA011C9F4 %long   0x78E3C1CC
data.set 0xA011C9F8 %long   0xDBDB4FEF
data.set 0xA011C9FC %long   0x5975D950
data.set 0xA011CA00 %long   0x253143DC
data.set 0xA011CA04 %long   0xC71AFF5C
data.set 0xA011CA08 %long   0x37F2ADB5
data.set 0xA011CA0C %long   0x32881A08
data.set 0xA011CA10 %long   0x10F783C2
data.set 0xA011CA14 %long   0x46BBD77B
data.set 0xA011CA18 %long   0xA45E3035
data.set 0xA011CA1C %long   0x929290F4
data.set 0xA011CA20 %long   0x6395031B
data.set 0xA011CA24 %long   0xF20BA5D9
data.set 0xA011CA28 %long   0x56195B3D
data.set 0xA011CA2C %long   0xA6FD7BDB
data.set 0xA011CA30 %long   0x22FFF8CF
data.set 0xA011CA34 %long   0xDB69A3BD
data.set 0xA011CA38 %long   0x9769A37F
data.set 0xA011CA3C %long   0xDB82C803
data.set 0xA011CA40 %long   0xD0230E13
data.set 0xA011CA44 %long   0x6274F542
data.set 0xA011CA48 %long   0xBB5B60E8
data.set 0xA011CA4C %long   0xFFEBC386
data.set 0xA011CA50 %long   0x4718DEAA
data.set 0xA011CA54 %long   0xFFCD4C15
data.set 0xA011CA58 %long   0xD18F13FA
data.set 0xA011CA5C %long   0x0C7E4097
data.set 0xA011CA60 %long   0x8F30D6FE
data.set 0xA011CA64 %long   0x0380EC38
data.set 0xA011CA68 %long   0xD6C5D16B
data.set 0xA011CA6C %long   0xC7026325
data.set 0xA011CA70 %long   0xD8AF1BED
data.set 0xA011CA74 %long   0x24705E60
data.set 0xA011CA78 %long   0x49D90D05
data.set 0xA011CA7C %long   0x0BFFD45E
data.set 0xA011CA80 %long   0x095B7D3D
data.set 0xA011CA84 %long   0x5A08AECB
data.set 0xA011CA88 %long   0x0147F6F5
data.set 0xA011CA8C %long   0x747DB58F
data.set 0xA011CA90 %long   0xE110E2AB
data.set 0xA011CA94 %long   0xF8D7C0FD
data.set 0xA011CA98 %long   0x71555E4A
data.set 0xA011CA9C %long   0xB39B7F05
data.set 0xA011CAA0 %long   0x29BDCF5B
data.set 0xA011CAA4 %long   0xD42DEF6F
data.set 0xA011CAA8 %long   0xB3AABDCA
data.set 0xA011CAAC %long   0xCE2E7CE9
data.set 0xA011CAB0 %long   0x78FE9F00
data.set 0xA011CAB4 %long   0xF65E1B0A
data.set 0xA011CAB8 %long   0xD47C62C3
data.set 0xA011CABC %long   0xA90C41FF
data.set 0xA011CAC0 %long   0xA5E72678
data.set 0xA011CAC4 %long   0x0881279D
data.set 0xA011CAC8 %long   0x0E83DF91
data.set 0xA011CACC %long   0x743CA70D
data.set 0xA011CAD0 %long   0xD1FCB869
data.set 0xA011CAD4 %long   0x6FE84F4C
data.set 0xA011CAD8 %long   0xD287EE93
data.set 0xA011CADC %long   0xEA262DE4
data.set 0xA011CAE0 %long   0x2E8D7958
data.set 0xA011CAE4 %long   0x38315572
data.set 0xA011CAE8 %long   0x9175ACFD
data.set 0xA011CAEC %long   0xD28C8DAA
data.set 0xA011CAF0 %long   0x6A28B1AE
data.set 0xA011CAF4 %long   0xB6853771
data.set 0xA011CAF8 %long   0x00A15A3C
data.set 0xA011CAFC %long   0xC2B8AE26
data.set 0xA011CB00 %long   0xE330E723
data.set 0xA011CB04 %long   0x02AE1096
data.set 0xA011CB08 %long   0x3120452C
data.set 0xA011CB0C %long   0x846EFC6B
data.set 0xA011CB10 %long   0x0B98547C
data.set 0xA011CB14 %long   0x7B390785
data.set 0xA011CB18 %long   0x34A4B967
data.set 0xA011CB1C %long   0x9879DC45
data.set 0xA011CB20 %long   0x084BF634
data.set 0xA011CB24 %long   0xFCD2E5EF
data.set 0xA011CB28 %long   0x2535A46F
data.set 0xA011CB2C %long   0x42717165
data.set 0xA011CB30 %long   0x60662D2D
data.set 0xA011CB34 %long   0x5263AD64
data.set 0xA011CB38 %long   0x6A2C7787
data.set 0xA011CB3C %long   0xA978D3E1
data.set 0xA011CB40 %long   0x4B9CD6D3
data.set 0xA011CB44 %long   0x26C353BA
data.set 0xA011CB48 %long   0x2F171338
data.set 0xA011CB4C %long   0xFD53D6C4
data.set 0xA011CB50 %long   0x96B35A6F
data.set 0xA011CB54 %long   0xB12DDFC2
data.set 0xA011CB58 %long   0x2AF3DB06
data.set 0xA011CB5C %long   0x729D862E
data.set 0xA011CB60 %long   0x464938E8
data.set 0xA011CB64 %long   0x62A81BEC
data.set 0xA011CB68 %long   0x5C745CD8
data.set 0xA011CB6C %long   0xBEE0FD4E
data.set 0xA011CB70 %long   0x0B640152
data.set 0xA011CB74 %long   0xC81FE72A
data.set 0xA011CB78 %long   0x2ED4E53C
data.set 0xA011CB7C %long   0x06E3E879
data.set 0xA011CB80 %long   0x62DFEF09
data.set 0xA011CB84 %long   0x79E8E150
data.set 0xA011CB88 %long   0x7E45880A
data.set 0xA011CB8C %long   0x258AD6D4
data.set 0xA011CB90 %long   0xD11C696F
data.set 0xA011CB94 %long   0xCF4E355A
data.set 0xA011CB98 %long   0x970C0AC0
data.set 0xA011CB9C %long   0x51DF073A
data.set 0xA011CBA0 %long   0xC9B33DD3
data.set 0xA011CBA4 %long   0x5EEDC4ED
data.set 0xA011CBA8 %long   0x8ACBF68F
data.set 0xA011CBAC %long   0x056523D8
data.set 0xA011CBB0 %long   0xF5FC1F5A
data.set 0xA011CBB4 %long   0x6E4F96FE
data.set 0xA011CBB8 %long   0x06A2F020
data.set 0xA011CBBC %long   0x153D2F79
data.set 0xA011CBC0 %long   0x19AAA86F
data.set 0xA011CBC4 %long   0x219B4715
data.set 0xA011CBC8 %long   0x4EB7DA4C
data.set 0xA011CBCC %long   0x6C2CED6D
data.set 0xA011CBD0 %long   0x8B19B2CA
data.set 0xA011CBD4 %long   0x822B671D
data.set 0xA011CBD8 %long   0x27A56D66
data.set 0xA011CBDC %long   0x68975D2A
data.set 0xA011CBE0 %long   0x86D1B97E
data.set 0xA011CBE4 %long   0xEF811BD1
data.set 0xA011CBE8 %long   0x15CE6966
data.set 0xA011CBEC %long   0x31AED786
data.set 0xA011CBF0 %long   0x66D2926E
data.set 0xA011CBF4 %long   0x95E9DC0B
data.set 0xA011CBF8 %long   0xA9A75B10
data.set 0xA011CBFC %long   0x18E05747
data.set 0xA011CC00 %long   0xA6726A1A
data.set 0xA011CC04 %long   0xC78801E1
data.set 0xA011CC08 %long   0xB8B54CFB
data.set 0xA011CC0C %long   0x39F7A643
data.set 0xA011CC10 %long   0xDF4550C0
data.set 0xA011CC14 %long   0x43330AA6
data.set 0xA011CC18 %long   0x0799A8D7
data.set 0xA011CC1C %long   0x01EB457F
data.set 0xA011CC20 %long   0x3FB7A604
data.set 0xA011CC24 %long   0x5C34275E
data.set 0xA011CC28 %long   0x8C6F8B88
data.set 0xA011CC2C %long   0xE837BD17
data.set 0xA011CC30 %long   0xAFDA499A
data.set 0xA011CC34 %long   0xA2B36DAA
data.set 0xA011CC38 %long   0x90E71AAE
data.set 0xA011CC3C %long   0x28879E10
data.set 0xA011CC40 %long   0xB3B07E22
data.set 0xA011CC44 %long   0x31117772
data.set 0xA011CC48 %long   0xFBCEF8F1
data.set 0xA011CC4C %long   0xF96FA14C
data.set 0xA011CC50 %long   0xEBA3C465
data.set 0xA011CC54 %long   0x2FBA3C8E
data.set 0xA011CC58 %long   0xF1321E5B
data.set 0xA011CC5C %long   0xA55C724D
data.set 0xA011CC60 %long   0x415C7CAB
data.set 0xA011CC64 %long   0x857BE6E8
data.set 0xA011CC68 %long   0x1C0574C1
data.set 0xA011CC6C %long   0x1CE2FB71
data.set 0xA011CC70 %long   0x2A099421
data.set 0xA011CC74 %long   0xBF54ECE8
data.set 0xA011CC78 %long   0x284EB327
data.set 0xA011CC7C %long   0x1EF1398B
data.set 0xA011CC80 %long   0x5079E441
data.set 0xA011CC84 %long   0xDE0F4FF6
data.set 0xA011CC88 %long   0x5304B2A9
data.set 0xA011CC8C %long   0x7E7A2173
data.set 0xA011CC90 %long   0x73B4B295
data.set 0xA011CC94 %long   0xAF3CA4F3
data.set 0xA011CC98 %long   0xA6484DE0
data.set 0xA011CC9C %long   0x652BF377
data.set 0xA011CCA0 %long   0xC8554EE9
data.set 0xA011CCA4 %long   0x4124C400
data.set 0xA011CCA8 %long   0x8554E9ED
data.set 0xA011CCAC %long   0x1CCE2A81
data.set 0xA011CCB0 %long   0x2AFDB8BB
data.set 0xA011CCB4 %long   0xC43E4143
data.set 0xA011CCB8 %long   0x8CEAC643
data.set 0xA011CCBC %long   0xA419B2CA
data.set 0xA011CCC0 %long   0xA2828F98
data.set 0xA011CCC4 %long   0xF753093F
data.set 0xA011CCC8 %long   0x82CDEFEB
data.set 0xA011CCCC %long   0xC0D9B54F
data.set 0xA011CCD0 %long   0xBB46C641
data.set 0xA011CCD4 %long   0x4F00A9C2
data.set 0xA011CCD8 %long   0xC99665A6
data.set 0xA011CCDC %long   0xFE6D9473
data.set 0xA011CCE0 %long   0x022E56AD
data.set 0xA011CCE4 %long   0xD25B3F2F
data.set 0xA011CCE8 %long   0x6152D66D
data.set 0xA011CCEC %long   0xCAF99E04
data.set 0xA011CCF0 %long   0x1949BB9E
data.set 0xA011CCF4 %long   0xEF7CD415
data.set 0xA011CCF8 %long   0xF0A745D2
data.set 0xA011CCFC %long   0x7CF429BB
data.set 0xA011CD00 %long   0xD3C5E871
data.set 0xA011CD04 %long   0x6F977294
data.set 0xA011CD08 %long   0xBDCD56AE
data.set 0xA011CD0C %long   0x38D42BFE
data.set 0xA011CD10 %long   0x3467B64D
data.set 0xA011CD14 %long   0x0B999358
data.set 0xA011CD18 %long   0xEBFB0EAB
data.set 0xA011CD1C %long   0x9097E8F7
data.set 0xA011CD20 %long   0xB727C741
data.set 0xA011CD24 %long   0x0778C032
data.set 0xA011CD28 %long   0xB6ABF42A
data.set 0xA011CD2C %long   0xA1F0DEC6
data.set 0xA011CD30 %long   0xB491E100
data.set 0xA011CD34 %long   0xC2736E98
data.set 0xA011CD38 %long   0x0409AFDE
data.set 0xA011CD3C %long   0x77861CA8
data.set 0xA011CD40 %long   0xCC43410A
data.set 0xA011CD44 %long   0xA46327DA
data.set 0xA011CD48 %long   0xC9B77241
data.set 0xA011CD4C %long   0x47919E5A
data.set 0xA011CD50 %long   0x5F37DC47
data.set 0xA011CD54 %long   0x1DDAB514
data.set 0xA011CD58 %long   0xC976D2B1
data.set 0xA011CD5C %long   0x1F401413
data.set 0xA011CD60 %long   0x99D2CE73
data.set 0xA011CD64 %long   0xFB71C727
data.set 0xA011CD68 %long   0xF47A5DCB
data.set 0xA011CD6C %long   0xCD79E23C
data.set 0xA011CD70 %long   0x7653D684
data.set 0xA011CD74 %long   0x287CFEDA
data.set 0xA011CD78 %long   0x6E7F7DFE
data.set 0xA011CD7C %long   0xF0F3E759
data.set 0xA011CD80 %long   0xB74EC15B
data.set 0xA011CD84 %long   0xBF4C6FD3
data.set 0xA011CD88 %long   0xF8F4B4B8
data.set 0xA011CD8C %long   0x8FF4BEB3
data.set 0xA011CD90 %long   0xDC34F374
data.set 0xA011CD94 %long   0xE4C10D7A
data.set 0xA011CD98 %long   0x1C6FCC6E
data.set 0xA011CD9C %long   0x1C4E2BAA
data.set 0xA011CDA0 %long   0x7BDBBC8B
data.set 0xA011CDA4 %long   0x7A985771
data.set 0xA011CDA8 %long   0x28654F26
data.set 0xA011CDAC %long   0x45D1D85C
data.set 0xA011CDB0 %long   0x916220FC
data.set 0xA011CDB4 %long   0xDB4F4C33
data.set 0xA011CDB8 %long   0x682C545A
data.set 0xA011CDBC %long   0x5334F4AA
data.set 0xA011CDC0 %long   0xC9AD05F2
data.set 0xA011CDC4 %long   0x6D319D0B
data.set 0xA011CDC8 %long   0xBEFDFB0A
data.set 0xA011CDCC %long   0xB12D9021
data.set 0xA011CDD0 %long   0x90DA458E
data.set 0xA011CDD4 %long   0x4AAD15E1
data.set 0xA011CDD8 %long   0x5972497B
data.set 0xA011CDDC %long   0xDAB0131B
data.set 0xA011CDE0 %long   0xB03A01ED
data.set 0xA011CDE4 %long   0x157EDC36
data.set 0xA011CDE8 %long   0xFDC49A8C
data.set 0xA011CDEC %long   0xF7298FB3
data.set 0xA011CDF0 %long   0x4E39E7AE
data.set 0xA011CDF4 %long   0xAA31371D
data.set 0xA011CDF8 %long   0xAD8A75C7
data.set 0xA011CDFC %long   0x85FE6762
data.set 0xA011CE00 %long   0xF2A4EE7C
data.set 0xA011CE04 %long   0x4CB9A4B8
data.set 0xA011CE08 %long   0x32C7ED8D
data.set 0xA011CE0C %long   0x727D97C3
data.set 0xA011CE10 %long   0x1E01B4B6
data.set 0xA011CE14 %long   0x9F3C2DA1
data.set 0xA011CE18 %long   0xFCCF3116
data.set 0xA011CE1C %long   0xC099442A
data.set 0xA011CE20 %long   0x89363CB3
data.set 0xA011CE24 %long   0x6175CF85
data.set 0xA011CE28 %long   0x5F98B954
data.set 0xA011CE2C %long   0x02E58CEF
data.set 0xA011CE30 %long   0x1715460F
data.set 0xA011CE34 %long   0xEE48D763
data.set 0xA011CE38 %long   0xB56CADA5
data.set 0xA011CE3C %long   0x6BFACF72
data.set 0xA011CE40 %long   0x4AD9330F
data.set 0xA011CE44 %long   0xC89385BF
data.set 0xA011CE48 %long   0xECAC8BA8
data.set 0xA011CE4C %long   0x88A0E567
data.set 0xA011CE50 %long   0x57CD7DD4
data.set 0xA011CE54 %long   0x485D7D6B
data.set 0xA011CE58 %long   0x6EA9ADEB
data.set 0xA011CE5C %long   0xE2587047
data.set 0xA011CE60 %long   0x8A5A5C9D
data.set 0xA011CE64 %long   0x85FDAD32
data.set 0xA011CE68 %long   0x7373EBF1
data.set 0xA011CE6C %long   0xE0CFEBA3
data.set 0xA011CE70 %long   0x1017B611
data.set 0xA011CE74 %long   0xCD169C1D
data.set 0xA011CE78 %long   0xCB02946A
data.set 0xA011CE7C %long   0x1E3148C4
data.set 0xA011CE80 %long   0xEB7720B7
data.set 0xA011CE84 %long   0x119D00D1
data.set 0xA011CE88 %long   0xBA34A937
data.set 0xA011CE8C %long   0x4B8340DB
data.set 0xA011CE90 %long   0x2DF3F212
data.set 0xA011CE94 %long   0x58E48129
data.set 0xA011CE98 %long   0x68823700
data.set 0xA011CE9C %long   0x279C374E
data.set 0xA011CEA0 %long   0xFC3A8597
data.set 0xA011CEA4 %long   0xC7AF5C3E
data.set 0xA011CEA8 %long   0x18CA43F1
data.set 0xA011CEAC %long   0x693255EF
data.set 0xA011CEB0 %long   0x00D3DBFA
data.set 0xA011CEB4 %long   0x3ADB8E4D
data.set 0xA011CEB8 %long   0xA7A18C44
data.set 0xA011CEBC %long   0x58D173AA
data.set 0xA011CEC0 %long   0x233C05BB
data.set 0xA011CEC4 %long   0xAE9AF1B3
data.set 0xA011CEC8 %long   0x8E5B0535
data.set 0xA011CECC %long   0x4BC66EFC
data.set 0xA011CED0 %long   0x967E8F62
data.set 0xA011CED4 %long   0xC3AC4A10
data.set 0xA011CED8 %long   0xC7548937
data.set 0xA011CEDC %long   0xD9489EC6
data.set 0xA011CEE0 %long   0x25E5743D
data.set 0xA011CEE4 %long   0x76A3CF51
data.set 0xA011CEE8 %long   0x2AA3E708
data.set 0xA011CEEC %long   0xFF7474AE
data.set 0xA011CEF0 %long   0x32EEEB28
data.set 0xA011CEF4 %long   0x26B4190A
data.set 0xA011CEF8 %long   0xC98A6A54
data.set 0xA011CEFC %long   0x99AB4672
data.set 0xA011CF00 %long   0x51F7103C
data.set 0xA011CF04 %long   0xE677776A
data.set 0xA011CF08 %long   0x4C841CDD
data.set 0xA011CF0C %long   0xADC5275B
data.set 0xA011CF10 %long   0x8EA4D90D
data.set 0xA011CF14 %long   0x8E282D75
data.set 0xA011CF18 %long   0x2B382EB5
data.set 0xA011CF1C %long   0xF430DEB9
data.set 0xA011CF20 %long   0xAF1C552B
data.set 0xA011CF24 %long   0x6B831C91
data.set 0xA011CF28 %long   0x657390E1
data.set 0xA011CF2C %long   0xEF2E7B07
data.set 0xA011CF30 %long   0x0367CC27
data.set 0xA011CF34 %long   0xBF19349D
data.set 0xA011CF38 %long   0xF66CF192
data.set 0xA011CF3C %long   0xC7754159
data.set 0xA011CF40 %long   0xA3AFB709
data.set 0xA011CF44 %long   0x3E0D9E7A
data.set 0xA011CF48 %long   0xBCB20F55
data.set 0xA011CF4C %long   0x2BDD1BD3
data.set 0xA011CF50 %long   0xAFBFDF21
data.set 0xA011CF54 %long   0x572CB190
data.set 0xA011CF58 %long   0xB4B26DE2
data.set 0xA011CF5C %long   0x33FF2213
data.set 0xA011CF60 %long   0xA0DECBE3
data.set 0xA011CF64 %long   0xA85749AB
data.set 0xA011CF68 %long   0x4F21F789
data.set 0xA011CF6C %long   0x20B76482
data.set 0xA011CF70 %long   0xEEFDE7AE
data.set 0xA011CF74 %long   0xE52C5AB3
data.set 0xA011CF78 %long   0x2D4CB3F3
data.set 0xA011CF7C %long   0x88865352
data.set 0xA011CF80 %long   0xEEDB314F
data.set 0xA011CF84 %long   0xCCF3A03F
data.set 0xA011CF88 %long   0x1149F7C4
data.set 0xA011CF8C %long   0xD7B99016
data.set 0xA011CF90 %long   0xCA26951A
data.set 0xA011CF94 %long   0x45F69CC2
data.set 0xA011CF98 %long   0xFB95D05E
data.set 0xA011CF9C %long   0x59043162
data.set 0xA011CFA0 %long   0x3C95A211
data.set 0xA011CFA4 %long   0xDAB03D60
data.set 0xA011CFA8 %long   0x3A02AA9E
data.set 0xA011CFAC %long   0x77E65E9D
data.set 0xA011CFB0 %long   0x9C7E422B
data.set 0xA011CFB4 %long   0xC036E333
data.set 0xA011CFB8 %long   0x15F2C641
data.set 0xA011CFBC %long   0x383006E4
data.set 0xA011CFC0 %long   0x33FA4A30
data.set 0xA011CFC4 %long   0x4F18FB86
data.set 0xA011CFC8 %long   0x7A93453E
data.set 0xA011CFCC %long   0x4C0A771F
data.set 0xA011CFD0 %long   0xB179BD04
data.set 0xA011CFD4 %long   0x4E457A33
data.set 0xA011CFD8 %long   0xFB0BAE5D
data.set 0xA011CFDC %long   0x98CBA84E
data.set 0xA011CFE0 %long   0x11A640ED
data.set 0xA011CFE4 %long   0x511F3E84
data.set 0xA011CFE8 %long   0x881C787D
data.set 0xA011CFEC %long   0x2000D053
data.set 0xA011CFF0 %long   0x13FC2D71
data.set 0xA011CFF4 %long   0xDEF4FA31
data.set 0xA011CFF8 %long   0xE2C36D05
data.set 0xA011CFFC %long   0x3F550F6F
data.set 0xA011D000 %long   0xCB467BDF
data.set 0xA011D004 %long   0x0C0186D6
data.set 0xA011D008 %long   0xF00514CA
data.set 0xA011D00C %long   0xA95633B7
data.set 0xA011D010 %long   0xCCB3043E
data.set 0xA011D014 %long   0x9074814A
data.set 0xA011D018 %long   0x321FF67F
data.set 0xA011D01C %long   0x3D9D762A
data.set 0xA011D020 %long   0x1920AD07
data.set 0xA011D024 %long   0x25443377
data.set 0xA011D028 %long   0x4B3849B2
data.set 0xA011D02C %long   0xFD2F170D
data.set 0xA011D030 %long   0x514C484C
data.set 0xA011D034 %long   0xA8A16AE0
data.set 0xA011D038 %long   0x41FFA3A7
data.set 0xA011D03C %long   0x81B32D76
data.set 0xA011D040 %long   0xC3158669
data.set 0xA011D044 %long   0x13C99741
data.set 0xA011D048 %long   0xAF42D484
data.set 0xA011D04C %long   0xBFB789F8
data.set 0xA011D050 %long   0x6F595A6A
data.set 0xA011D054 %long   0x2F7B1DD7
data.set 0xA011D058 %long   0x2537D746
data.set 0xA011D05C %long   0x7555C2ED
data.set 0xA011D060 %long   0xBD218C33
data.set 0xA011D064 %long   0xF1C322FC
data.set 0xA011D068 %long   0xAAD4D69D
data.set 0xA011D06C %long   0x3CFB7F80
data.set 0xA011D070 %long   0xED18322F
data.set 0xA011D074 %long   0x61FA6556
data.set 0xA011D078 %long   0x7673786A
data.set 0xA011D07C %long   0xAACD0986
data.set 0xA011D080 %long   0x915BA2E6
data.set 0xA011D084 %long   0xFC225223
data.set 0xA011D088 %long   0xC6FAEEA9
data.set 0xA011D08C %long   0x6D7C12C1
data.set 0xA011D090 %long   0xFC8D5F45
data.set 0xA011D094 %long   0x32A426B6
data.set 0xA011D098 %long   0x2527E292
data.set 0xA011D09C %long   0x56C5B1AA
data.set 0xA011D0A0 %long   0x7FDC4E34
data.set 0xA011D0A4 %long   0x02C0B3E5
data.set 0xA011D0A8 %long   0xC7C49F3A
data.set 0xA011D0AC %long   0x7E8B6D66
data.set 0xA011D0B0 %long   0x474B5CB7
data.set 0xA011D0B4 %long   0x676AC244
data.set 0xA011D0B8 %long   0xD4AA9390
data.set 0xA011D0BC %long   0x5BE41936
data.set 0xA011D0C0 %long   0x1D93A075
data.set 0xA011D0C4 %long   0x4C135C92
data.set 0xA011D0C8 %long   0x9A57A6FD
data.set 0xA011D0CC %long   0x53B22A07
data.set 0xA011D0D0 %long   0x1543082F
data.set 0xA011D0D4 %long   0x2B232E7C
data.set 0xA011D0D8 %long   0xF3409BE1
data.set 0xA011D0DC %long   0x25AE0CD8
data.set 0xA011D0E0 %long   0x998A49A5
data.set 0xA011D0E4 %long   0xA327B3B8
data.set 0xA011D0E8 %long   0x3D1FB3FB
data.set 0xA011D0EC %long   0x353B45D4
data.set 0xA011D0F0 %long   0xB1C55EC8
data.set 0xA011D0F4 %long   0xCD3FEE94
data.set 0xA011D0F8 %long   0xFB5B2EC8
data.set 0xA011D0FC %long   0x0246EA03
data.set 0xA011D100 %long   0x541798EF
data.set 0xA011D104 %long   0xFA265D28
data.set 0xA011D108 %long   0x3C9934BA
data.set 0xA011D10C %long   0x026D2459
data.set 0xA011D110 %long   0xF5AFADA2
data.set 0xA011D114 %long   0x13DC700D
data.set 0xA011D118 %long   0x5767393A
data.set 0xA011D11C %long   0xF4BF4BB4
data.set 0xA011D120 %long   0x853093C6
data.set 0xA011D124 %long   0xD2252B54
data.set 0xA011D128 %long   0x805CAD19
data.set 0xA011D12C %long   0xF0A99837
data.set 0xA011D130 %long   0x386AA5FF
data.set 0xA011D134 %long   0xC1B80176
data.set 0xA011D138 %long   0x140FAAE3
data.set 0xA011D13C %long   0xD5285D9E
data.set 0xA011D140 %long   0xFE9806F5
data.set 0xA011D144 %long   0x18F23523
data.set 0xA011D148 %long   0x0363FBCA
data.set 0xA011D14C %long   0x8CEE65A6
data.set 0xA011D150 %long   0xA30B16EC
data.set 0xA011D154 %long   0x388683EE
data.set 0xA011D158 %long   0x5C472FF9
data.set 0xA011D15C %long   0x5FB5D13B
data.set 0xA011D160 %long   0xBFFC57E2
data.set 0xA011D164 %long   0xAC203B9B
data.set 0xA011D168 %long   0xFED289EF
data.set 0xA011D16C %long   0x651FFC8B
data.set 0xA011D170 %long   0xECE1C4AD
data.set 0xA011D174 %long   0xE15DE15A
data.set 0xA011D178 %long   0x81E2B6FD
data.set 0xA011D17C %long   0xDD28652F
data.set 0xA011D180 %long   0x6E650B40
data.set 0xA011D184 %long   0xC1DF6BC3
data.set 0xA011D188 %long   0xD588DEF6
data.set 0xA011D18C %long   0xF1B9C6DB
data.set 0xA011D190 %long   0xE5A7D947
data.set 0xA011D194 %long   0xB511D4DA
data.set 0xA011D198 %long   0x16C09FBA
data.set 0xA011D19C %long   0xC012780F
data.set 0xA011D1A0 %long   0x91BE492E
data.set 0xA011D1A4 %long   0xD9BA477B
data.set 0xA011D1A8 %long   0xB781647C
data.set 0xA011D1AC %long   0x37459FAC
data.set 0xA011D1B0 %long   0xCE5BFA73
data.set 0xA011D1B4 %long   0x7C7E85C8
data.set 0xA011D1B8 %long   0xC2BCF9AE
data.set 0xA011D1BC %long   0x38CB6F52
data.set 0xA011D1C0 %long   0x02910BB0
data.set 0xA011D1C4 %long   0x444BAFE3
data.set 0xA011D1C8 %long   0x99794972
data.set 0xA011D1CC %long   0x98D5564E
data.set 0xA011D1D0 %long   0x33E11BA0
data.set 0xA011D1D4 %long   0xE57389AA
data.set 0xA011D1D8 %long   0x6E60AF77
data.set 0xA011D1DC %long   0x71B01A1A
data.set 0xA011D1E0 %long   0x556590BC
data.set 0xA011D1E4 %long   0x35B63D3F
data.set 0xA011D1E8 %long   0x64AE9DB3
data.set 0xA011D1EC %long   0xC6E624C6
data.set 0xA011D1F0 %long   0xCEEE891F
data.set 0xA011D1F4 %long   0xDF8681DF
data.set 0xA011D1F8 %long   0x4F9B7AEE
data.set 0xA011D1FC %long   0xAA204E19
data.set 0xA011D200 %long   0x89F43FD1
data.set 0xA011D204 %long   0x6567703D
data.set 0xA011D208 %long   0x8EC8D271
data.set 0xA011D20C %long   0x79FA945D
data.set 0xA011D210 %long   0xB3083E6C
data.set 0xA011D214 %long   0x5E3280B2
data.set 0xA011D218 %long   0xACD8E555
data.set 0xA011D21C %long   0x7A9FD051
data.set 0xA011D220 %long   0xE560DADF
data.set 0xA011D224 %long   0x6045A797
data.set 0xA011D228 %long   0xFC149724
data.set 0xA011D22C %long   0x57584570
data.set 0xA011D230 %long   0x4A5F67FB
data.set 0xA011D234 %long   0x652FF64D
data.set 0xA011D238 %long   0xA306C10E
data.set 0xA011D23C %long   0x5CA0BF4F
data.set 0xA011D240 %long   0x07792653
data.set 0xA011D244 %long   0x9AF7F321
data.set 0xA011D248 %long   0xF61F0A58
data.set 0xA011D24C %long   0x8007C197
data.set 0xA011D250 %long   0x6D22F796
data.set 0xA011D254 %long   0x9576B069
data.set 0xA011D258 %long   0x0DDC6B5A
data.set 0xA011D25C %long   0x5EEE7507
data.set 0xA011D260 %long   0x4E31C8E8
data.set 0xA011D264 %long   0x16FE048B
data.set 0xA011D268 %long   0x447DBF45
data.set 0xA011D26C %long   0x3DC9D873
data.set 0xA011D270 %long   0xD678AB62
data.set 0xA011D274 %long   0x76129EC8
data.set 0xA011D278 %long   0x64601EA8
data.set 0xA011D27C %long   0xFCA81AC7
data.set 0xA011D280 %long   0x3A79215B
data.set 0xA011D284 %long   0x4BBB79C5
data.set 0xA011D288 %long   0xCFB7F45F
data.set 0xA011D28C %long   0x8009813A
data.set 0xA011D290 %long   0x6ECD635B
data.set 0xA011D294 %long   0x2C3D0F30
data.set 0xA011D298 %long   0x42C93B0B
data.set 0xA011D29C %long   0x2C5837A7
data.set 0xA011D2A0 %long   0x8836FBCB
data.set 0xA011D2A4 %long   0xD2CE4888
data.set 0xA011D2A8 %long   0xE96684EB
data.set 0xA011D2AC %long   0xA75EEBB4
data.set 0xA011D2B0 %long   0x49D3A6A6
data.set 0xA011D2B4 %long   0x7CF2E05A
data.set 0xA011D2B8 %long   0xC1349250
data.set 0xA011D2BC %long   0x29D52C79
data.set 0xA011D2C0 %long   0x022555A5
data.set 0xA011D2C4 %long   0x87C9C742
data.set 0xA011D2C8 %long   0xECCE4EFE
data.set 0xA011D2CC %long   0xA0AFA532
data.set 0xA011D2D0 %long   0x7C0CD11C
data.set 0xA011D2D4 %long   0x65D08669
data.set 0xA011D2D8 %long   0x8EE5C1F6
data.set 0xA011D2DC %long   0x670E1E8C
data.set 0xA011D2E0 %long   0x658788A6
data.set 0xA011D2E4 %long   0x8E06FA42
data.set 0xA011D2E8 %long   0x817D0BC3
data.set 0xA011D2EC %long   0xA52CE528
data.set 0xA011D2F0 %long   0x80D38039
data.set 0xA011D2F4 %long   0x19015E40
data.set 0xA011D2F8 %long   0xE6F63ED7
data.set 0xA011D2FC %long   0x9293426E
data.set 0xA011D300 %long   0x22180800
data.set 0xA011D304 %long   0x5A222A76
data.set 0xA011D308 %long   0xFDB6C293
data.set 0xA011D30C %long   0x468F6539
data.set 0xA011D310 %long   0xFDA9E1B1
data.set 0xA011D314 %long   0x84692FB3
data.set 0xA011D318 %long   0xA2A50D6F
data.set 0xA011D31C %long   0xEB7A1EF9
data.set 0xA011D320 %long   0x18148E1A
data.set 0xA011D324 %long   0xD1D3AA55
data.set 0xA011D328 %long   0x7993CB01
data.set 0xA011D32C %long   0x1B3A9723
data.set 0xA011D330 %long   0x7A73440B
data.set 0xA011D334 %long   0x0433C01B
data.set 0xA011D338 %long   0xA9C22355
data.set 0xA011D33C %long   0xFD65B95C
data.set 0xA011D340 %long   0xA91E8E45
data.set 0xA011D344 %long   0xA008C153
data.set 0xA011D348 %long   0x9EA0FF2B
data.set 0xA011D34C %long   0x1DE68521
data.set 0xA011D350 %long   0x21566A11
data.set 0xA011D354 %long   0x0BF0350F
data.set 0xA011D358 %long   0x78F7C799
data.set 0xA011D35C %long   0xFFAB4DA1
data.set 0xA011D360 %long   0x2E2E2624
data.set 0xA011D364 %long   0x38F120BD
data.set 0xA011D368 %long   0xE75785E8
data.set 0xA011D36C %long   0xCA4B347C
data.set 0xA011D370 %long   0x85BEF615
data.set 0xA011D374 %long   0xAE9D4615
data.set 0xA011D378 %long   0xF04B27E7
data.set 0xA011D37C %long   0x789E560F
data.set 0xA011D380 %long   0x9A31B007
data.set 0xA011D384 %long   0x57F5387B
data.set 0xA011D388 %long   0x3A59E00F
data.set 0xA011D38C %long   0x2341A0B1
data.set 0xA011D390 %long   0x3B642BFE
data.set 0xA011D394 %long   0x52B48F91
data.set 0xA011D398 %long   0x46054F78
data.set 0xA011D39C %long   0x1D01FAA0
data.set 0xA011D3A0 %long   0x8DA10B7B
data.set 0xA011D3A4 %long   0x652E85F1
data.set 0xA011D3A8 %long   0x998F51C2
data.set 0xA011D3AC %long   0x52DD4B71
data.set 0xA011D3B0 %long   0x938FB538
data.set 0xA011D3B4 %long   0x042CC8AE
data.set 0xA011D3B8 %long   0xDAFF3567
data.set 0xA011D3BC %long   0x34697BE9
data.set 0xA011D3C0 %long   0x45D80B9E
data.set 0xA011D3C4 %long   0x4EE688AD
data.set 0xA011D3C8 %long   0x4FD5D316
data.set 0xA011D3CC %long   0x49659BFC
data.set 0xA011D3D0 %long   0x979EB456
data.set 0xA011D3D4 %long   0x7BBE7B13
data.set 0xA011D3D8 %long   0x8FD00C83
data.set 0xA011D3DC %long   0x72B61153
data.set 0xA011D3E0 %long   0x159BD133
data.set 0xA011D3E4 %long   0xBD8C9F8E
data.set 0xA011D3E8 %long   0xC802F389
data.set 0xA011D3EC %long   0x03ED013F
data.set 0xA011D3F0 %long   0xB2C642D0
data.set 0xA011D3F4 %long   0x52BD1D27
data.set 0xA011D3F8 %long   0x32C7EF37
data.set 0xA011D3FC %long   0x48FA224F
data.set 0xA011D400 %long   0x06C90256
data.set 0xA011D404 %long   0xDD3C3A9B
data.set 0xA011D408 %long   0x16092498
data.set 0xA011D40C %long   0xDBA901DA
data.set 0xA011D410 %long   0x87EDAE74
data.set 0xA011D414 %long   0xE3F720C9
data.set 0xA011D418 %long   0x06213FF1
data.set 0xA011D41C %long   0x05891DFC
data.set 0xA011D420 %long   0x0288888B
data.set 0xA011D424 %long   0x07DDADB7
data.set 0xA011D428 %long   0xA6D939ED
data.set 0xA011D42C %long   0x48DCE248
data.set 0xA011D430 %long   0xCE1A3136
data.set 0xA011D434 %long   0x9DD91A64
data.set 0xA011D438 %long   0x346A6215
data.set 0xA011D43C %long   0xD9C288F6
data.set 0xA011D440 %long   0xEC54E4B1
data.set 0xA011D444 %long   0xAE140855
data.set 0xA011D448 %long   0xCACE6552
data.set 0xA011D44C %long   0x8E194C49
data.set 0xA011D450 %long   0xC2E17603
data.set 0xA011D454 %long   0x370BB64D
data.set 0xA011D458 %long   0xD102CD8F
data.set 0xA011D45C %long   0x77E574EF
data.set 0xA011D460 %long   0x90B266AC
data.set 0xA011D464 %long   0xB68432D0
data.set 0xA011D468 %long   0x3BC5CDCE
data.set 0xA011D46C %long   0x53F34B15
data.set 0xA011D470 %long   0x41E6AE03
data.set 0xA011D474 %long   0x23EFE41D
data.set 0xA011D478 %long   0xF6C315AC
data.set 0xA011D47C %long   0x95210C76
data.set 0xA011D480 %long   0xA5109A5B
data.set 0xA011D484 %long   0xA8D3A467
data.set 0xA011D488 %long   0xB90DB753
data.set 0xA011D48C %long   0xC29E5F22
data.set 0xA011D490 %long   0x70783D5C
data.set 0xA011D494 %long   0x35CC7F7E
data.set 0xA011D498 %long   0x39F44E50
data.set 0xA011D49C %long   0x9B7D6175
data.set 0xA011D4A0 %long   0x618EB7F2
data.set 0xA011D4A4 %long   0x13827EDA
data.set 0xA011D4A8 %long   0xF4782921
data.set 0xA011D4AC %long   0x6F8FA7D7
data.set 0xA011D4B0 %long   0x8B1F33C7
data.set 0xA011D4B4 %long   0xC3100B6F
data.set 0xA011D4B8 %long   0x80500B98
data.set 0xA011D4BC %long   0x1BECF59F
data.set 0xA011D4C0 %long   0x76446C74
data.set 0xA011D4C4 %long   0xC4089B89
data.set 0xA011D4C8 %long   0x17275E89
data.set 0xA011D4CC %long   0x0E43B1E9
data.set 0xA011D4D0 %long   0x2E113672
data.set 0xA011D4D4 %long   0x143D196C
data.set 0xA011D4D8 %long   0x005BF5C9
data.set 0xA011D4DC %long   0x67CE9F85
data.set 0xA011D4E0 %long   0x569E80A8
data.set 0xA011D4E4 %long   0x686717C7
data.set 0xA011D4E8 %long   0x806A0291
data.set 0xA011D4EC %long   0x9C51E6D0
data.set 0xA011D4F0 %long   0xF1CAFF0D
data.set 0xA011D4F4 %long   0x3CEE899A
data.set 0xA011D4F8 %long   0xA418506A
data.set 0xA011D4FC %long   0x83621F85
data.set 0xA011D500 %long   0x45C86ACF
data.set 0xA011D504 %long   0x7654A018
data.set 0xA011D508 %long   0x85A793E0
data.set 0xA011D50C %long   0xF54664E0
data.set 0xA011D510 %long   0x8F894F1E
data.set 0xA011D514 %long   0x00205A24
data.set 0xA011D518 %long   0x2265DD88
data.set 0xA011D51C %long   0x454032D8
data.set 0xA011D520 %long   0xE4501D50
data.set 0xA011D524 %long   0x3589E83B
data.set 0xA011D528 %long   0x9F1CEDD6
data.set 0xA011D52C %long   0x88263C06
data.set 0xA011D530 %long   0xDC3B397D
data.set 0xA011D534 %long   0x09C924D4
data.set 0xA011D538 %long   0x8D9284E4
data.set 0xA011D53C %long   0xAF2F74DB
data.set 0xA011D540 %long   0xD8764F26
data.set 0xA011D544 %long   0x0A48F2B3
data.set 0xA011D548 %long   0xE4459659
data.set 0xA011D54C %long   0x2E8AF8F2
data.set 0xA011D550 %long   0xBF3E1DA5
data.set 0xA011D554 %long   0x9B049DE9
data.set 0xA011D558 %long   0x0A117DEF
data.set 0xA011D55C %long   0x9BB352C1
data.set 0xA011D560 %long   0x3D488C4A
data.set 0xA011D564 %long   0x36C957E5
data.set 0xA011D568 %long   0xD25F98C9
data.set 0xA011D56C %long   0x947635D9
data.set 0xA011D570 %long   0x5722CF7E
data.set 0xA011D574 %long   0x3AE35791
data.set 0xA011D578 %long   0xC592BD04
data.set 0xA011D57C %long   0xAAF3CA1E
data.set 0xA011D580 %long   0x8ED2A3BC
data.set 0xA011D584 %long   0xF95A1821
data.set 0xA011D588 %long   0xFCD8D530
data.set 0xA011D58C %long   0x0BA17965
data.set 0xA011D590 %long   0x0F1CA0EA
data.set 0xA011D594 %long   0x31D5C7EC
data.set 0xA011D598 %long   0x3A8B5C8C
data.set 0xA011D59C %long   0x76B2DFCC
data.set 0xA011D5A0 %long   0x99D75D6D
data.set 0xA011D5A4 %long   0xFD0CF568
data.set 0xA011D5A8 %long   0x9662D7B0
data.set 0xA011D5AC %long   0x6AA5494A
data.set 0xA011D5B0 %long   0xF30EBE47
data.set 0xA011D5B4 %long   0x5CE01D15
data.set 0xA011D5B8 %long   0xC6D03961
data.set 0xA011D5BC %long   0x9B0FAFE4
data.set 0xA011D5C0 %long   0xB40BE7FF
data.set 0xA011D5C4 %long   0xC257623F
data.set 0xA011D5C8 %long   0xE7CBACD1
data.set 0xA011D5CC %long   0x04C2BAB5
data.set 0xA011D5D0 %long   0x635AEF91
data.set 0xA011D5D4 %long   0xA9F51BF2
data.set 0xA011D5D8 %long   0xDF84DEC2
data.set 0xA011D5DC %long   0x511AF9DB
data.set 0xA011D5E0 %long   0x5A5C7454
data.set 0xA011D5E4 %long   0x2663BC49
data.set 0xA011D5E8 %long   0x8909754D
data.set 0xA011D5EC %long   0xBC308F10
data.set 0xA011D5F0 %long   0x023965A4
data.set 0xA011D5F4 %long   0xAC554153
data.set 0xA011D5F8 %long   0xF322567E
data.set 0xA011D5FC %long   0xF1E4A2B0
data.set 0xA011D600 %long   0x273ED870
data.set 0xA011D604 %long   0x6F3183F5
data.set 0xA011D608 %long   0xEFDF499E
data.set 0xA011D60C %long   0x5A61AE1B
data.set 0xA011D610 %long   0xA449FFF4
data.set 0xA011D614 %long   0x701AC897
data.set 0xA011D618 %long   0xA1B5E55F
data.set 0xA011D61C %long   0x7C43C537
data.set 0xA011D620 %long   0x91D5204D
data.set 0xA011D624 %long   0xF0B7A184
data.set 0xA011D628 %long   0x89F820E9
data.set 0xA011D62C %long   0x1991F80E
data.set 0xA011D630 %long   0xCB095DA6
data.set 0xA011D634 %long   0xFADFFE3E
data.set 0xA011D638 %long   0xAE01AE3C
data.set 0xA011D63C %long   0x9DF939E4
data.set 0xA011D640 %long   0xB4B077C5
data.set 0xA011D644 %long   0xCC31508B
data.set 0xA011D648 %long   0xF658E470
data.set 0xA011D64C %long   0x839B6DFC
data.set 0xA011D650 %long   0x38FC9B54
data.set 0xA011D654 %long   0x7FAF7BAB
data.set 0xA011D658 %long   0xE68A3C28
data.set 0xA011D65C %long   0xF9A6B07F
data.set 0xA011D660 %long   0xD5CD60AC
data.set 0xA011D664 %long   0x5ED1E73E
data.set 0xA011D668 %long   0xF61658CB
data.set 0xA011D66C %long   0xA3B02551
data.set 0xA011D670 %long   0xA6693671
data.set 0xA011D674 %long   0xC7AAE2E8
data.set 0xA011D678 %long   0x4BF9C380
data.set 0xA011D67C %long   0x3ED890DE
data.set 0xA011D680 %long   0x26E453F7
data.set 0xA011D684 %long   0xAEA2BA2C
data.set 0xA011D688 %long   0x3CAB7682
data.set 0xA011D68C %long   0xA2A63F83
data.set 0xA011D690 %long   0x9A8570B2
data.set 0xA011D694 %long   0x7A611A15
data.set 0xA011D698 %long   0x3E97A0EB
data.set 0xA011D69C %long   0xC607B214
data.set 0xA011D6A0 %long   0x3A5902AF
data.set 0xA011D6A4 %long   0x6D27A5C2
data.set 0xA011D6A8 %long   0xC7D094E1
data.set 0xA011D6AC %long   0x19CF06A4
data.set 0xA011D6B0 %long   0xF8663621
data.set 0xA011D6B4 %long   0x651C35BC
data.set 0xA011D6B8 %long   0x2DABCA1F
data.set 0xA011D6BC %long   0x88B78633
data.set 0xA011D6C0 %long   0xEDB31424
data.set 0xA011D6C4 %long   0x1D881C35
data.set 0xA011D6C8 %long   0xEF16E3A8
data.set 0xA011D6CC %long   0xE61A87E2
data.set 0xA011D6D0 %long   0xECBB471C
data.set 0xA011D6D4 %long   0x477921FB
data.set 0xA011D6D8 %long   0x888787BE
data.set 0xA011D6DC %long   0xA2996860
data.set 0xA011D6E0 %long   0x8A919063
data.set 0xA011D6E4 %long   0xAED11796
data.set 0xA011D6E8 %long   0xB17406D4
data.set 0xA011D6EC %long   0xC6E03FB0
data.set 0xA011D6F0 %long   0x76C2BF8E
data.set 0xA011D6F4 %long   0x092AB3D6
data.set 0xA011D6F8 %long   0xC52D0190
data.set 0xA011D6FC %long   0x6A05EF45
data.set 0xA011D700 %long   0xE33814D6
data.set 0xA011D704 %long   0x52B11125
data.set 0xA011D708 %long   0x660F3810
data.set 0xA011D70C %long   0x08041E3E
data.set 0xA011D710 %long   0x865DC9D3
data.set 0xA011D714 %long   0xB5D72810
data.set 0xA011D718 %long   0x979441CC
data.set 0xA011D71C %long   0x9B22EC19
data.set 0xA011D720 %long   0xF07129AF
data.set 0xA011D724 %long   0x53ACF7AA
data.set 0xA011D728 %long   0x85722B75
data.set 0xA011D72C %long   0x2C9E951D
data.set 0xA011D730 %long   0xA4C26638
data.set 0xA011D734 %long   0x3CB9A3FD
data.set 0xA011D738 %long   0xB8A4D8A7
data.set 0xA011D73C %long   0xD8F04184
data.set 0xA011D740 %long   0x5E5214BC
data.set 0xA011D744 %long   0xD8733AA1
data.set 0xA011D748 %long   0xD337F544
data.set 0xA011D74C %long   0xF8227F0C
data.set 0xA011D750 %long   0xEDA668C3
data.set 0xA011D754 %long   0x60DB1686
data.set 0xA011D758 %long   0x48166AA1
data.set 0xA011D75C %long   0x8179D3AC
data.set 0xA011D760 %long   0xCDF04D54
data.set 0xA011D764 %long   0xB193EDF4
data.set 0xA011D768 %long   0x4EFC64A7
data.set 0xA011D76C %long   0x466A7E17
data.set 0xA011D770 %long   0xAE05B211
data.set 0xA011D774 %long   0x8A686009
data.set 0xA011D778 %long   0xDCAF3575
data.set 0xA011D77C %long   0x55D56850
data.set 0xA011D780 %long   0x69E082B5
data.set 0xA011D784 %long   0x6994D27E
data.set 0xA011D788 %long   0xB213599C
data.set 0xA011D78C %long   0xADCBBBF1
data.set 0xA011D790 %long   0x7685EA35
data.set 0xA011D794 %long   0x104A527A
data.set 0xA011D798 %long   0xA689B2A4
data.set 0xA011D79C %long   0x351FA023
data.set 0xA011D7A0 %long   0xA8B2C3D4
data.set 0xA011D7A4 %long   0x9307AD2F
data.set 0xA011D7A8 %long   0x83E31935
data.set 0xA011D7AC %long   0xEE03327F
data.set 0xA011D7B0 %long   0x26C8A727
data.set 0xA011D7B4 %long   0x98F0FA5A
data.set 0xA011D7B8 %long   0xE8525024
data.set 0xA011D7BC %long   0xB1E7C598
data.set 0xA011D7C0 %long   0x1D2AD56E
data.set 0xA011D7C4 %long   0xBAEF0108
data.set 0xA011D7C8 %long   0x5123CFF0
data.set 0xA011D7CC %long   0x23E39E67
data.set 0xA011D7D0 %long   0x4775CC44
data.set 0xA011D7D4 %long   0x1A8E1E26
data.set 0xA011D7D8 %long   0x1C25DF11
data.set 0xA011D7DC %long   0x91690DEF
data.set 0xA011D7E0 %long   0x9E6EEBE5
data.set 0xA011D7E4 %long   0x45268668
data.set 0xA011D7E8 %long   0xC7EDFAED
data.set 0xA011D7EC %long   0xB8AA58ED
data.set 0xA011D7F0 %long   0x9F7DBFFA
data.set 0xA011D7F4 %long   0x89E37C65
data.set 0xA011D7F8 %long   0xEF62FED1
data.set 0xA011D7FC %long   0xBAC417C1
data.set 0xA011D800 %long   0xCDD3D658
data.set 0xA011D804 %long   0x3D0EEB86
data.set 0xA011D808 %long   0x31BCB06F
data.set 0xA011D80C %long   0xB6766265
data.set 0xA011D810 %long   0xDACB71C1
data.set 0xA011D814 %long   0x81077A88
data.set 0xA011D818 %long   0x673763C3
data.set 0xA011D81C %long   0xFAE5033E
data.set 0xA011D820 %long   0x87E72EBD
data.set 0xA011D824 %long   0x19098DB4
data.set 0xA011D828 %long   0x924B1D2A
data.set 0xA011D82C %long   0xDE4BF1FA
data.set 0xA011D830 %long   0x0634CBDD
data.set 0xA011D834 %long   0x8B12B7CA
data.set 0xA011D838 %long   0xFA708C02
data.set 0xA011D83C %long   0xED31680B
data.set 0xA011D840 %long   0xD27B604C
data.set 0xA011D844 %long   0x36FCEFB7
data.set 0xA011D848 %long   0xD786FC8F
data.set 0xA011D84C %long   0xE07AEB76
data.set 0xA011D850 %long   0x85A4E900
data.set 0xA011D854 %long   0x9A16D70A
data.set 0xA011D858 %long   0xC18ED1EE
data.set 0xA011D85C %long   0x11E5E916
data.set 0xA011D860 %long   0x0BDC1CF0
data.set 0xA011D864 %long   0x0B4BD02E
data.set 0xA011D868 %long   0xCDED711D
data.set 0xA011D86C %long   0xFFA20428
data.set 0xA011D870 %long   0xE5DF9014
data.set 0xA011D874 %long   0xBDA62D37
data.set 0xA011D878 %long   0xA7ACD7F8
data.set 0xA011D87C %long   0x7CE946AC
data.set 0xA011D880 %long   0x2EAF1B63
data.set 0xA011D884 %long   0xF0B4F776
data.set 0xA011D888 %long   0x3858AE5E
data.set 0xA011D88C %long   0x9F5C1034
data.set 0xA011D890 %long   0x11FC2727
data.set 0xA011D894 %long   0xCDA309F9
data.set 0xA011D898 %long   0x3C15AD37
data.set 0xA011D89C %long   0x36C78407
data.set 0xA011D8A0 %long   0x55882236
data.set 0xA011D8A4 %long   0x13B868C1
data.set 0xA011D8A8 %long   0x2B03C488
data.set 0xA011D8AC %long   0x8BE2549D
data.set 0xA011D8B0 %long   0x69856448
data.set 0xA011D8B4 %long   0x69D25D75
data.set 0xA011D8B8 %long   0x1DD9A5FF
data.set 0xA011D8BC %long   0x047B2CEE
data.set 0xA011D8C0 %long   0xE90B6CE3
data.set 0xA011D8C4 %long   0x117EA15C
data.set 0xA011D8C8 %long   0x10CB908D
data.set 0xA011D8CC %long   0xCA99500B
data.set 0xA011D8D0 %long   0xBD9134BF
data.set 0xA011D8D4 %long   0xD3F6EAF1
data.set 0xA011D8D8 %long   0x653132AB
data.set 0xA011D8DC %long   0x26060A18
data.set 0xA011D8E0 %long   0xA5E69AEE
data.set 0xA011D8E4 %long   0xFE9DB105
data.set 0xA011D8E8 %long   0x70FFC813
data.set 0xA011D8EC %long   0x278EA9FF
data.set 0xA011D8F0 %long   0x01499218
data.set 0xA011D8F4 %long   0x35C59755
data.set 0xA011D8F8 %long   0x39B88D18
data.set 0xA011D8FC %long   0x8F41FEC9
data.set 0xA011D900 %long   0xAFC60EFB
data.set 0xA011D904 %long   0x95280BB8
data.set 0xA011D908 %long   0xAD5C3907
data.set 0xA011D90C %long   0x1FAC3F70
data.set 0xA011D910 %long   0xFFE72150
data.set 0xA011D914 %long   0x7F1831C6
data.set 0xA011D918 %long   0x1FFB0ACE
data.set 0xA011D91C %long   0x7B0E76C4
data.set 0xA011D920 %long   0xC843629A
data.set 0xA011D924 %long   0x1582F65C
data.set 0xA011D928 %long   0x7665BD9C
data.set 0xA011D92C %long   0x47DE98B1
data.set 0xA011D930 %long   0xAFB7A983
data.set 0xA011D934 %long   0xC67A0286
data.set 0xA011D938 %long   0x9C0F53A8
data.set 0xA011D93C %long   0x78208E51
data.set 0xA011D940 %long   0xE74386DC
data.set 0xA011D944 %long   0x938B4369
data.set 0xA011D948 %long   0x957653AC
data.set 0xA011D94C %long   0x5440BE83
data.set 0xA011D950 %long   0xACB47B17
data.set 0xA011D954 %long   0x20295AB7
data.set 0xA011D958 %long   0x58E93740
data.set 0xA011D95C %long   0xBDFD46FC
data.set 0xA011D960 %long   0xF8C65117
data.set 0xA011D964 %long   0xB8CCE3D0
data.set 0xA011D968 %long   0x14162AB2
data.set 0xA011D96C %long   0xC94324D1
data.set 0xA011D970 %long   0x63EFCD41
data.set 0xA011D974 %long   0x1AC25F08
data.set 0xA011D978 %long   0x5CF076D5
data.set 0xA011D97C %long   0xE7AFDB67
data.set 0xA011D980 %long   0xF77EF5EF
data.set 0xA011D984 %long   0x3F3D17BC
data.set 0xA011D988 %long   0x957EB2F0
data.set 0xA011D98C %long   0x571B2606
data.set 0xA011D990 %long   0xA6680582
data.set 0xA011D994 %long   0xEEBC03FE
data.set 0xA011D998 %long   0x80F79C1A
data.set 0xA011D99C %long   0x54622093
data.set 0xA011D9A0 %long   0x13800122
data.set 0xA011D9A4 %long   0x97452E4A
data.set 0xA011D9A8 %long   0x0EE4B97F
data.set 0xA011D9AC %long   0xD1692AE8
data.set 0xA011D9B0 %long   0xA555EC4F
data.set 0xA011D9B4 %long   0x7C07E03B
data.set 0xA011D9B8 %long   0xD588DA44
data.set 0xA011D9BC %long   0x29C7EDD4
data.set 0xA011D9C0 %long   0xCC59CC7E
data.set 0xA011D9C4 %long   0xE734FF97
data.set 0xA011D9C8 %long   0xB5525064
data.set 0xA011D9CC %long   0x474E502C
data.set 0xA011D9D0 %long   0x89ED46C3
data.set 0xA011D9D4 %long   0x6399A8DC
data.set 0xA011D9D8 %long   0x38220D49
data.set 0xA011D9DC %long   0xB47D4DEE
data.set 0xA011D9E0 %long   0x846B1EE4
data.set 0xA011D9E4 %long   0x06917DF9
data.set 0xA011D9E8 %long   0x4E62C21E
data.set 0xA011D9EC %long   0xCCD7D250
data.set 0xA011D9F0 %long   0xDA41ACD2
data.set 0xA011D9F4 %long   0x701CDE7D
data.set 0xA011D9F8 %long   0x0E93673C
data.set 0xA011D9FC %long   0x49372474
data.set 0xA011DA00 %long   0xC71DC689
data.set 0xA011DA04 %long   0xB8B99767
data.set 0xA011DA08 %long   0x36F0EDE4
data.set 0xA011DA0C %long   0x0629E479
data.set 0xA011DA10 %long   0x3C817EAB
data.set 0xA011DA14 %long   0x88F16408
data.set 0xA011DA18 %long   0x7A2A0E21
data.set 0xA011DA1C %long   0xCFBEDA67
data.set 0xA011DA20 %long   0x87A90489
data.set 0xA011DA24 %long   0x2FCB7855
data.set 0xA011DA28 %long   0x7B72103B
data.set 0xA011DA2C %long   0x700136E6
data.set 0xA011DA30 %long   0x0F1CF36F
data.set 0xA011DA34 %long   0x0141B39F
data.set 0xA011DA38 %long   0xCC45908F
data.set 0xA011DA3C %long   0x541EEB44
data.set 0xA011DA40 %long   0x9D6CD31A
data.set 0xA011DA44 %long   0xB9E05515
data.set 0xA011DA48 %long   0xCECA10CA
data.set 0xA011DA4C %long   0x89FE88D5
data.set 0xA011DA50 %long   0x418A9530
data.set 0xA011DA54 %long   0xF9CBE140
data.set 0xA011DA58 %long   0xBF4A5B4C
data.set 0xA011DA5C %long   0x340FA34B
data.set 0xA011DA60 %long   0xF09A678C
data.set 0xA011DA64 %long   0xD8D1D4BA
data.set 0xA011DA68 %long   0x70A8F809
data.set 0xA011DA6C %long   0x7BE4DEC4
data.set 0xA011DA70 %long   0x333A642B
data.set 0xA011DA74 %long   0x6C9670A9
data.set 0xA011DA78 %long   0xA4ED8596
data.set 0xA011DA7C %long   0x61D57C42
data.set 0xA011DA80 %long   0x52BCD850
data.set 0xA011DA84 %long   0x76C9F298
data.set 0xA011DA88 %long   0xA48F75CE
data.set 0xA011DA8C %long   0xF7904A88
data.set 0xA011DA90 %long   0xBFAB5489
data.set 0xA011DA94 %long   0x9E277B81
data.set 0xA011DA98 %long   0x6B6DAD29
data.set 0xA011DA9C %long   0x351FD15B
data.set 0xA011DAA0 %long   0x63F6C977
data.set 0xA011DAA4 %long   0x8C3B4508
data.set 0xA011DAA8 %long   0xB318EEEF
data.set 0xA011DAAC %long   0x84EE7EFE
data.set 0xA011DAB0 %long   0xA9531AA6
data.set 0xA011DAB4 %long   0xC8623D56
data.set 0xA011DAB8 %long   0xF3D83051
data.set 0xA011DABC %long   0x9A55CB69
data.set 0xA011DAC0 %long   0xEEF5C81B
data.set 0xA011DAC4 %long   0xC5F5996D
data.set 0xA011DAC8 %long   0xD4DFD9CB
data.set 0xA011DACC %long   0x5A7CFABA
data.set 0xA011DAD0 %long   0xC7C8B436
data.set 0xA011DAD4 %long   0xC0048B36
data.set 0xA011DAD8 %long   0xEFF5EDDC
data.set 0xA011DADC %long   0x62C3DA0B
data.set 0xA011DAE0 %long   0xD7AA4DB7
data.set 0xA011DAE4 %long   0xBA7D16EA
data.set 0xA011DAE8 %long   0x1E5E1346
data.set 0xA011DAEC %long   0x0801A61F
data.set 0xA011DAF0 %long   0xF3B8EA86
data.set 0xA011DAF4 %long   0x149BF9C4
data.set 0xA011DAF8 %long   0x9E1D8950
data.set 0xA011DAFC %long   0x1E08B6D9
data.set 0xA011DB00 %long   0x10F4A19A
data.set 0xA011DB04 %long   0xC0A9ED4C
data.set 0xA011DB08 %long   0x3023CC6F
data.set 0xA011DB0C %long   0x25341E77
data.set 0xA011DB10 %long   0x7F79963C
data.set 0xA011DB14 %long   0x97C80D28
data.set 0xA011DB18 %long   0x4D681C65
data.set 0xA011DB1C %long   0x5C476859
data.set 0xA011DB20 %long   0xFAC3D339
data.set 0xA011DB24 %long   0xD485D042
data.set 0xA011DB28 %long   0xA2C758A3
data.set 0xA011DB2C %long   0x2836C1C6
data.set 0xA011DB30 %long   0x38936AB2
data.set 0xA011DB34 %long   0x3E520551
data.set 0xA011DB38 %long   0x42F99D00
data.set 0xA011DB3C %long   0xBFD02C63
data.set 0xA011DB40 %long   0x01414B38
data.set 0xA011DB44 %long   0x4385BE4F
data.set 0xA011DB48 %long   0xE42F178C
data.set 0xA011DB4C %long   0xDD47A6F4
data.set 0xA011DB50 %long   0xE31DB233
data.set 0xA011DB54 %long   0x61C973BB
data.set 0xA011DB58 %long   0x1EEAB2ED
data.set 0xA011DB5C %long   0x5CC6734A
data.set 0xA011DB60 %long   0x56A60F5B
data.set 0xA011DB64 %long   0x3538B4FA
data.set 0xA011DB68 %long   0xEAB5EB29
data.set 0xA011DB6C %long   0xF0CA6B55
data.set 0xA011DB70 %long   0x118812CF
data.set 0xA011DB74 %long   0x9A79C0B9
data.set 0xA011DB78 %long   0xCD9A87B0
data.set 0xA011DB7C %long   0xD0C9527F
data.set 0xA011DB80 %long   0x2E828BF3
data.set 0xA011DB84 %long   0x0F5F217B
data.set 0xA011DB88 %long   0x3883C826
data.set 0xA011DB8C %long   0xDF35C873
data.set 0xA011DB90 %long   0x354BA86E
data.set 0xA011DB94 %long   0x6435D363
data.set 0xA011DB98 %long   0x975F81D6
data.set 0xA011DB9C %long   0x4A0AD217
data.set 0xA011DBA0 %long   0x4FCC2566
data.set 0xA011DBA4 %long   0xDE67F2CF
data.set 0xA011DBA8 %long   0x041C8FF1
data.set 0xA011DBAC %long   0x38D00140
data.set 0xA011DBB0 %long   0xA41B910C
data.set 0xA011DBB4 %long   0x96CE35AE
data.set 0xA011DBB8 %long   0x664019EF
data.set 0xA011DBBC %long   0x9CE91636
data.set 0xA011DBC0 %long   0x32E00F75
data.set 0xA011DBC4 %long   0x58D4DE3A
data.set 0xA011DBC8 %long   0x960AF6FE
data.set 0xA011DBCC %long   0x1844CD83
data.set 0xA011DBD0 %long   0x507FF19A
data.set 0xA011DBD4 %long   0xD8DF7CC8
data.set 0xA011DBD8 %long   0xEEB294D4
data.set 0xA011DBDC %long   0x00ED00AA
data.set 0xA011DBE0 %long   0xC985B59B
data.set 0xA011DBE4 %long   0xF8F80565
data.set 0xA011DBE8 %long   0xE8C90B4E
data.set 0xA011DBEC %long   0x859C73B2
data.set 0xA011DBF0 %long   0x88F1C02E
data.set 0xA011DBF4 %long   0xF87AC1BA
data.set 0xA011DBF8 %long   0xC36C5DD8
data.set 0xA011DBFC %long   0xAAAAE1A1
data.set 0xA011DC00 %long   0xED4366ED
data.set 0xA011DC04 %long   0xEA4162A1
data.set 0xA011DC08 %long   0xB796B55B
data.set 0xA011DC0C %long   0xA6340E2B
data.set 0xA011DC10 %long   0xFDF7DCFA
data.set 0xA011DC14 %long   0x622A5C75
data.set 0xA011DC18 %long   0xD28195D3
data.set 0xA011DC1C %long   0x5739DA64
data.set 0xA011DC20 %long   0xC697D8A0
data.set 0xA011DC24 %long   0xEDF380C8
data.set 0xA011DC28 %long   0x90830607
data.set 0xA011DC2C %long   0xAF9ABB8E
data.set 0xA011DC30 %long   0x67DDCB40
data.set 0xA011DC34 %long   0x7E3A5F6B
data.set 0xA011DC38 %long   0x9D1AB81A
data.set 0xA011DC3C %long   0x5138CCEB
data.set 0xA011DC40 %long   0xFA12D9A7
data.set 0xA011DC44 %long   0x169016B6
data.set 0xA011DC48 %long   0x3ACF8160
data.set 0xA011DC4C %long   0x00000000
data.set 0xA011DC50 %long   0x00000000
data.set 0xA011DC54 %long   0x00000000
data.set 0xA011DC58 %long   0x00000000
data.set 0xA011DC5C %long   0x00000000
data.set 0xA011DC60 %long   0x00000000
data.set 0xA011DC64 %long   0x00000000
data.set 0xA011DC68 %long   0x00000000
data.set 0xA011DC6C %long   0x00000000
data.set 0xA011DC70 %long   0x00000000
data.set 0xA011DC74 %long   0x00000000
data.set 0xA011DC78 %long   0x00000000
data.set 0xA011DC7C %long   0x00000000
data.set 0xA011DC80 %long   0x00000000
data.set 0xA011DC84 %long   0x00000000
data.set 0xA011DC88 %long   0x00000000
data.set 0xA011DC8C %long   0x00000000
data.set 0xA011DC90 %long   0x00000000
data.set 0xA011DC94 %long   0x00000000
data.set 0xA011DC98 %long   0x00000000
data.set 0xA011DC9C %long   0x00000000
data.set 0xA011DCA0 %long   0x00000000
data.set 0xA011DCA4 %long   0x00000000
data.set 0xA011DCA8 %long   0x00000000
data.set 0xA011DCAC %long   0x00000000
data.set 0xA011DCB0 %long   0x00000000
data.set 0xA011DCB4 %long   0x00000000
data.set 0xA011DCB8 %long   0x00000000
data.set 0xA011DCBC %long   0x00000000
data.set 0xA011DCC0 %long   0x00000000
data.set 0xA011DCC4 %long   0x00000000
data.set 0xA011DCC8 %long   0x00000000
data.set 0xA011DCCC %long   0x00000000
data.set 0xA011DCD0 %long   0x00000000
data.set 0xA011DCD4 %long   0x00000000
data.set 0xA011DCD8 %long   0x00000000
data.set 0xA011DCDC %long   0x00000000
data.set 0xA011DCE0 %long   0x00000000
data.set 0xA011DCE4 %long   0x00000000
data.set 0xA011DCE8 %long   0x00000000
data.set 0xA011DCEC %long   0x00000000
data.set 0xA011DCF0 %long   0x00000000
data.set 0xA011DCF4 %long   0x00000000
data.set 0xA011DCF8 %long   0x00000000
data.set 0xA011DCFC %long   0x00000000
data.set 0xA011DD00 %long   0x00000000
data.set 0xA011DD04 %long   0x00000000
data.set 0xA011DD08 %long   0x00000000
data.set 0xA011DD0C %long   0x00000000
data.set 0xA011DD10 %long   0x00000000
data.set 0xA011DD14 %long   0x00000000
data.set 0xA011DD18 %long   0x00000000
data.set 0xA011DD1C %long   0x00000000
data.set 0xA011DD20 %long   0x00000000
data.set 0xA011DD24 %long   0x00000000
data.set 0xA011DD28 %long   0x00000000
data.set 0xA011DD2C %long   0x00000000
data.set 0xA011DD30 %long   0x00000000
data.set 0xA011DD34 %long   0x00000000
data.set 0xA011DD38 %long   0x00000000
data.set 0xA011DD3C %long   0x00000000
data.set 0xA011DD40 %long   0x00000000
data.set 0xA011DD44 %long   0x00000000
data.set 0xA011DD48 %long   0x00000000
data.set 0xA011DD4C %long   0x00000000
data.set 0xA011DD50 %long   0x00000000
data.set 0xA011DD54 %long   0x00000000
data.set 0xA011DD58 %long   0x00000000
data.set 0xA011DD5C %long   0x00000000
data.set 0xA011DD60 %long   0x00000000
data.set 0xA011DD64 %long   0x00000000
data.set 0xA011DD68 %long   0x00000000
data.set 0xA011DD6C %long   0x00000000
data.set 0xA011DD70 %long   0x00000000
data.set 0xA011DD74 %long   0x00000000
data.set 0xA011DD78 %long   0x00000000
data.set 0xA011DD7C %long   0x00000000
data.set 0xA011DD80 %long   0x00000000
data.set 0xA011DD84 %long   0x00000000
data.set 0xA011DD88 %long   0x00000000
data.set 0xA011DD8C %long   0x00000000
data.set 0xA011DD90 %long   0x00000000
data.set 0xA011DD94 %long   0x00000000
data.set 0xA011DD98 %long   0x00000000
data.set 0xA011DD9C %long   0x00000000
data.set 0xA011DDA0 %long   0x00000000
data.set 0xA011DDA4 %long   0x00000000
data.set 0xA011DDA8 %long   0x00000000
data.set 0xA011DDAC %long   0x00000000
data.set 0xA011DDB0 %long   0x00000000
data.set 0xA011DDB4 %long   0x00000000
data.set 0xA011DDB8 %long   0x00000000
data.set 0xA011DDBC %long   0x00000000
data.set 0xA011DDC0 %long   0x00000000
data.set 0xA011DDC4 %long   0x00000000
data.set 0xA011DDC8 %long   0x00000000
data.set 0xA011DDCC %long   0x00000000
data.set 0xA011DDD0 %long   0x00000000
data.set 0xA011DDD4 %long   0x00000000
data.set 0xA011DDD8 %long   0x00000000
data.set 0xA011DDDC %long   0x00000000
data.set 0xA011DDE0 %long   0x00000000
data.set 0xA011DDE4 %long   0x00000000
data.set 0xA011DDE8 %long   0x00000000
data.set 0xA011DDEC %long   0x00000000
data.set 0xA011DDF0 %long   0x00000000
data.set 0xA011DDF4 %long   0x00000000
data.set 0xA011DDF8 %long   0x00000000
data.set 0xA011DDFC %long   0x00000000
data.set 0xA011DE00 %long   0x00000000
data.set 0xA011DE04 %long   0x00000000
data.set 0xA011DE08 %long   0x00000000
data.set 0xA011DE0C %long   0x00000000
data.set 0xA011DE10 %long   0x00000000
data.set 0xA011DE14 %long   0x00000000
data.set 0xA011DE18 %long   0x00000000
data.set 0xA011DE1C %long   0x00000000
data.set 0xA011DE20 %long   0x00000000
data.set 0xA011DE24 %long   0x00000000
data.set 0xA011DE28 %long   0x00000000
data.set 0xA011DE2C %long   0x00000000
data.set 0xA011DE30 %long   0x00000000
data.set 0xA011DE34 %long   0x00000000
data.set 0xA011DE38 %long   0x00000000
data.set 0xA011DE3C %long   0x00000000
data.set 0xA011DE40 %long   0x00000000
data.set 0xA011DE44 %long   0x00000000
data.set 0xA011DE48 %long   0x00000000
data.set 0xA011DE4C %long   0x00000000
data.set 0xA011DE50 %long   0x00000000
data.set 0xA011DE54 %long   0x00000000
data.set 0xA011DE58 %long   0x00000000
data.set 0xA011DE5C %long   0x00000000
data.set 0xA011DE60 %long   0x00000000
data.set 0xA011DE64 %long   0x00000000
data.set 0xA011DE68 %long   0x00000000
data.set 0xA011DE6C %long   0x00000000
data.set 0xA011DE70 %long   0x00000000
data.set 0xA011DE74 %long   0x00000000
data.set 0xA011DE78 %long   0x00000000
data.set 0xA011DE7C %long   0x00000000
data.set 0xA011DE80 %long   0x00000000
data.set 0xA011DE84 %long   0x00000000
data.set 0xA011DE88 %long   0x00000000
data.set 0xA011DE8C %long   0x00000000
data.set 0xA011DE90 %long   0x00000000
data.set 0xA011DE94 %long   0x00000000
data.set 0xA011DE98 %long   0x00000000
data.set 0xA011DE9C %long   0x00000000
data.set 0xA011DEA0 %long   0x00000000
data.set 0xA011DEA4 %long   0x00000000
data.set 0xA011DEA8 %long   0x00000000
data.set 0xA011DEAC %long   0x00000000
data.set 0xA011DEB0 %long   0x00000000
data.set 0xA011DEB4 %long   0x00000000
data.set 0xA011DEB8 %long   0x00000000
data.set 0xA011DEBC %long   0x00000000
data.set 0xA011DEC0 %long   0x00000000
data.set 0xA011DEC4 %long   0x00000000
data.set 0xA011DEC8 %long   0x00000000
data.set 0xA011DECC %long   0x00000000
data.set 0xA011DED0 %long   0x00000000
data.set 0xA011DED4 %long   0x00000000
data.set 0xA011DED8 %long   0x00000000
data.set 0xA011DEDC %long   0x00000000
data.set 0xA011DEE0 %long   0x00000000
data.set 0xA011DEE4 %long   0x00000000
data.set 0xA011DEE8 %long   0x00000000
data.set 0xA011DEEC %long   0x00000000
data.set 0xA011DEF0 %long   0x00000000
data.set 0xA011DEF4 %long   0x00000000
data.set 0xA011DEF8 %long   0x00000000
data.set 0xA011DEFC %long   0x00000000
data.set 0xA011DF00 %long   0x00000000
data.set 0xA011DF04 %long   0x00000000
data.set 0xA011DF08 %long   0x00000000
data.set 0xA011DF0C %long   0x00000000
data.set 0xA011DF10 %long   0x00000000
data.set 0xA011DF14 %long   0x00000000
data.set 0xA011DF18 %long   0x00000000
data.set 0xA011DF1C %long   0x00000000
data.set 0xA011DF20 %long   0x00000000
data.set 0xA011DF24 %long   0x00000000
data.set 0xA011DF28 %long   0x00000000
data.set 0xA011DF2C %long   0x00000000
data.set 0xA011DF30 %long   0x00000000
data.set 0xA011DF34 %long   0x00000000
data.set 0xA011DF38 %long   0x00000000
data.set 0xA011DF3C %long   0x00000000
data.set 0xA011DF40 %long   0x00000000
data.set 0xA011DF44 %long   0x00000000
data.set 0xA011DF48 %long   0x00000000
data.set 0xA011DF4C %long   0x00000000
data.set 0xA011DF50 %long   0x00000000
data.set 0xA011DF54 %long   0x00000000
data.set 0xA011DF58 %long   0x00000000
data.set 0xA011DF5C %long   0x00000000
data.set 0xA011DF60 %long   0x00000000
data.set 0xA011DF64 %long   0x00000000
data.set 0xA011DF68 %long   0x00000000
data.set 0xA011DF6C %long   0x00000000
data.set 0xA011DF70 %long   0x00000000
data.set 0xA011DF74 %long   0x00000000
data.set 0xA011DF78 %long   0x00000000
data.set 0xA011DF7C %long   0x00000000
data.set 0xA011DF80 %long   0x00000000
data.set 0xA011DF84 %long   0x00000000
data.set 0xA011DF88 %long   0x00000000
data.set 0xA011DF8C %long   0x00000000
data.set 0xA011DF90 %long   0x00000000
data.set 0xA011DF94 %long   0x00000000
data.set 0xA011DF98 %long   0x00000000
data.set 0xA011DF9C %long   0x00000000
data.set 0xA011DFA0 %long   0x00000000
data.set 0xA011DFA4 %long   0x00000000
data.set 0xA011DFA8 %long   0x00000000
data.set 0xA011DFAC %long   0x00000000
data.set 0xA011DFB0 %long   0x00000000
data.set 0xA011DFB4 %long   0x00000000
data.set 0xA011DFB8 %long   0x00000000
data.set 0xA011DFBC %long   0x00000000
data.set 0xA011DFC0 %long   0x00000000
data.set 0xA011DFC4 %long   0x00000000
data.set 0xA011DFC8 %long   0x00000000
data.set 0xA011DFCC %long   0x00000000
data.set 0xA011DFD0 %long   0x00000000
data.set 0xA011DFD4 %long   0x00000000
data.set 0xA011DFD8 %long   0x00000000
data.set 0xA011DFDC %long   0x00000000
data.set 0xA011DFE0 %long   0x00000000
data.set 0xA011DFE4 %long   0x00000000
data.set 0xA011DFE8 %long   0x00000000
data.set 0xA011DFEC %long   0x00000000
data.set 0xA011DFF0 %long   0x00000000
data.set 0xA011DFF4 %long   0x00000000
data.set 0xA011DFF8 %long   0x00000000
data.set 0xA011DFFC %long   0x00000000
data.set 0xA011E000 %long   0x00000000
data.set 0xA011E004 %long   0x00000000
data.set 0xA011E008 %long   0x00000000
data.set 0xA011E00C %long   0x00000000
data.set 0xA011E010 %long   0x00000000
data.set 0xA011E014 %long   0x00000000
data.set 0xA011E018 %long   0x00000000
data.set 0xA011E01C %long   0x00000000
data.set 0xA011E020 %long   0x00000000
data.set 0xA011E024 %long   0x00000000
data.set 0xA011E028 %long   0x00000000
data.set 0xA011E02C %long   0x00000000
data.set 0xA011E030 %long   0x00000000
data.set 0xA011E034 %long   0x00000000
data.set 0xA011E038 %long   0x00000000
data.set 0xA011E03C %long   0x00000000
data.set 0xA011E040 %long   0x00000000
data.set 0xA011E044 %long   0x00000000
data.set 0xA011E048 %long   0x00000000
data.set 0xA011E04C %long   0x00000000
data.set 0xA011E050 %long   0x00000000
data.set 0xA011E054 %long   0x00000000
data.set 0xA011E058 %long   0x00000000
data.set 0xA011E05C %long   0x00000000
data.set 0xA011E060 %long   0x00000000
data.set 0xA011E064 %long   0x00000000
data.set 0xA011E068 %long   0x00000000
data.set 0xA011E06C %long   0x00000000
data.set 0xA011E070 %long   0x00000000
data.set 0xA011E074 %long   0x00000000
data.set 0xA011E078 %long   0x00000000
data.set 0xA011E07C %long   0x00000000
data.set 0xA011E080 %long   0x00000000
data.set 0xA011E084 %long   0x00000000
data.set 0xA011E088 %long   0x00000000
data.set 0xA011E08C %long   0x00000000
data.set 0xA011E090 %long   0x00000000
data.set 0xA011E094 %long   0x00000000
data.set 0xA011E098 %long   0x00000000
data.set 0xA011E09C %long   0x00000000
data.set 0xA011E0A0 %long   0x00000000
data.set 0xA011E0A4 %long   0x00000000
data.set 0xA011E0A8 %long   0x00000000
data.set 0xA011E0AC %long   0x00000000
data.set 0xA011E0B0 %long   0x00000000
data.set 0xA011E0B4 %long   0x00000000
data.set 0xA011E0B8 %long   0x00000000
data.set 0xA011E0BC %long   0x00000000
data.set 0xA011E0C0 %long   0x00000000
data.set 0xA011E0C4 %long   0x00000000
data.set 0xA011E0C8 %long   0x00000000
data.set 0xA011E0CC %long   0x00000000
data.set 0xA011E0D0 %long   0x00000000
data.set 0xA011E0D4 %long   0x00000000
data.set 0xA011E0D8 %long   0x00000000
data.set 0xA011E0DC %long   0x00000000
data.set 0xA011E0E0 %long   0x00000000
data.set 0xA011E0E4 %long   0x00000000
data.set 0xA011E0E8 %long   0x00000000
data.set 0xA011E0EC %long   0x00000000
data.set 0xA011E0F0 %long   0x00000000
data.set 0xA011E0F4 %long   0x00000000
data.set 0xA011E0F8 %long   0x00000000
data.set 0xA011E0FC %long   0x00000000
data.set 0xA011E100 %long   0x00000000
data.set 0xA011E104 %long   0x00000000
data.set 0xA011E108 %long   0x00000000
data.set 0xA011E10C %long   0x00000000
data.set 0xA011E110 %long   0x00000000
data.set 0xA011E114 %long   0x00000000
data.set 0xA011E118 %long   0x00000000
data.set 0xA011E11C %long   0x00000000
data.set 0xA011E120 %long   0x00000000
data.set 0xA011E124 %long   0x00000000
data.set 0xA011E128 %long   0x00000000
data.set 0xA011E12C %long   0x00000000
data.set 0xA011E130 %long   0x00000000
data.set 0xA011E134 %long   0x00000000
data.set 0xA011E138 %long   0x00000000
data.set 0xA011E13C %long   0x00000000
data.set 0xA011E140 %long   0x00000000
data.set 0xA011E144 %long   0x00000000
data.set 0xA011E148 %long   0x00000000
data.set 0xA011E14C %long   0x00000000
data.set 0xA011E150 %long   0x00000000
data.set 0xA011E154 %long   0x00000000
data.set 0xA011E158 %long   0x00000000
data.set 0xA011E15C %long   0x00000000
data.set 0xA011E160 %long   0x00000000
data.set 0xA011E164 %long   0x00000000
data.set 0xA011E168 %long   0x00000000
data.set 0xA011E16C %long   0x00000000
data.set 0xA011E170 %long   0x00000000
data.set 0xA011E174 %long   0x00000000
data.set 0xA011E178 %long   0x00000000
data.set 0xA011E17C %long   0x00000000
data.set 0xA011E180 %long   0x00000000
data.set 0xA011E184 %long   0x00000000
data.set 0xA011E188 %long   0x00000000
data.set 0xA011E18C %long   0x00000000
data.set 0xA011E190 %long   0x00000000
data.set 0xA011E194 %long   0x00000000
data.set 0xA011E198 %long   0x00000000
data.set 0xA011E19C %long   0x00000000
data.set 0xA011E1A0 %long   0x00000000
data.set 0xA011E1A4 %long   0x00000000
data.set 0xA011E1A8 %long   0x00000000
data.set 0xA011E1AC %long   0x00000000
data.set 0xA011E1B0 %long   0x00000000
data.set 0xA011E1B4 %long   0x00000000
data.set 0xA011E1B8 %long   0x00000000
data.set 0xA011E1BC %long   0x00000000
data.set 0xA011E1C0 %long   0x00000000
data.set 0xA011E1C4 %long   0x00000000
data.set 0xA011E1C8 %long   0x00000000
data.set 0xA011E1CC %long   0x00000000
data.set 0xA011E1D0 %long   0x00000000
data.set 0xA011E1D4 %long   0x00000000
data.set 0xA011E1D8 %long   0x00000000
data.set 0xA011E1DC %long   0x00000000
data.set 0xA011E1E0 %long   0x00000000
data.set 0xA011E1E4 %long   0x00000000
data.set 0xA011E1E8 %long   0x00000000
data.set 0xA011E1EC %long   0x00000000
data.set 0xA011E1F0 %long   0x00000000
data.set 0xA011E1F4 %long   0x00000000
data.set 0xA011E1F8 %long   0x00000000
data.set 0xA011E1FC %long   0x00000000
data.set 0xA011E200 %long   0x00000000
data.set 0xA011E204 %long   0x00000000
data.set 0xA011E208 %long   0x00000000
data.set 0xA011E20C %long   0x00000000
data.set 0xA011E210 %long   0x00000000
data.set 0xA011E214 %long   0x00000000
data.set 0xA011E218 %long   0x00000000
data.set 0xA011E21C %long   0x00000000
data.set 0xA011E220 %long   0x00000000
data.set 0xA011E224 %long   0x00000000
data.set 0xA011E228 %long   0x00000000
data.set 0xA011E22C %long   0x00000000
data.set 0xA011E230 %long   0x00000000
data.set 0xA011E234 %long   0x00000000
data.set 0xA011E238 %long   0x00000000
data.set 0xA011E23C %long   0x00000000
data.set 0xA011E240 %long   0x00000000
data.set 0xA011E244 %long   0x00000000
data.set 0xA011E248 %long   0x00000000
data.set 0xA011E24C %long   0x00000000
data.set 0xA011E250 %long   0x00000000
data.set 0xA011E254 %long   0x00000000
data.set 0xA011E258 %long   0x00000000
data.set 0xA011E25C %long   0x00000000
data.set 0xA011E260 %long   0x00000000
data.set 0xA011E264 %long   0x00000000
data.set 0xA011E268 %long   0x00000000
data.set 0xA011E26C %long   0x00000000
data.set 0xA011E270 %long   0x00000000
data.set 0xA011E274 %long   0x00000000
data.set 0xA011E278 %long   0x00000000
data.set 0xA011E27C %long   0x00000000
data.set 0xA011E280 %long   0x00000000
data.set 0xA011E284 %long   0x00000000
data.set 0xA011E288 %long   0x00000000
data.set 0xA011E28C %long   0x00000000
data.set 0xA011E290 %long   0x00000000
data.set 0xA011E294 %long   0x00000000
data.set 0xA011E298 %long   0x00000000
data.set 0xA011E29C %long   0x00000000
data.set 0xA011E2A0 %long   0x00000000
data.set 0xA011E2A4 %long   0x00000000
data.set 0xA011E2A8 %long   0x00000000
data.set 0xA011E2AC %long   0x00000000
data.set 0xA011E2B0 %long   0x00000000
data.set 0xA011E2B4 %long   0x00000000
data.set 0xA011E2B8 %long   0x00000000
data.set 0xA011E2BC %long   0x00000000
data.set 0xA011E2C0 %long   0x00000000
data.set 0xA011E2C4 %long   0x00000000
data.set 0xA011E2C8 %long   0x00000000
data.set 0xA011E2CC %long   0x00000000
data.set 0xA011E2D0 %long   0x00000000
data.set 0xA011E2D4 %long   0x00000000
data.set 0xA011E2D8 %long   0x00000000
data.set 0xA011E2DC %long   0x00000000
data.set 0xA011E2E0 %long   0x00000000
data.set 0xA011E2E4 %long   0x00000000
data.set 0xA011E2E8 %long   0x00000000
data.set 0xA011E2EC %long   0x00000000
data.set 0xA011E2F0 %long   0x00000000
data.set 0xA011E2F4 %long   0x00000000
data.set 0xA011E2F8 %long   0x00000000
data.set 0xA011E2FC %long   0x00000000
data.set 0xA011E300 %long   0x00000000
data.set 0xA011E304 %long   0x00000000
data.set 0xA011E308 %long   0x00000000
data.set 0xA011E30C %long   0x00000000
data.set 0xA011E310 %long   0x00000000
data.set 0xA011E314 %long   0x00000000
data.set 0xA011E318 %long   0x00000000
data.set 0xA011E31C %long   0x00000000
data.set 0xA011E320 %long   0x00000000
data.set 0xA011E324 %long   0x00000000
data.set 0xA011E328 %long   0x00000000
data.set 0xA011E32C %long   0x00000000
data.set 0xA011E330 %long   0x00000000
data.set 0xA011E334 %long   0x00000000
data.set 0xA011E338 %long   0x00000000
data.set 0xA011E33C %long   0x00000000
data.set 0xA011E340 %long   0x00000000
data.set 0xA011E344 %long   0x00000000
data.set 0xA011E348 %long   0x00000000
data.set 0xA011E34C %long   0x00000000
data.set 0xA011E350 %long   0x00000000
data.set 0xA011E354 %long   0x00000000
data.set 0xA011E358 %long   0x00000000
data.set 0xA011E35C %long   0x00000000
data.set 0xA011E360 %long   0x00000000
data.set 0xA011E364 %long   0x00000000
data.set 0xA011E368 %long   0x00000000
data.set 0xA011E36C %long   0x00000000
data.set 0xA011E370 %long   0x00000000
data.set 0xA011E374 %long   0x00000000
data.set 0xA011E378 %long   0x00000000
data.set 0xA011E37C %long   0x00000000
data.set 0xA011E380 %long   0x00000000
data.set 0xA011E384 %long   0x00000000
data.set 0xA011E388 %long   0x00000000
data.set 0xA011E38C %long   0x00000000
data.set 0xA011E390 %long   0x00000000
data.set 0xA011E394 %long   0x00000000
data.set 0xA011E398 %long   0x00000000
data.set 0xA011E39C %long   0x00000000
data.set 0xA011E3A0 %long   0x00000000
data.set 0xA011E3A4 %long   0x00000000
data.set 0xA011E3A8 %long   0x00000000
data.set 0xA011E3AC %long   0x00000000
data.set 0xA011E3B0 %long   0x00000000
data.set 0xA011E3B4 %long   0x00000000
data.set 0xA011E3B8 %long   0x00000000
data.set 0xA011E3BC %long   0x00000000
data.set 0xA011E3C0 %long   0x00000000
data.set 0xA011E3C4 %long   0x00000000
data.set 0xA011E3C8 %long   0x00000000
data.set 0xA011E3CC %long   0x00000000
data.set 0xA011E3D0 %long   0x00000000
data.set 0xA011E3D4 %long   0x00000000
data.set 0xA011E3D8 %long   0x00000000
data.set 0xA011E3DC %long   0x00000000
data.set 0xA011E3E0 %long   0x00000000
data.set 0xA011E3E4 %long   0x00000000
data.set 0xA011E3E8 %long   0x00000000
data.set 0xA011E3EC %long   0x00000000
data.set 0xA011E3F0 %long   0x00000000
data.set 0xA011E3F4 %long   0x00000000
data.set 0xA011E3F8 %long   0x00000000
data.set 0xA011E3FC %long   0x00000000
data.set 0xA011E400 %long   0x00000000
data.set 0xA011E404 %long   0x00000000
data.set 0xA011E408 %long   0x00000000
data.set 0xA011E40C %long   0x00000000
data.set 0xA011E410 %long   0x00000000
data.set 0xA011E414 %long   0x00000000
data.set 0xA011E418 %long   0x00000000
data.set 0xA011E41C %long   0x00000000
data.set 0xA011E420 %long   0x00000000
data.set 0xA011E424 %long   0x00000000
data.set 0xA011E428 %long   0x00000000
data.set 0xA011E42C %long   0x00000000
data.set 0xA011E430 %long   0x00000000
data.set 0xA011E434 %long   0x00000000
data.set 0xA011E438 %long   0x00000000
data.set 0xA011E43C %long   0x00000000
data.set 0xA011E440 %long   0x00000000
data.set 0xA011E444 %long   0x00000000
data.set 0xA011E448 %long   0x00000000
data.set 0xA011E44C %long   0x00000000
data.set 0xA011E450 %long   0x00000000
data.set 0xA011E454 %long   0x00000000
data.set 0xA011E458 %long   0x00000000
data.set 0xA011E45C %long   0x00000000
data.set 0xA011E460 %long   0x00000000
data.set 0xA011E464 %long   0x00000000
data.set 0xA011E468 %long   0x00000000
data.set 0xA011E46C %long   0x00000000
data.set 0xA011E470 %long   0x00000000
data.set 0xA011E474 %long   0x00000000
data.set 0xA011E478 %long   0x00000000
data.set 0xA011E47C %long   0x00000000
data.set 0xA011E480 %long   0x00000000
data.set 0xA011E484 %long   0x00000000
data.set 0xA011E488 %long   0x00000000
data.set 0xA011E48C %long   0x00000000
data.set 0xA011E490 %long   0x00000000
data.set 0xA011E494 %long   0x00000000
data.set 0xA011E498 %long   0x00000000
data.set 0xA011E49C %long   0x00000000
data.set 0xA011E4A0 %long   0x00000000
data.set 0xA011E4A4 %long   0x00000000
data.set 0xA011E4A8 %long   0x00000000
data.set 0xA011E4AC %long   0x00000000
data.set 0xA011E4B0 %long   0x00000000
data.set 0xA011E4B4 %long   0x00000000
data.set 0xA011E4B8 %long   0x00000000
data.set 0xA011E4BC %long   0x00000000
data.set 0xA011E4C0 %long   0x00000000
data.set 0xA011E4C4 %long   0x00000000
data.set 0xA011E4C8 %long   0x00000000
data.set 0xA011E4CC %long   0x00000000
data.set 0xA011E4D0 %long   0x00000000
data.set 0xA011E4D4 %long   0x00000000
data.set 0xA011E4D8 %long   0x00000000
data.set 0xA011E4DC %long   0x00000000
data.set 0xA011E4E0 %long   0x00000000
data.set 0xA011E4E4 %long   0x00000000
data.set 0xA011E4E8 %long   0x00000000
data.set 0xA011E4EC %long   0x00000000
data.set 0xA011E4F0 %long   0x00000000
data.set 0xA011E4F4 %long   0x00000000
data.set 0xA011E4F8 %long   0x00000000
data.set 0xA011E4FC %long   0x00000000
data.set 0xA011E500 %long   0x00000000
data.set 0xA011E504 %long   0x00000000
data.set 0xA011E508 %long   0x00000000
data.set 0xA011E50C %long   0x00000000
data.set 0xA011E510 %long   0x00000000
data.set 0xA011E514 %long   0x00000000
data.set 0xA011E518 %long   0x00000000
data.set 0xA011E51C %long   0x00000000
data.set 0xA011E520 %long   0x00000000
data.set 0xA011E524 %long   0x00000000
data.set 0xA011E528 %long   0x00000000
data.set 0xA011E52C %long   0x00000000
data.set 0xA011E530 %long   0x00000000
data.set 0xA011E534 %long   0x00000000
data.set 0xA011E538 %long   0x00000000
data.set 0xA011E53C %long   0x00000000
data.set 0xA011E540 %long   0x00000000
data.set 0xA011E544 %long   0x00000000
data.set 0xA011E548 %long   0x00000000
data.set 0xA011E54C %long   0x00000000
data.set 0xA011E550 %long   0x00000000
data.set 0xA011E554 %long   0x00000000
data.set 0xA011E558 %long   0x00000000
data.set 0xA011E55C %long   0x00000000
data.set 0xA011E560 %long   0x00000000
data.set 0xA011E564 %long   0x00000000
data.set 0xA011E568 %long   0x00000000
data.set 0xA011E56C %long   0x00000000
data.set 0xA011E570 %long   0x00000000
data.set 0xA011E574 %long   0x00000000
data.set 0xA011E578 %long   0x00000000
data.set 0xA011E57C %long   0x00000000
data.set 0xA011E580 %long   0x00000000
data.set 0xA011E584 %long   0x00000000
data.set 0xA011E588 %long   0x00000000
data.set 0xA011E58C %long   0x00000000
data.set 0xA011E590 %long   0x00000000
data.set 0xA011E594 %long   0x00000000
data.set 0xA011E598 %long   0x00000000
data.set 0xA011E59C %long   0x00000000
data.set 0xA011E5A0 %long   0x00000000
data.set 0xA011E5A4 %long   0x00000000
data.set 0xA011E5A8 %long   0x00000000
data.set 0xA011E5AC %long   0x00000000
data.set 0xA011E5B0 %long   0x00000000
data.set 0xA011E5B4 %long   0x00000000
data.set 0xA011E5B8 %long   0x00000000
data.set 0xA011E5BC %long   0x00000000
data.set 0xA011E5C0 %long   0x00000000
data.set 0xA011E5C4 %long   0x00000000
data.set 0xA011E5C8 %long   0x00000000
data.set 0xA011E5CC %long   0x00000000
data.set 0xA011E5D0 %long   0x00000000
data.set 0xA011E5D4 %long   0x00000000
data.set 0xA011E5D8 %long   0x00000000
data.set 0xA011E5DC %long   0x00000000
data.set 0xA011E5E0 %long   0x00000000
data.set 0xA011E5E4 %long   0x00000000
data.set 0xA011E5E8 %long   0x00000000
data.set 0xA011E5EC %long   0x00000000
data.set 0xA011E5F0 %long   0x00000000
data.set 0xA011E5F4 %long   0x00000000
data.set 0xA011E5F8 %long   0x00000000
data.set 0xA011E5FC %long   0x00000000
data.set 0xA011E600 %long   0x00000000
data.set 0xA011E604 %long   0x00000000
data.set 0xA011E608 %long   0x00000000
data.set 0xA011E60C %long   0x00000000
data.set 0xA011E610 %long   0x00000000
data.set 0xA011E614 %long   0x00000000
data.set 0xA011E618 %long   0x00000000
data.set 0xA011E61C %long   0x00000000
data.set 0xA011E620 %long   0x00000000
data.set 0xA011E624 %long   0x00000000
data.set 0xA011E628 %long   0x00000000
data.set 0xA011E62C %long   0x00000000
data.set 0xA011E630 %long   0x00000000
data.set 0xA011E634 %long   0x00000000
data.set 0xA011E638 %long   0x00000000
data.set 0xA011E63C %long   0x00000000
data.set 0xA011E640 %long   0x00000000
data.set 0xA011E644 %long   0x00000000
data.set 0xA011E648 %long   0x00000000
data.set 0xA011E64C %long   0x00000000
data.set 0xA011E650 %long   0x00000000
data.set 0xA011E654 %long   0x00000000
data.set 0xA011E658 %long   0x00000000
data.set 0xA011E65C %long   0x00000000
data.set 0xA011E660 %long   0x00000000
data.set 0xA011E664 %long   0x00000000
data.set 0xA011E668 %long   0x00000000
data.set 0xA011E66C %long   0x00000000
data.set 0xA011E670 %long   0x00000000
data.set 0xA011E674 %long   0x00000000
data.set 0xA011E678 %long   0x00000000
data.set 0xA011E67C %long   0x00000000
data.set 0xA011E680 %long   0x00000000
data.set 0xA011E684 %long   0x00000000
data.set 0xA011E688 %long   0x00000000
data.set 0xA011E68C %long   0x00000000
data.set 0xA011E690 %long   0x00000000
data.set 0xA011E694 %long   0x00000000
data.set 0xA011E698 %long   0x00000000
data.set 0xA011E69C %long   0x00000000
data.set 0xA011E6A0 %long   0x00000000
data.set 0xA011E6A4 %long   0x00000000
data.set 0xA011E6A8 %long   0x00000000
data.set 0xA011E6AC %long   0x00000000
data.set 0xA011E6B0 %long   0x00000000
data.set 0xA011E6B4 %long   0x00000000
data.set 0xA011E6B8 %long   0x00000000
data.set 0xA011E6BC %long   0x00000000
data.set 0xA011E6C0 %long   0x00000000
data.set 0xA011E6C4 %long   0x00000000
data.set 0xA011E6C8 %long   0x00000000
data.set 0xA011E6CC %long   0x00000000
data.set 0xA011E6D0 %long   0x00000000
data.set 0xA011E6D4 %long   0x00000000
data.set 0xA011E6D8 %long   0x00000000
data.set 0xA011E6DC %long   0x00000000
data.set 0xA011E6E0 %long   0x00000000
data.set 0xA011E6E4 %long   0x00000000
data.set 0xA011E6E8 %long   0x00000000
data.set 0xA011E6EC %long   0x00000000
data.set 0xA011E6F0 %long   0x00000000
data.set 0xA011E6F4 %long   0x00000000
data.set 0xA011E6F8 %long   0x00000000
data.set 0xA011E6FC %long   0x00000000
data.set 0xA011E700 %long   0x00000000
data.set 0xA011E704 %long   0x00000000
data.set 0xA011E708 %long   0x00000000
data.set 0xA011E70C %long   0x00000000
data.set 0xA011E710 %long   0x00000000
data.set 0xA011E714 %long   0x00000000
data.set 0xA011E718 %long   0x00000000
data.set 0xA011E71C %long   0x00000000
data.set 0xA011E720 %long   0x00000000
data.set 0xA011E724 %long   0x00000000
data.set 0xA011E728 %long   0x00000000
data.set 0xA011E72C %long   0x00000000
data.set 0xA011E730 %long   0x00000000
data.set 0xA011E734 %long   0x00000000
data.set 0xA011E738 %long   0x00000000
data.set 0xA011E73C %long   0x00000000
data.set 0xA011E740 %long   0x00000000
data.set 0xA011E744 %long   0x00000000
data.set 0xA011E748 %long   0x00000000
data.set 0xA011E74C %long   0x00000000
data.set 0xA011E750 %long   0x00000000
data.set 0xA011E754 %long   0x00000000
data.set 0xA011E758 %long   0x00000000
data.set 0xA011E75C %long   0x00000000
data.set 0xA011E760 %long   0x00000000
data.set 0xA011E764 %long   0x00000000
data.set 0xA011E768 %long   0x00000000
data.set 0xA011E76C %long   0x00000000
data.set 0xA011E770 %long   0x00000000
data.set 0xA011E774 %long   0x00000000
data.set 0xA011E778 %long   0x00000000
data.set 0xA011E77C %long   0x00000000
data.set 0xA011E780 %long   0x00000000
data.set 0xA011E784 %long   0x00000000
data.set 0xA011E788 %long   0x00000000
data.set 0xA011E78C %long   0x00000000
data.set 0xA011E790 %long   0x00000000
data.set 0xA011E794 %long   0x00000000
data.set 0xA011E798 %long   0x00000000
data.set 0xA011E79C %long   0x00000000
data.set 0xA011E7A0 %long   0x00000000
data.set 0xA011E7A4 %long   0x00000000
data.set 0xA011E7A8 %long   0x00000000
data.set 0xA011E7AC %long   0x00000000
data.set 0xA011E7B0 %long   0x00000000
data.set 0xA011E7B4 %long   0x00000000
data.set 0xA011E7B8 %long   0x00000000
data.set 0xA011E7BC %long   0x00000000
data.set 0xA011E7C0 %long   0x00000000
data.set 0xA011E7C4 %long   0x00000000
data.set 0xA011E7C8 %long   0x00000000
data.set 0xA011E7CC %long   0x00000000
data.set 0xA011E7D0 %long   0x00000000
data.set 0xA011E7D4 %long   0x00000000
data.set 0xA011E7D8 %long   0x00000000
data.set 0xA011E7DC %long   0x00000000
data.set 0xA011E7E0 %long   0x00000000
data.set 0xA011E7E4 %long   0x00000000
data.set 0xA011E7E8 %long   0x00000000
data.set 0xA011E7EC %long   0x00000000
data.set 0xA011E7F0 %long   0x00000000
data.set 0xA011E7F4 %long   0x00000000
data.set 0xA011E7F8 %long   0x00000000
data.set 0xA011E7FC %long   0x00000000
data.set 0xA011E800 %long   0x00000000
data.set 0xA011E804 %long   0x00000000
data.set 0xA011E808 %long   0x00000000
data.set 0xA011E80C %long   0x00000000
data.set 0xA011E810 %long   0x00000000
data.set 0xA011E814 %long   0x00000000
data.set 0xA011E818 %long   0x00000000
data.set 0xA011E81C %long   0x00000000
data.set 0xA011E820 %long   0x00000000
data.set 0xA011E824 %long   0x00000000
data.set 0xA011E828 %long   0x00000000
data.set 0xA011E82C %long   0x00000000
data.set 0xA011E830 %long   0x00000000
data.set 0xA011E834 %long   0x00000000
data.set 0xA011E838 %long   0x00000000
data.set 0xA011E83C %long   0x00000000
data.set 0xA011E840 %long   0x00000000
data.set 0xA011E844 %long   0x00000000
data.set 0xA011E848 %long   0x00000000
data.set 0xA011E84C %long   0x00000000
data.set 0xA011E850 %long   0x00000000
data.set 0xA011E854 %long   0x00000000
data.set 0xA011E858 %long   0x00000000
data.set 0xA011E85C %long   0x00000000
data.set 0xA011E860 %long   0x00000000
data.set 0xA011E864 %long   0x00000000
data.set 0xA011E868 %long   0x00000000
data.set 0xA011E86C %long   0x00000000
data.set 0xA011E870 %long   0x00000000
data.set 0xA011E874 %long   0x00000000
data.set 0xA011E878 %long   0x00000000
data.set 0xA011E87C %long   0x00000000
data.set 0xA011E880 %long   0x00000000
data.set 0xA011E884 %long   0x00000000
data.set 0xA011E888 %long   0x00000000
data.set 0xA011E88C %long   0x00000000
data.set 0xA011E890 %long   0x00000000
data.set 0xA011E894 %long   0x00000000
data.set 0xA011E898 %long   0x00000000
data.set 0xA011E89C %long   0x00000000
data.set 0xA011E8A0 %long   0x00000000
data.set 0xA011E8A4 %long   0x00000000
data.set 0xA011E8A8 %long   0x00000000
data.set 0xA011E8AC %long   0x00000000
data.set 0xA011E8B0 %long   0x00000000
data.set 0xA011E8B4 %long   0x00000000
data.set 0xA011E8B8 %long   0x00000000
data.set 0xA011E8BC %long   0x00000000
data.set 0xA011E8C0 %long   0x00000000
data.set 0xA011E8C4 %long   0x00000000
data.set 0xA011E8C8 %long   0x00000000
data.set 0xA011E8CC %long   0x00000000
data.set 0xA011E8D0 %long   0x00000000
data.set 0xA011E8D4 %long   0x00000000
data.set 0xA011E8D8 %long   0x00000000
data.set 0xA011E8DC %long   0x00000000
data.set 0xA011E8E0 %long   0x00000000
data.set 0xA011E8E4 %long   0x00000000
data.set 0xA011E8E8 %long   0x00000000
data.set 0xA011E8EC %long   0x00000000
data.set 0xA011E8F0 %long   0x00000000
data.set 0xA011E8F4 %long   0x00000000
data.set 0xA011E8F8 %long   0x00000000
data.set 0xA011E8FC %long   0x00000000
data.set 0xA011E900 %long   0x00000000
data.set 0xA011E904 %long   0x00000000
data.set 0xA011E908 %long   0x00000000
data.set 0xA011E90C %long   0x00000000
data.set 0xA011E910 %long   0x00000000
data.set 0xA011E914 %long   0x00000000
data.set 0xA011E918 %long   0x00000000
data.set 0xA011E91C %long   0x00000000
data.set 0xA011E920 %long   0x00000000
data.set 0xA011E924 %long   0x00000000
data.set 0xA011E928 %long   0x00000000
data.set 0xA011E92C %long   0x00000000
data.set 0xA011E930 %long   0x00000000
data.set 0xA011E934 %long   0x00000000
data.set 0xA011E938 %long   0x00000000
data.set 0xA011E93C %long   0x00000000
data.set 0xA011E940 %long   0x00000000
data.set 0xA011E944 %long   0x00000000
data.set 0xA011E948 %long   0x00000000
data.set 0xA011E94C %long   0x00000000
data.set 0xA011E950 %long   0x00000000
data.set 0xA011E954 %long   0x00000000
data.set 0xA011E958 %long   0x00000000
data.set 0xA011E95C %long   0x00000000
data.set 0xA011E960 %long   0x00000000
data.set 0xA011E964 %long   0x00000000
data.set 0xA011E968 %long   0x00000000
data.set 0xA011E96C %long   0x00000000
data.set 0xA011E970 %long   0x00000000
data.set 0xA011E974 %long   0x00000000
data.set 0xA011E978 %long   0x00000000
data.set 0xA011E97C %long   0x00000000
data.set 0xA011E980 %long   0x00000000
data.set 0xA011E984 %long   0x00000000
data.set 0xA011E988 %long   0x00000000
data.set 0xA011E98C %long   0x00000000
data.set 0xA011E990 %long   0x00000000
data.set 0xA011E994 %long   0x00000000
data.set 0xA011E998 %long   0x00000000
data.set 0xA011E99C %long   0x00000000
data.set 0xA011E9A0 %long   0x00000000
data.set 0xA011E9A4 %long   0x00000000
data.set 0xA011E9A8 %long   0x00000000
data.set 0xA011E9AC %long   0x00000000
data.set 0xA011E9B0 %long   0x00000000
data.set 0xA011E9B4 %long   0x00000000
data.set 0xA011E9B8 %long   0x00000000
data.set 0xA011E9BC %long   0x00000000
data.set 0xA011E9C0 %long   0x00000000
data.set 0xA011E9C4 %long   0x00000000
data.set 0xA011E9C8 %long   0x00000000
data.set 0xA011E9CC %long   0x00000000
data.set 0xA011E9D0 %long   0x00000000
data.set 0xA011E9D4 %long   0x00000000
data.set 0xA011E9D8 %long   0x00000000
data.set 0xA011E9DC %long   0x00000000
data.set 0xA011E9E0 %long   0x00000000
data.set 0xA011E9E4 %long   0x00000000
data.set 0xA011E9E8 %long   0x00000000
data.set 0xA011E9EC %long   0x00000000
data.set 0xA011E9F0 %long   0x00000000
data.set 0xA011E9F4 %long   0x00000000
data.set 0xA011E9F8 %long   0x00000000
data.set 0xA011E9FC %long   0x00000000
data.set 0xA011EA00 %long   0x00000000
data.set 0xA011EA04 %long   0x00000000
data.set 0xA011EA08 %long   0x00000000
data.set 0xA011EA0C %long   0x00000000
data.set 0xA011EA10 %long   0x00000000
data.set 0xA011EA14 %long   0x00000000
data.set 0xA011EA18 %long   0x00000000
data.set 0xA011EA1C %long   0x00000000
data.set 0xA011EA20 %long   0x00000000
data.set 0xA011EA24 %long   0x00000000
data.set 0xA011EA28 %long   0x00000000
data.set 0xA011EA2C %long   0x00000000
data.set 0xA011EA30 %long   0x00000000
data.set 0xA011EA34 %long   0x00000000
data.set 0xA011EA38 %long   0x00000000
data.set 0xA011EA3C %long   0x00000000
data.set 0xA011EA40 %long   0x00000000
data.set 0xA011EA44 %long   0x00000000
data.set 0xA011EA48 %long   0x00000000
data.set 0xA011EA4C %long   0x00000000
data.set 0xA011EA50 %long   0x00000000
data.set 0xA011EA54 %long   0x00000000
data.set 0xA011EA58 %long   0x00000000
data.set 0xA011EA5C %long   0x00000000
data.set 0xA011EA60 %long   0x00000000
data.set 0xA011EA64 %long   0x00000000
data.set 0xA011EA68 %long   0x00000000
data.set 0xA011EA6C %long   0x00000000
data.set 0xA011EA70 %long   0x00000000
data.set 0xA011EA74 %long   0x00000000
data.set 0xA011EA78 %long   0x00000000
data.set 0xA011EA7C %long   0x00000000
data.set 0xA011EA80 %long   0x00000000
data.set 0xA011EA84 %long   0x00000000
data.set 0xA011EA88 %long   0x00000000
data.set 0xA011EA8C %long   0x00000000
data.set 0xA011EA90 %long   0x00000000
data.set 0xA011EA94 %long   0x00000000
data.set 0xA011EA98 %long   0x00000000
data.set 0xA011EA9C %long   0x00000000
data.set 0xA011EAA0 %long   0x00000000
data.set 0xA011EAA4 %long   0x00000000
data.set 0xA011EAA8 %long   0x00000000
data.set 0xA011EAAC %long   0x00000000
data.set 0xA011EAB0 %long   0x00000000
data.set 0xA011EAB4 %long   0x00000000
data.set 0xA011EAB8 %long   0x00000000
data.set 0xA011EABC %long   0x00000000
data.set 0xA011EAC0 %long   0x00000000
data.set 0xA011EAC4 %long   0x00000000
data.set 0xA011EAC8 %long   0x00000000
data.set 0xA011EACC %long   0x00000000
data.set 0xA011EAD0 %long   0x00000000
data.set 0xA011EAD4 %long   0x00000000
data.set 0xA011EAD8 %long   0x00000000
data.set 0xA011EADC %long   0x00000000
data.set 0xA011EAE0 %long   0x00000000
data.set 0xA011EAE4 %long   0x00000000
data.set 0xA011EAE8 %long   0x00000000
data.set 0xA011EAEC %long   0x00000000
data.set 0xA011EAF0 %long   0x00000000
data.set 0xA011EAF4 %long   0x00000000
data.set 0xA011EAF8 %long   0x00000000
data.set 0xA011EAFC %long   0x00000000
data.set 0xA011EB00 %long   0x00000000
data.set 0xA011EB04 %long   0x00000000
data.set 0xA011EB08 %long   0x00000000
data.set 0xA011EB0C %long   0x00000000
data.set 0xA011EB10 %long   0x00000000
data.set 0xA011EB14 %long   0x00000000
data.set 0xA011EB18 %long   0x00000000
data.set 0xA011EB1C %long   0x00000000
data.set 0xA011EB20 %long   0x00000000
data.set 0xA011EB24 %long   0x00000000
data.set 0xA011EB28 %long   0x00000000
data.set 0xA011EB2C %long   0x00000000
data.set 0xA011EB30 %long   0x00000000
data.set 0xA011EB34 %long   0x00000000
data.set 0xA011EB38 %long   0x00000000
data.set 0xA011EB3C %long   0x00000000
data.set 0xA011EB40 %long   0x00000000
data.set 0xA011EB44 %long   0x00000000
data.set 0xA011EB48 %long   0x00000000
data.set 0xA011EB4C %long   0x00000000
data.set 0xA011EB50 %long   0x00000000
data.set 0xA011EB54 %long   0x00000000
data.set 0xA011EB58 %long   0x00000000
data.set 0xA011EB5C %long   0x00000000
data.set 0xA011EB60 %long   0x00000000
data.set 0xA011EB64 %long   0x00000000
data.set 0xA011EB68 %long   0x00000000
data.set 0xA011EB6C %long   0x00000000
data.set 0xA011EB70 %long   0x00000000
data.set 0xA011EB74 %long   0x00000000
data.set 0xA011EB78 %long   0x00000000
data.set 0xA011EB7C %long   0x00000000
data.set 0xA011EB80 %long   0x00000000
data.set 0xA011EB84 %long   0x00000000
data.set 0xA011EB88 %long   0x00000000
data.set 0xA011EB8C %long   0x00000000
data.set 0xA011EB90 %long   0x00000000
data.set 0xA011EB94 %long   0x00000000
data.set 0xA011EB98 %long   0x00000000
data.set 0xA011EB9C %long   0x00000000
data.set 0xA011EBA0 %long   0x00000000
data.set 0xA011EBA4 %long   0x00000000
data.set 0xA011EBA8 %long   0x00000000
data.set 0xA011EBAC %long   0x00000000
data.set 0xA011EBB0 %long   0x00000000
data.set 0xA011EBB4 %long   0x00000000
data.set 0xA011EBB8 %long   0x00000000
data.set 0xA011EBBC %long   0x00000000
data.set 0xA011EBC0 %long   0x00000000
data.set 0xA011EBC4 %long   0x00000000
data.set 0xA011EBC8 %long   0x00000000
data.set 0xA011EBCC %long   0x00000000
data.set 0xA011EBD0 %long   0x00000000
data.set 0xA011EBD4 %long   0x00000000
data.set 0xA011EBD8 %long   0x00000000
data.set 0xA011EBDC %long   0x00000000
data.set 0xA011EBE0 %long   0x00000000
data.set 0xA011EBE4 %long   0x00000000
data.set 0xA011EBE8 %long   0x00000000
data.set 0xA011EBEC %long   0x00000000
data.set 0xA011EBF0 %long   0x00000000
data.set 0xA011EBF4 %long   0x00000000
data.set 0xA011EBF8 %long   0x00000000
data.set 0xA011EBFC %long   0x00000000
data.set 0xA011EC00 %long   0x00000000
data.set 0xA011EC04 %long   0x00000000
data.set 0xA011EC08 %long   0x00000000
data.set 0xA011EC0C %long   0x00000000
data.set 0xA011EC10 %long   0x00000000
data.set 0xA011EC14 %long   0x00000000
data.set 0xA011EC18 %long   0x00000000
data.set 0xA011EC1C %long   0x00000000
data.set 0xA011EC20 %long   0x00000000
data.set 0xA011EC24 %long   0x00000000
data.set 0xA011EC28 %long   0x00000000
data.set 0xA011EC2C %long   0x00000000
data.set 0xA011EC30 %long   0x00000000
data.set 0xA011EC34 %long   0x00000000
data.set 0xA011EC38 %long   0x00000000
data.set 0xA011EC3C %long   0x00000000
data.set 0xA011EC40 %long   0x00000000
data.set 0xA011EC44 %long   0x00000000
data.set 0xA011EC48 %long   0x00000000
data.set 0xA011EC4C %long   0x00000000
data.set 0xA011EC50 %long   0x00000000
data.set 0xA011EC54 %long   0x00000000
data.set 0xA011EC58 %long   0x00000000
data.set 0xA011EC5C %long   0x00000000
data.set 0xA011EC60 %long   0x00000000
data.set 0xA011EC64 %long   0x00000000
data.set 0xA011EC68 %long   0x00000000
data.set 0xA011EC6C %long   0x00000000
data.set 0xA011EC70 %long   0x00000000
data.set 0xA011EC74 %long   0x00000000
data.set 0xA011EC78 %long   0x00000000
data.set 0xA011EC7C %long   0x00000000
data.set 0xA011EC80 %long   0x00000000
data.set 0xA011EC84 %long   0x00000000
data.set 0xA011EC88 %long   0x00000000
data.set 0xA011EC8C %long   0x00000000
data.set 0xA011EC90 %long   0x00000000
data.set 0xA011EC94 %long   0x00000000
data.set 0xA011EC98 %long   0x00000000
data.set 0xA011EC9C %long   0x00000000
data.set 0xA011ECA0 %long   0x00000000
data.set 0xA011ECA4 %long   0x00000000
data.set 0xA011ECA8 %long   0x00000000
data.set 0xA011ECAC %long   0x00000000
data.set 0xA011ECB0 %long   0x00000000
data.set 0xA011ECB4 %long   0x00000000
data.set 0xA011ECB8 %long   0x00000000
data.set 0xA011ECBC %long   0x00000000
data.set 0xA011ECC0 %long   0x00000000
data.set 0xA011ECC4 %long   0x00000000
data.set 0xA011ECC8 %long   0x00000000
data.set 0xA011ECCC %long   0x00000000
data.set 0xA011ECD0 %long   0x00000000
data.set 0xA011ECD4 %long   0x00000000
data.set 0xA011ECD8 %long   0x00000000
data.set 0xA011ECDC %long   0x00000000
data.set 0xA011ECE0 %long   0x00000000
data.set 0xA011ECE4 %long   0x00000000
data.set 0xA011ECE8 %long   0x00000000
data.set 0xA011ECEC %long   0x00000000
data.set 0xA011ECF0 %long   0x00000000
data.set 0xA011ECF4 %long   0x00000000
data.set 0xA011ECF8 %long   0x00000000
data.set 0xA011ECFC %long   0x00000000
data.set 0xA011ED00 %long   0x00000000
data.set 0xA011ED04 %long   0x00000000
data.set 0xA011ED08 %long   0x00000000
data.set 0xA011ED0C %long   0x00000000
data.set 0xA011ED10 %long   0x00000000
data.set 0xA011ED14 %long   0x00000000
data.set 0xA011ED18 %long   0x00000000
data.set 0xA011ED1C %long   0x00000000
data.set 0xA011ED20 %long   0x00000000
data.set 0xA011ED24 %long   0x00000000
data.set 0xA011ED28 %long   0x00000000
data.set 0xA011ED2C %long   0x00000000
data.set 0xA011ED30 %long   0x00000000
data.set 0xA011ED34 %long   0x00000000
data.set 0xA011ED38 %long   0x00000000
data.set 0xA011ED3C %long   0x00000000
data.set 0xA011ED40 %long   0x00000000
data.set 0xA011ED44 %long   0x00000000
data.set 0xA011ED48 %long   0x00000000
data.set 0xA011ED4C %long   0x00000000
data.set 0xA011ED50 %long   0x00000000
data.set 0xA011ED54 %long   0x00000000
data.set 0xA011ED58 %long   0x00000000
data.set 0xA011ED5C %long   0x00000000
data.set 0xA011ED60 %long   0x00000000
data.set 0xA011ED64 %long   0x00000000
data.set 0xA011ED68 %long   0x00000000
data.set 0xA011ED6C %long   0x00000000
data.set 0xA011ED70 %long   0x00000000
data.set 0xA011ED74 %long   0x00000000
data.set 0xA011ED78 %long   0x00000000
data.set 0xA011ED7C %long   0x00000000
data.set 0xA011ED80 %long   0x00000000
data.set 0xA011ED84 %long   0x00000000
data.set 0xA011ED88 %long   0x00000000
data.set 0xA011ED8C %long   0x00000000
data.set 0xA011ED90 %long   0x00000000
data.set 0xA011ED94 %long   0x00000000
data.set 0xA011ED98 %long   0x00000000
data.set 0xA011ED9C %long   0x00000000
data.set 0xA011EDA0 %long   0x00000000
data.set 0xA011EDA4 %long   0x00000000
data.set 0xA011EDA8 %long   0x00000000
data.set 0xA011EDAC %long   0x00000000
data.set 0xA011EDB0 %long   0x00000000
data.set 0xA011EDB4 %long   0x00000000
data.set 0xA011EDB8 %long   0x00000000
data.set 0xA011EDBC %long   0x00000000
data.set 0xA011EDC0 %long   0x00000000
data.set 0xA011EDC4 %long   0x00000000
data.set 0xA011EDC8 %long   0x00000000
data.set 0xA011EDCC %long   0x00000000
data.set 0xA011EDD0 %long   0x00000000
data.set 0xA011EDD4 %long   0x00000000
data.set 0xA011EDD8 %long   0x00000000
data.set 0xA011EDDC %long   0x00000000
data.set 0xA011EDE0 %long   0x00000000
data.set 0xA011EDE4 %long   0x00000000
data.set 0xA011EDE8 %long   0x00000000
data.set 0xA011EDEC %long   0x00000000
data.set 0xA011EDF0 %long   0x00000000
data.set 0xA011EDF4 %long   0x00000000
data.set 0xA011EDF8 %long   0x00000000
data.set 0xA011EDFC %long   0x00000000
data.set 0xA011EE00 %long   0x00000000
data.set 0xA011EE04 %long   0x00000000
data.set 0xA011EE08 %long   0x00000000
data.set 0xA011EE0C %long   0x00000000
data.set 0xA011EE10 %long   0x00000000
data.set 0xA011EE14 %long   0x00000000
data.set 0xA011EE18 %long   0x00000000
data.set 0xA011EE1C %long   0x00000000
data.set 0xA011EE20 %long   0x00000000
data.set 0xA011EE24 %long   0x00000000
data.set 0xA011EE28 %long   0x00000000
data.set 0xA011EE2C %long   0x00000000
data.set 0xA011EE30 %long   0x00000000
data.set 0xA011EE34 %long   0x00000000
data.set 0xA011EE38 %long   0x00000000
data.set 0xA011EE3C %long   0x00000000
data.set 0xA011EE40 %long   0x00000000
data.set 0xA011EE44 %long   0x00000000
data.set 0xA011EE48 %long   0x00000000
data.set 0xA011EE4C %long   0x00000000
data.set 0xA011EE50 %long   0x00000000
data.set 0xA011EE54 %long   0x00000000
data.set 0xA011EE58 %long   0x00000000
data.set 0xA011EE5C %long   0x00000000
data.set 0xA011EE60 %long   0x00000000
data.set 0xA011EE64 %long   0x00000000
data.set 0xA011EE68 %long   0x00000000
data.set 0xA011EE6C %long   0x00000000
data.set 0xA011EE70 %long   0x00000000
data.set 0xA011EE74 %long   0x00000000
data.set 0xA011EE78 %long   0x00000000
data.set 0xA011EE7C %long   0x00000000
data.set 0xA011EE80 %long   0x00000000
data.set 0xA011EE84 %long   0x00000000
data.set 0xA011EE88 %long   0x00000000
data.set 0xA011EE8C %long   0x00000000
data.set 0xA011EE90 %long   0x00000000
data.set 0xA011EE94 %long   0x00000000
data.set 0xA011EE98 %long   0x00000000
data.set 0xA011EE9C %long   0x00000000
data.set 0xA011EEA0 %long   0x00000000
data.set 0xA011EEA4 %long   0x00000000
data.set 0xA011EEA8 %long   0x00000000
data.set 0xA011EEAC %long   0x00000000
data.set 0xA011EEB0 %long   0x00000000
data.set 0xA011EEB4 %long   0x00000000
data.set 0xA011EEB8 %long   0x00000000
data.set 0xA011EEBC %long   0x00000000
data.set 0xA011EEC0 %long   0x00000000
data.set 0xA011EEC4 %long   0x00000000
data.set 0xA011EEC8 %long   0x00000000
data.set 0xA011EECC %long   0x00000000
data.set 0xA011EED0 %long   0x00000000
data.set 0xA011EED4 %long   0x00000000
data.set 0xA011EED8 %long   0x00000000
data.set 0xA011EEDC %long   0x00000000
data.set 0xA011EEE0 %long   0x00000000
data.set 0xA011EEE4 %long   0x00000000
data.set 0xA011EEE8 %long   0x00000000
data.set 0xA011EEEC %long   0x00000000
data.set 0xA011EEF0 %long   0x00000000
data.set 0xA011EEF4 %long   0x00000000
data.set 0xA011EEF8 %long   0x00000000
data.set 0xA011EEFC %long   0x00000000
data.set 0xA011EF00 %long   0x00000000
data.set 0xA011EF04 %long   0x00000000
data.set 0xA011EF08 %long   0x00000000
data.set 0xA011EF0C %long   0x00000000
data.set 0xA011EF10 %long   0x00000000
data.set 0xA011EF14 %long   0x00000000
data.set 0xA011EF18 %long   0x00000000
data.set 0xA011EF1C %long   0x00000000
data.set 0xA011EF20 %long   0x00000000
data.set 0xA011EF24 %long   0x00000000
data.set 0xA011EF28 %long   0x00000000
data.set 0xA011EF2C %long   0x00000000
data.set 0xA011EF30 %long   0x00000000
data.set 0xA011EF34 %long   0x00000000
data.set 0xA011EF38 %long   0x00000000
data.set 0xA011EF3C %long   0x00000000
data.set 0xA011EF40 %long   0x00000000
data.set 0xA011EF44 %long   0x00000000
data.set 0xA011EF48 %long   0x00000000
data.set 0xA011EF4C %long   0x00000000
data.set 0xA011EF50 %long   0x00000000
data.set 0xA011EF54 %long   0x00000000
data.set 0xA011EF58 %long   0x00000000
data.set 0xA011EF5C %long   0x00000000
data.set 0xA011EF60 %long   0x00000000
data.set 0xA011EF64 %long   0x00000000
data.set 0xA011EF68 %long   0x00000000
data.set 0xA011EF6C %long   0x00000000
data.set 0xA011EF70 %long   0x00000000
data.set 0xA011EF74 %long   0x00000000
data.set 0xA011EF78 %long   0x00000000
data.set 0xA011EF7C %long   0x00000000
data.set 0xA011EF80 %long   0x00000000
data.set 0xA011EF84 %long   0x00000000
data.set 0xA011EF88 %long   0x00000000
data.set 0xA011EF8C %long   0x00000000
data.set 0xA011EF90 %long   0x00000000
data.set 0xA011EF94 %long   0x00000000
data.set 0xA011EF98 %long   0x00000000
data.set 0xA011EF9C %long   0x00000000
data.set 0xA011EFA0 %long   0x00000000
data.set 0xA011EFA4 %long   0x00000000
data.set 0xA011EFA8 %long   0x00000000
data.set 0xA011EFAC %long   0x00000000
data.set 0xA011EFB0 %long   0x00000000
data.set 0xA011EFB4 %long   0x00000000
data.set 0xA011EFB8 %long   0x00000000
data.set 0xA011EFBC %long   0x00000000
data.set 0xA011EFC0 %long   0x00000000
data.set 0xA011EFC4 %long   0x00000000
data.set 0xA011EFC8 %long   0x00000000
data.set 0xA011EFCC %long   0x00000000
data.set 0xA011EFD0 %long   0x00000000
data.set 0xA011EFD4 %long   0x00000000
data.set 0xA011EFD8 %long   0x00000000
data.set 0xA011EFDC %long   0x00000000
data.set 0xA011EFE0 %long   0x00000000
data.set 0xA011EFE4 %long   0x00000000
data.set 0xA011EFE8 %long   0x00000000
data.set 0xA011EFEC %long   0x00000000
data.set 0xA011EFF0 %long   0x00000000
data.set 0xA011EFF4 %long   0x00000000
data.set 0xA011EFF8 %long   0x00000000
data.set 0xA011EFFC %long   0x00000000
data.set 0xA011F000 %long   0x00000000
data.set 0xA011F004 %long   0x00000000
data.set 0xA011F008 %long   0x00000000
data.set 0xA011F00C %long   0x00000000
data.set 0xA011F010 %long   0x00000000
data.set 0xA011F014 %long   0x00000000
data.set 0xA011F018 %long   0x00000000
data.set 0xA011F01C %long   0x00000000
data.set 0xA011F020 %long   0x00000000
data.set 0xA011F024 %long   0x00000000
data.set 0xA011F028 %long   0x00000000
data.set 0xA011F02C %long   0x00000000
data.set 0xA011F030 %long   0x00000000
data.set 0xA011F034 %long   0x00000000
data.set 0xA011F038 %long   0x00000000
data.set 0xA011F03C %long   0x00000000
data.set 0xA011F040 %long   0x00000000
data.set 0xA011F044 %long   0x00000000
data.set 0xA011F048 %long   0x00000000
data.set 0xA011F04C %long   0x00000000
data.set 0xA011F050 %long   0x00000000
data.set 0xA011F054 %long   0x00000000
data.set 0xA011F058 %long   0x00000000
data.set 0xA011F05C %long   0x00000000
data.set 0xA011F060 %long   0x00000000
data.set 0xA011F064 %long   0x00000000
data.set 0xA011F068 %long   0x00000000
data.set 0xA011F06C %long   0x00000000
data.set 0xA011F070 %long   0x00000000
data.set 0xA011F074 %long   0x00000000
data.set 0xA011F078 %long   0x00000000
data.set 0xA011F07C %long   0x00000000
data.set 0xA011F080 %long   0x00000000
data.set 0xA011F084 %long   0x00000000
data.set 0xA011F088 %long   0x00000000
data.set 0xA011F08C %long   0x00000000
data.set 0xA011F090 %long   0x00000000
data.set 0xA011F094 %long   0x00000000
data.set 0xA011F098 %long   0x00000000
data.set 0xA011F09C %long   0x00000000
data.set 0xA011F0A0 %long   0x00000000
data.set 0xA011F0A4 %long   0x00000000
data.set 0xA011F0A8 %long   0x00000000
data.set 0xA011F0AC %long   0x00000000
data.set 0xA011F0B0 %long   0x00000000
data.set 0xA011F0B4 %long   0x00000000
data.set 0xA011F0B8 %long   0x00000000
data.set 0xA011F0BC %long   0x00000000
data.set 0xA011F0C0 %long   0x00000000
data.set 0xA011F0C4 %long   0x00000000
data.set 0xA011F0C8 %long   0x00000000
data.set 0xA011F0CC %long   0x00000000
data.set 0xA011F0D0 %long   0x00000000
data.set 0xA011F0D4 %long   0x00000000
data.set 0xA011F0D8 %long   0x00000000
data.set 0xA011F0DC %long   0x00000000
data.set 0xA011F0E0 %long   0x00000000
data.set 0xA011F0E4 %long   0x00000000
data.set 0xA011F0E8 %long   0x00000000
data.set 0xA011F0EC %long   0x00000000
data.set 0xA011F0F0 %long   0x00000000
data.set 0xA011F0F4 %long   0x00000000
data.set 0xA011F0F8 %long   0x00000000
data.set 0xA011F0FC %long   0x00000000
data.set 0xA011F100 %long   0x00000000
data.set 0xA011F104 %long   0x00000000
data.set 0xA011F108 %long   0x00000000
data.set 0xA011F10C %long   0x00000000
data.set 0xA011F110 %long   0x00000000
data.set 0xA011F114 %long   0x00000000
data.set 0xA011F118 %long   0x00000000
data.set 0xA011F11C %long   0x00000000
data.set 0xA011F120 %long   0x00000000
data.set 0xA011F124 %long   0x00000000
data.set 0xA011F128 %long   0x00000000
data.set 0xA011F12C %long   0x00000000
data.set 0xA011F130 %long   0x00000000
data.set 0xA011F134 %long   0x00000000
data.set 0xA011F138 %long   0x00000000
data.set 0xA011F13C %long   0x00000000
data.set 0xA011F140 %long   0x00000000
data.set 0xA011F144 %long   0x00000000
data.set 0xA011F148 %long   0x00000000
data.set 0xA011F14C %long   0x00000000
data.set 0xA011F150 %long   0x00000000
data.set 0xA011F154 %long   0x00000000
data.set 0xA011F158 %long   0x00000000
data.set 0xA011F15C %long   0x00000000
data.set 0xA011F160 %long   0x00000000
data.set 0xA011F164 %long   0x00000000
data.set 0xA011F168 %long   0x00000000
data.set 0xA011F16C %long   0x00000000
data.set 0xA011F170 %long   0x00000000
data.set 0xA011F174 %long   0x00000000
data.set 0xA011F178 %long   0x00000000
data.set 0xA011F17C %long   0x00000000
data.set 0xA011F180 %long   0x00000000
data.set 0xA011F184 %long   0x00000000
data.set 0xA011F188 %long   0x00000000
data.set 0xA011F18C %long   0x00000000
data.set 0xA011F190 %long   0x00000000
data.set 0xA011F194 %long   0x00000000
data.set 0xA011F198 %long   0x00000000
data.set 0xA011F19C %long   0x00000000
data.set 0xA011F1A0 %long   0x00000000
data.set 0xA011F1A4 %long   0x00000000
data.set 0xA011F1A8 %long   0x00000000
data.set 0xA011F1AC %long   0x00000000
data.set 0xA011F1B0 %long   0x00000000
data.set 0xA011F1B4 %long   0x00000000
data.set 0xA011F1B8 %long   0x00000000
data.set 0xA011F1BC %long   0x00000000
data.set 0xA011F1C0 %long   0x00000000
data.set 0xA011F1C4 %long   0x00000000
data.set 0xA011F1C8 %long   0x00000000
data.set 0xA011F1CC %long   0x00000000
data.set 0xA011F1D0 %long   0x00000000
data.set 0xA011F1D4 %long   0x00000000
data.set 0xA011F1D8 %long   0x00000000
data.set 0xA011F1DC %long   0x00000000
data.set 0xA011F1E0 %long   0x00000000
data.set 0xA011F1E4 %long   0x00000000
data.set 0xA011F1E8 %long   0x00000000
data.set 0xA011F1EC %long   0x00000000
data.set 0xA011F1F0 %long   0x00000000
data.set 0xA011F1F4 %long   0x00000000
data.set 0xA011F1F8 %long   0x00000000
data.set 0xA011F1FC %long   0x00000000
data.set 0xA011F200 %long   0x00000000
data.set 0xA011F204 %long   0x00000000
data.set 0xA011F208 %long   0x00000000
data.set 0xA011F20C %long   0x00000000
data.set 0xA011F210 %long   0x00000000
data.set 0xA011F214 %long   0x00000000
data.set 0xA011F218 %long   0x00000000
data.set 0xA011F21C %long   0x00000000
data.set 0xA011F220 %long   0x00000000
data.set 0xA011F224 %long   0x00000000
data.set 0xA011F228 %long   0x00000000
data.set 0xA011F22C %long   0x00000000
data.set 0xA011F230 %long   0x00000000
data.set 0xA011F234 %long   0x00000000
data.set 0xA011F238 %long   0x00000000
data.set 0xA011F23C %long   0x00000000
data.set 0xA011F240 %long   0x00000000
data.set 0xA011F244 %long   0x00000000
data.set 0xA011F248 %long   0x00000000
data.set 0xA011F24C %long   0x00000000
data.set 0xA011F250 %long   0x00000000
data.set 0xA011F254 %long   0x00000000
data.set 0xA011F258 %long   0x00000000
data.set 0xA011F25C %long   0x00000000
data.set 0xA011F260 %long   0x00000000
data.set 0xA011F264 %long   0x00000000
data.set 0xA011F268 %long   0x00000000
data.set 0xA011F26C %long   0x00000000
data.set 0xA011F270 %long   0x00000000
data.set 0xA011F274 %long   0x00000000
data.set 0xA011F278 %long   0x00000000
data.set 0xA011F27C %long   0x00000000
data.set 0xA011F280 %long   0x00000000
data.set 0xA011F284 %long   0x00000000
data.set 0xA011F288 %long   0x00000000
data.set 0xA011F28C %long   0x00000000
data.set 0xA011F290 %long   0x00000000
data.set 0xA011F294 %long   0x00000000
data.set 0xA011F298 %long   0x00000000
data.set 0xA011F29C %long   0x00000000
data.set 0xA011F2A0 %long   0x00000000
data.set 0xA011F2A4 %long   0x00000000
data.set 0xA011F2A8 %long   0x00000000
data.set 0xA011F2AC %long   0x00000000
data.set 0xA011F2B0 %long   0x00000000
data.set 0xA011F2B4 %long   0x00000000
data.set 0xA011F2B8 %long   0x00000000
data.set 0xA011F2BC %long   0x00000000
data.set 0xA011F2C0 %long   0x00000000
data.set 0xA011F2C4 %long   0x00000000
data.set 0xA011F2C8 %long   0x00000000
data.set 0xA011F2CC %long   0x00000000
data.set 0xA011F2D0 %long   0x00000000
data.set 0xA011F2D4 %long   0x00000000
data.set 0xA011F2D8 %long   0x00000000
data.set 0xA011F2DC %long   0x00000000
data.set 0xA011F2E0 %long   0x00000000
data.set 0xA011F2E4 %long   0x00000000
data.set 0xA011F2E8 %long   0x00000000
data.set 0xA011F2EC %long   0x00000000
data.set 0xA011F2F0 %long   0x00000000
data.set 0xA011F2F4 %long   0x00000000
data.set 0xA011F2F8 %long   0x00000000
data.set 0xA011F2FC %long   0x00000000
data.set 0xA011F300 %long   0x00000000
data.set 0xA011F304 %long   0x00000000
data.set 0xA011F308 %long   0x00000000
data.set 0xA011F30C %long   0x00000000
data.set 0xA011F310 %long   0x00000000
data.set 0xA011F314 %long   0x00000000
data.set 0xA011F318 %long   0x00000000
data.set 0xA011F31C %long   0x00000000
data.set 0xA011F320 %long   0x00000000
data.set 0xA011F324 %long   0x00000000
data.set 0xA011F328 %long   0x00000000
data.set 0xA011F32C %long   0x00000000
data.set 0xA011F330 %long   0x00000000
data.set 0xA011F334 %long   0x00000000
data.set 0xA011F338 %long   0x00000000
data.set 0xA011F33C %long   0x00000000
data.set 0xA011F340 %long   0x00000000
data.set 0xA011F344 %long   0x00000000
data.set 0xA011F348 %long   0x00000000
data.set 0xA011F34C %long   0x00000000
data.set 0xA011F350 %long   0x00000000
data.set 0xA011F354 %long   0x00000000
data.set 0xA011F358 %long   0x00000000
data.set 0xA011F35C %long   0x00000000
data.set 0xA011F360 %long   0x00000000
data.set 0xA011F364 %long   0x00000000
data.set 0xA011F368 %long   0x00000000
data.set 0xA011F36C %long   0x00000000
data.set 0xA011F370 %long   0x00000000
data.set 0xA011F374 %long   0x00000000
data.set 0xA011F378 %long   0x00000000
data.set 0xA011F37C %long   0x00000000
data.set 0xA011F380 %long   0x00000000
data.set 0xA011F384 %long   0x00000000
data.set 0xA011F388 %long   0x00000000
data.set 0xA011F38C %long   0x00000000
data.set 0xA011F390 %long   0x00000000
data.set 0xA011F394 %long   0x00000000
data.set 0xA011F398 %long   0x00000000
data.set 0xA011F39C %long   0x00000000
data.set 0xA011F3A0 %long   0x00000000
data.set 0xA011F3A4 %long   0x00000000
data.set 0xA011F3A8 %long   0x00000000
data.set 0xA011F3AC %long   0x00000000
data.set 0xA011F3B0 %long   0x00000000
data.set 0xA011F3B4 %long   0x00000000
data.set 0xA011F3B8 %long   0x00000000
data.set 0xA011F3BC %long   0x00000000
data.set 0xA011F3C0 %long   0x00000000
data.set 0xA011F3C4 %long   0x00000000
data.set 0xA011F3C8 %long   0x00000000
data.set 0xA011F3CC %long   0x00000000
data.set 0xA011F3D0 %long   0x00000000
data.set 0xA011F3D4 %long   0x00000000
data.set 0xA011F3D8 %long   0x00000000
data.set 0xA011F3DC %long   0x00000000
data.set 0xA011F3E0 %long   0x00000000
data.set 0xA011F3E4 %long   0x00000000
data.set 0xA011F3E8 %long   0x00000000
data.set 0xA011F3EC %long   0x00000000
data.set 0xA011F3F0 %long   0x00000000
data.set 0xA011F3F4 %long   0x00000000
data.set 0xA011F3F8 %long   0x00000000
data.set 0xA011F3FC %long   0x00000000
data.set 0xA011F400 %long   0x00000000
data.set 0xA011F404 %long   0x00000000
data.set 0xA011F408 %long   0x00000000
data.set 0xA011F40C %long   0x00000000
data.set 0xA011F410 %long   0x00000000
data.set 0xA011F414 %long   0x00000000
data.set 0xA011F418 %long   0x00000000
data.set 0xA011F41C %long   0x00000000
data.set 0xA011F420 %long   0x00000000
data.set 0xA011F424 %long   0x00000000
data.set 0xA011F428 %long   0x00000000
data.set 0xA011F42C %long   0x00000000
data.set 0xA011F430 %long   0x00000000
data.set 0xA011F434 %long   0x00000000
data.set 0xA011F438 %long   0x00000000
data.set 0xA011F43C %long   0x00000000
data.set 0xA011F440 %long   0x00000000
data.set 0xA011F444 %long   0x00000000
data.set 0xA011F448 %long   0x00000000
data.set 0xA011F44C %long   0x00000000
data.set 0xA011F450 %long   0x00000000
data.set 0xA011F454 %long   0x00000000
data.set 0xA011F458 %long   0x00000000
data.set 0xA011F45C %long   0x00000000
data.set 0xA011F460 %long   0x00000000
data.set 0xA011F464 %long   0x00000000
data.set 0xA011F468 %long   0x00000000
data.set 0xA011F46C %long   0x00000000
data.set 0xA011F470 %long   0x00000000
data.set 0xA011F474 %long   0x00000000
data.set 0xA011F478 %long   0x00000000
data.set 0xA011F47C %long   0x00000000
data.set 0xA011F480 %long   0x00000000
data.set 0xA011F484 %long   0x00000000
data.set 0xA011F488 %long   0x00000000
data.set 0xA011F48C %long   0x00000000
data.set 0xA011F490 %long   0x00000000
data.set 0xA011F494 %long   0x00000000
data.set 0xA011F498 %long   0x00000000
data.set 0xA011F49C %long   0x00000000
data.set 0xA011F4A0 %long   0x00000000
data.set 0xA011F4A4 %long   0x00000000
data.set 0xA011F4A8 %long   0x00000000
data.set 0xA011F4AC %long   0x00000000
data.set 0xA011F4B0 %long   0x00000000
data.set 0xA011F4B4 %long   0x00000000
data.set 0xA011F4B8 %long   0x00000000
data.set 0xA011F4BC %long   0x00000000
data.set 0xA011F4C0 %long   0x00000000
data.set 0xA011F4C4 %long   0x00000000
data.set 0xA011F4C8 %long   0x00000000
data.set 0xA011F4CC %long   0x00000000
data.set 0xA011F4D0 %long   0x00000000
data.set 0xA011F4D4 %long   0x00000000
data.set 0xA011F4D8 %long   0x00000000
data.set 0xA011F4DC %long   0x00000000
data.set 0xA011F4E0 %long   0x00000000
data.set 0xA011F4E4 %long   0x00000000
data.set 0xA011F4E8 %long   0x00000000
data.set 0xA011F4EC %long   0x00000000
data.set 0xA011F4F0 %long   0x00000000
data.set 0xA011F4F4 %long   0x00000000
data.set 0xA011F4F8 %long   0x00000000
data.set 0xA011F4FC %long   0x00000000
data.set 0xA011F500 %long   0x00000000
data.set 0xA011F504 %long   0x00000000
data.set 0xA011F508 %long   0x00000000
data.set 0xA011F50C %long   0x00000000
data.set 0xA011F510 %long   0x00000000
data.set 0xA011F514 %long   0x00000000
data.set 0xA011F518 %long   0x00000000
data.set 0xA011F51C %long   0x00000000
data.set 0xA011F520 %long   0x00000000
data.set 0xA011F524 %long   0x00000000
data.set 0xA011F528 %long   0x00000000
data.set 0xA011F52C %long   0x00000000
data.set 0xA011F530 %long   0x00000000
data.set 0xA011F534 %long   0x00000000
data.set 0xA011F538 %long   0x00000000
data.set 0xA011F53C %long   0x00000000
data.set 0xA011F540 %long   0x00000000
data.set 0xA011F544 %long   0x00000000
data.set 0xA011F548 %long   0x00000000
data.set 0xA011F54C %long   0x00000000
data.set 0xA011F550 %long   0x00000000
data.set 0xA011F554 %long   0x00000000
data.set 0xA011F558 %long   0x00000000
data.set 0xA011F55C %long   0x00000000
data.set 0xA011F560 %long   0x00000000
data.set 0xA011F564 %long   0x00000000
data.set 0xA011F568 %long   0x00000000
data.set 0xA011F56C %long   0x00000000
data.set 0xA011F570 %long   0x00000000
data.set 0xA011F574 %long   0x00000000
data.set 0xA011F578 %long   0x00000000
data.set 0xA011F57C %long   0x00000000
data.set 0xA011F580 %long   0x00000000
data.set 0xA011F584 %long   0x00000000
data.set 0xA011F588 %long   0x00000000
data.set 0xA011F58C %long   0x00000000
data.set 0xA011F590 %long   0x00000000
data.set 0xA011F594 %long   0x00000000
data.set 0xA011F598 %long   0x00000000
data.set 0xA011F59C %long   0x00000000
data.set 0xA011F5A0 %long   0x00000000
data.set 0xA011F5A4 %long   0x00000000
data.set 0xA011F5A8 %long   0x00000000
data.set 0xA011F5AC %long   0x00000000
data.set 0xA011F5B0 %long   0x00000000
data.set 0xA011F5B4 %long   0x00000000
data.set 0xA011F5B8 %long   0x00000000
data.set 0xA011F5BC %long   0x00000000
data.set 0xA011F5C0 %long   0x00000000
data.set 0xA011F5C4 %long   0x00000000
data.set 0xA011F5C8 %long   0x00000000
data.set 0xA011F5CC %long   0x00000000
data.set 0xA011F5D0 %long   0x00000000
data.set 0xA011F5D4 %long   0x00000000
data.set 0xA011F5D8 %long   0x00000000
data.set 0xA011F5DC %long   0x00000000
data.set 0xA011F5E0 %long   0x00000000
data.set 0xA011F5E4 %long   0x00000000
data.set 0xA011F5E8 %long   0x00000000
data.set 0xA011F5EC %long   0x00000000
data.set 0xA011F5F0 %long   0x00000000
data.set 0xA011F5F4 %long   0x00000000
data.set 0xA011F5F8 %long   0x00000000
data.set 0xA011F5FC %long   0x00000000
data.set 0xA011F600 %long   0x00000000
data.set 0xA011F604 %long   0x00000000
data.set 0xA011F608 %long   0x00000000
data.set 0xA011F60C %long   0x00000000
data.set 0xA011F610 %long   0x00000000
data.set 0xA011F614 %long   0x00000000
data.set 0xA011F618 %long   0x00000000
data.set 0xA011F61C %long   0x00000000
data.set 0xA011F620 %long   0x00000000
data.set 0xA011F624 %long   0x00000000
data.set 0xA011F628 %long   0x00000000
data.set 0xA011F62C %long   0x00000000
data.set 0xA011F630 %long   0x00000000
data.set 0xA011F634 %long   0x00000000
data.set 0xA011F638 %long   0x00000000
data.set 0xA011F63C %long   0x00000000
data.set 0xA011F640 %long   0x00000000
data.set 0xA011F644 %long   0x00000000
data.set 0xA011F648 %long   0x00000000
data.set 0xA011F64C %long   0x00000000
data.set 0xA011F650 %long   0x00000000
data.set 0xA011F654 %long   0x00000000
data.set 0xA011F658 %long   0x00000000
data.set 0xA011F65C %long   0x00000000
data.set 0xA011F660 %long   0x00000000
data.set 0xA011F664 %long   0x00000000
data.set 0xA011F668 %long   0x00000000
data.set 0xA011F66C %long   0x00000000
data.set 0xA011F670 %long   0x00000000
data.set 0xA011F674 %long   0x00000000
data.set 0xA011F678 %long   0x00000000
data.set 0xA011F67C %long   0x00000000
data.set 0xA011F680 %long   0x00000000
data.set 0xA011F684 %long   0x00000000
data.set 0xA011F688 %long   0x00000000
data.set 0xA011F68C %long   0x00000000
data.set 0xA011F690 %long   0x00000000
data.set 0xA011F694 %long   0x00000000
data.set 0xA011F698 %long   0x00000000
data.set 0xA011F69C %long   0x00000000
data.set 0xA011F6A0 %long   0x00000000
data.set 0xA011F6A4 %long   0x00000000
data.set 0xA011F6A8 %long   0x00000000
data.set 0xA011F6AC %long   0x00000000
data.set 0xA011F6B0 %long   0x00000000
data.set 0xA011F6B4 %long   0x00000000
data.set 0xA011F6B8 %long   0x00000000
data.set 0xA011F6BC %long   0x00000000
data.set 0xA011F6C0 %long   0x00000000
data.set 0xA011F6C4 %long   0x00000000
data.set 0xA011F6C8 %long   0x00000000
data.set 0xA011F6CC %long   0x00000000
data.set 0xA011F6D0 %long   0x00000000
data.set 0xA011F6D4 %long   0x00000000
data.set 0xA011F6D8 %long   0x00000000
data.set 0xA011F6DC %long   0x00000000
data.set 0xA011F6E0 %long   0x00000000
data.set 0xA011F6E4 %long   0x00000000
data.set 0xA011F6E8 %long   0x00000000
data.set 0xA011F6EC %long   0x00000000
data.set 0xA011F6F0 %long   0x00000000
data.set 0xA011F6F4 %long   0x00000000
data.set 0xA011F6F8 %long   0x00000000
data.set 0xA011F6FC %long   0x00000000
data.set 0xA011F700 %long   0x00000000
data.set 0xA011F704 %long   0x00000000
data.set 0xA011F708 %long   0x00000000
data.set 0xA011F70C %long   0x00000000
data.set 0xA011F710 %long   0x00000000
data.set 0xA011F714 %long   0x00000000
data.set 0xA011F718 %long   0x00000000
data.set 0xA011F71C %long   0x00000000
data.set 0xA011F720 %long   0x00000000
data.set 0xA011F724 %long   0x00000000
data.set 0xA011F728 %long   0x00000000
data.set 0xA011F72C %long   0x00000000
data.set 0xA011F730 %long   0x00000000
data.set 0xA011F734 %long   0x00000000
data.set 0xA011F738 %long   0x00000000
data.set 0xA011F73C %long   0x00000000
data.set 0xA011F740 %long   0x00000000
data.set 0xA011F744 %long   0x00000000
data.set 0xA011F748 %long   0x00000000
data.set 0xA011F74C %long   0x00000000
data.set 0xA011F750 %long   0x00000000
data.set 0xA011F754 %long   0x00000000
data.set 0xA011F758 %long   0x00000000
data.set 0xA011F75C %long   0x00000000
data.set 0xA011F760 %long   0x00000000
data.set 0xA011F764 %long   0x00000000
data.set 0xA011F768 %long   0x00000000
data.set 0xA011F76C %long   0x00000000
data.set 0xA011F770 %long   0x00000000
data.set 0xA011F774 %long   0x00000000
data.set 0xA011F778 %long   0x00000000
data.set 0xA011F77C %long   0x00000000
data.set 0xA011F780 %long   0x00000000
data.set 0xA011F784 %long   0x00000000
data.set 0xA011F788 %long   0x00000000
data.set 0xA011F78C %long   0x00000000
data.set 0xA011F790 %long   0x00000000
data.set 0xA011F794 %long   0x00000000
data.set 0xA011F798 %long   0x00000000
data.set 0xA011F79C %long   0x00000000
data.set 0xA011F7A0 %long   0x00000000
data.set 0xA011F7A4 %long   0x00000000
data.set 0xA011F7A8 %long   0x00000000
data.set 0xA011F7AC %long   0x00000000
data.set 0xA011F7B0 %long   0x00000000
data.set 0xA011F7B4 %long   0x00000000
data.set 0xA011F7B8 %long   0x00000000
data.set 0xA011F7BC %long   0x00000000
data.set 0xA011F7C0 %long   0x00000000
data.set 0xA011F7C4 %long   0x00000000
data.set 0xA011F7C8 %long   0x00000000
data.set 0xA011F7CC %long   0x00000000
data.set 0xA011F7D0 %long   0x00000000
data.set 0xA011F7D4 %long   0x00000000
data.set 0xA011F7D8 %long   0x00000000
data.set 0xA011F7DC %long   0x00000000
data.set 0xA011F7E0 %long   0x00000000
data.set 0xA011F7E4 %long   0x00000000
data.set 0xA011F7E8 %long   0x00000000
data.set 0xA011F7EC %long   0x00000000
data.set 0xA011F7F0 %long   0x00000000
data.set 0xA011F7F4 %long   0x00000000
data.set 0xA011F7F8 %long   0x00000000
data.set 0xA011F7FC %long   0x00000000
data.set 0xA011F800 %long   0x00000000
data.set 0xA011F804 %long   0x00000000
data.set 0xA011F808 %long   0x00000000
data.set 0xA011F80C %long   0x00000000
data.set 0xA011F810 %long   0x00000000
data.set 0xA011F814 %long   0x00000000
data.set 0xA011F818 %long   0x00000000
data.set 0xA011F81C %long   0x00000000
data.set 0xA011F820 %long   0x00000000
data.set 0xA011F824 %long   0x00000000
data.set 0xA011F828 %long   0x00000000
data.set 0xA011F82C %long   0x00000000
data.set 0xA011F830 %long   0x00000000
data.set 0xA011F834 %long   0x00000000
data.set 0xA011F838 %long   0x00000000
data.set 0xA011F83C %long   0x00000000
data.set 0xA011F840 %long   0x00000000
data.set 0xA011F844 %long   0x00000000
data.set 0xA011F848 %long   0x00000000
data.set 0xA011F84C %long   0x00000000
data.set 0xA011F850 %long   0x00000000
data.set 0xA011F854 %long   0x00000000
data.set 0xA011F858 %long   0x00000000
data.set 0xA011F85C %long   0x00000000
data.set 0xA011F860 %long   0x00000000
data.set 0xA011F864 %long   0x00000000
data.set 0xA011F868 %long   0x00000000
data.set 0xA011F86C %long   0x00000000
data.set 0xA011F870 %long   0x00000000
data.set 0xA011F874 %long   0x00000000
data.set 0xA011F878 %long   0x00000000
data.set 0xA011F87C %long   0x00000000
data.set 0xA011F880 %long   0x00000000
data.set 0xA011F884 %long   0x00000000
data.set 0xA011F888 %long   0x00000000
data.set 0xA011F88C %long   0x00000000
data.set 0xA011F890 %long   0x00000000
data.set 0xA011F894 %long   0x00000000
data.set 0xA011F898 %long   0x00000000
data.set 0xA011F89C %long   0x00000000
data.set 0xA011F8A0 %long   0x00000000
data.set 0xA011F8A4 %long   0x00000000
data.set 0xA011F8A8 %long   0x00000000
data.set 0xA011F8AC %long   0x00000000
data.set 0xA011F8B0 %long   0x00000000
data.set 0xA011F8B4 %long   0x00000000
data.set 0xA011F8B8 %long   0x00000000
data.set 0xA011F8BC %long   0x00000000
data.set 0xA011F8C0 %long   0x00000000
data.set 0xA011F8C4 %long   0x00000000
data.set 0xA011F8C8 %long   0x00000000
data.set 0xA011F8CC %long   0x00000000
data.set 0xA011F8D0 %long   0x00000000
data.set 0xA011F8D4 %long   0x00000000
data.set 0xA011F8D8 %long   0x00000000
data.set 0xA011F8DC %long   0x00000000
data.set 0xA011F8E0 %long   0x00000000
data.set 0xA011F8E4 %long   0x00000000
data.set 0xA011F8E8 %long   0x00000000
data.set 0xA011F8EC %long   0x00000000
data.set 0xA011F8F0 %long   0x00000000
data.set 0xA011F8F4 %long   0x00000000
data.set 0xA011F8F8 %long   0x00000000
data.set 0xA011F8FC %long   0x00000000
data.set 0xA011F900 %long   0x00000000
data.set 0xA011F904 %long   0x00000000
data.set 0xA011F908 %long   0x00000000
data.set 0xA011F90C %long   0x00000000
data.set 0xA011F910 %long   0x00000000
data.set 0xA011F914 %long   0x00000000
data.set 0xA011F918 %long   0x00000000
data.set 0xA011F91C %long   0x00000000
data.set 0xA011F920 %long   0x00000000
data.set 0xA011F924 %long   0x00000000
data.set 0xA011F928 %long   0x00000000
data.set 0xA011F92C %long   0x00000000
data.set 0xA011F930 %long   0x00000000
data.set 0xA011F934 %long   0x00000000
data.set 0xA011F938 %long   0x00000000
data.set 0xA011F93C %long   0x00000000
data.set 0xA011F940 %long   0x00000000
data.set 0xA011F944 %long   0x00000000
data.set 0xA011F948 %long   0x00000000
data.set 0xA011F94C %long   0x00000000
data.set 0xA011F950 %long   0x00000000
data.set 0xA011F954 %long   0x00000000
data.set 0xA011F958 %long   0x00000000
data.set 0xA011F95C %long   0x00000000
data.set 0xA011F960 %long   0x00000000
data.set 0xA011F964 %long   0x00000000
data.set 0xA011F968 %long   0x00000000
data.set 0xA011F96C %long   0x00000000
data.set 0xA011F970 %long   0x00000000
data.set 0xA011F974 %long   0x00000000
data.set 0xA011F978 %long   0x00000000
data.set 0xA011F97C %long   0x00000000
data.set 0xA011F980 %long   0x00000000
data.set 0xA011F984 %long   0x00000000
data.set 0xA011F988 %long   0x00000000
data.set 0xA011F98C %long   0x00000000
data.set 0xA011F990 %long   0x00000000
data.set 0xA011F994 %long   0x00000000
data.set 0xA011F998 %long   0x00000000
data.set 0xA011F99C %long   0x00000000
data.set 0xA011F9A0 %long   0x00000000
data.set 0xA011F9A4 %long   0x00000000
data.set 0xA011F9A8 %long   0x00000000
data.set 0xA011F9AC %long   0x00000000
data.set 0xA011F9B0 %long   0x00000000
data.set 0xA011F9B4 %long   0x00000000
data.set 0xA011F9B8 %long   0x00000000
data.set 0xA011F9BC %long   0x00000000
data.set 0xA011F9C0 %long   0x00000000
data.set 0xA011F9C4 %long   0x00000000
data.set 0xA011F9C8 %long   0x00000000
data.set 0xA011F9CC %long   0x00000000
data.set 0xA011F9D0 %long   0x00000000
data.set 0xA011F9D4 %long   0x00000000
data.set 0xA011F9D8 %long   0x00000000
data.set 0xA011F9DC %long   0x00000000
data.set 0xA011F9E0 %long   0x00000000
data.set 0xA011F9E4 %long   0x00000000
data.set 0xA011F9E8 %long   0x00000000
data.set 0xA011F9EC %long   0x00000000
data.set 0xA011F9F0 %long   0x00000000
data.set 0xA011F9F4 %long   0x00000000
data.set 0xA011F9F8 %long   0x00000000
data.set 0xA011F9FC %long   0x00000000
data.set 0xA011FA00 %long   0x00000000
data.set 0xA011FA04 %long   0x00000000
data.set 0xA011FA08 %long   0x00000000
data.set 0xA011FA0C %long   0x00000000
data.set 0xA011FA10 %long   0x00000000
data.set 0xA011FA14 %long   0x00000000
data.set 0xA011FA18 %long   0x00000000
data.set 0xA011FA1C %long   0x00000000
data.set 0xA011FA20 %long   0x00000000
data.set 0xA011FA24 %long   0x00000000
data.set 0xA011FA28 %long   0x00000000
data.set 0xA011FA2C %long   0x00000000
data.set 0xA011FA30 %long   0x00000000
data.set 0xA011FA34 %long   0x00000000
data.set 0xA011FA38 %long   0x00000000
data.set 0xA011FA3C %long   0x00000000
data.set 0xA011FA40 %long   0x00000000
data.set 0xA011FA44 %long   0x00000000
data.set 0xA011FA48 %long   0x00000000
data.set 0xA011FA4C %long   0x00000000
data.set 0xA011FA50 %long   0x00000000
data.set 0xA011FA54 %long   0x00000000
data.set 0xA011FA58 %long   0x00000000
data.set 0xA011FA5C %long   0x00000000
data.set 0xA011FA60 %long   0x00000000
data.set 0xA011FA64 %long   0x00000000
data.set 0xA011FA68 %long   0x00000000
data.set 0xA011FA6C %long   0x00000000
data.set 0xA011FA70 %long   0x00000000
data.set 0xA011FA74 %long   0x00000000
data.set 0xA011FA78 %long   0x00000000
data.set 0xA011FA7C %long   0x00000000
data.set 0xA011FA80 %long   0x00000000
data.set 0xA011FA84 %long   0x00000000
data.set 0xA011FA88 %long   0x00000000
data.set 0xA011FA8C %long   0x00000000
data.set 0xA011FA90 %long   0x00000000
data.set 0xA011FA94 %long   0x00000000
data.set 0xA011FA98 %long   0x00000000
data.set 0xA011FA9C %long   0x00000000
data.set 0xA011FAA0 %long   0x00000000
data.set 0xA011FAA4 %long   0x00000000
data.set 0xA011FAA8 %long   0x00000000
data.set 0xA011FAAC %long   0x00000000
data.set 0xA011FAB0 %long   0x00000000
data.set 0xA011FAB4 %long   0x00000000
data.set 0xA011FAB8 %long   0x00000000
data.set 0xA011FABC %long   0x00000000
data.set 0xA011FAC0 %long   0x00000000
data.set 0xA011FAC4 %long   0x00000000
data.set 0xA011FAC8 %long   0x00000000
data.set 0xA011FACC %long   0x00000000
data.set 0xA011FAD0 %long   0x00000000
data.set 0xA011FAD4 %long   0x00000000
data.set 0xA011FAD8 %long   0x00000000
data.set 0xA011FADC %long   0x00000000
data.set 0xA011FAE0 %long   0x00000000
data.set 0xA011FAE4 %long   0x00000000
data.set 0xA011FAE8 %long   0x00000000
data.set 0xA011FAEC %long   0x00000000
data.set 0xA011FAF0 %long   0x00000000
data.set 0xA011FAF4 %long   0x00000000
data.set 0xA011FAF8 %long   0x00000000
data.set 0xA011FAFC %long   0x00000000
data.set 0xA011FB00 %long   0x00000000
data.set 0xA011FB04 %long   0x00000000
data.set 0xA011FB08 %long   0x00000000
data.set 0xA011FB0C %long   0x00000000
data.set 0xA011FB10 %long   0x00000000
data.set 0xA011FB14 %long   0x00000000
data.set 0xA011FB18 %long   0x00000000
data.set 0xA011FB1C %long   0x00000000
data.set 0xA011FB20 %long   0x00000000
data.set 0xA011FB24 %long   0x00000000
data.set 0xA011FB28 %long   0x00000000
data.set 0xA011FB2C %long   0x00000000
data.set 0xA011FB30 %long   0x00000000
data.set 0xA011FB34 %long   0x00000000
data.set 0xA011FB38 %long   0x00000000
data.set 0xA011FB3C %long   0x00000000
data.set 0xA011FB40 %long   0x00000000
data.set 0xA011FB44 %long   0x00000000
data.set 0xA011FB48 %long   0x00000000
data.set 0xA011FB4C %long   0x00000000
data.set 0xA011FB50 %long   0x00000000
data.set 0xA011FB54 %long   0x00000000
data.set 0xA011FB58 %long   0x00000000
data.set 0xA011FB5C %long   0x00000000
data.set 0xA011FB60 %long   0x00000000
data.set 0xA011FB64 %long   0x00000000
data.set 0xA011FB68 %long   0x00000000
data.set 0xA011FB6C %long   0x00000000
data.set 0xA011FB70 %long   0x00000000
data.set 0xA011FB74 %long   0x00000000
data.set 0xA011FB78 %long   0x00000000
data.set 0xA011FB7C %long   0x00000000
data.set 0xA011FB80 %long   0x00000000
data.set 0xA011FB84 %long   0x00000000
data.set 0xA011FB88 %long   0x00000000
data.set 0xA011FB8C %long   0x00000000
data.set 0xA011FB90 %long   0x00000000
data.set 0xA011FB94 %long   0x00000000
data.set 0xA011FB98 %long   0x00000000
data.set 0xA011FB9C %long   0x00000000
data.set 0xA011FBA0 %long   0x00000000
data.set 0xA011FBA4 %long   0x00000000
data.set 0xA011FBA8 %long   0x00000000
data.set 0xA011FBAC %long   0x00000000
data.set 0xA011FBB0 %long   0x00000000
data.set 0xA011FBB4 %long   0x00000000
data.set 0xA011FBB8 %long   0x00000000
data.set 0xA011FBBC %long   0x00000000
data.set 0xA011FBC0 %long   0x00000000
data.set 0xA011FBC4 %long   0x00000000
data.set 0xA011FBC8 %long   0x00000000
data.set 0xA011FBCC %long   0x00000000
data.set 0xA011FBD0 %long   0x00000000
data.set 0xA011FBD4 %long   0x00000000
data.set 0xA011FBD8 %long   0x00000000
data.set 0xA011FBDC %long   0x00000000
data.set 0xA011FBE0 %long   0x00000000
data.set 0xA011FBE4 %long   0x00000000
data.set 0xA011FBE8 %long   0x00000000
data.set 0xA011FBEC %long   0x00000000
data.set 0xA011FBF0 %long   0x00000000
data.set 0xA011FBF4 %long   0x00000000
data.set 0xA011FBF8 %long   0x00000000
data.set 0xA011FBFC %long   0x00000000
data.set 0xA011FC00 %long   0x00000000
data.set 0xA011FC04 %long   0x00000000
data.set 0xA011FC08 %long   0x00000000
data.set 0xA011FC0C %long   0x00000000
data.set 0xA011FC10 %long   0x00000000
data.set 0xA011FC14 %long   0x00000000
data.set 0xA011FC18 %long   0x00000000
data.set 0xA011FC1C %long   0x00000000
data.set 0xA011FC20 %long   0x00000000
data.set 0xA011FC24 %long   0x00000000
data.set 0xA011FC28 %long   0x00000000
data.set 0xA011FC2C %long   0x00000000
data.set 0xA011FC30 %long   0x00000000
data.set 0xA011FC34 %long   0x00000000
data.set 0xA011FC38 %long   0x00000000
data.set 0xA011FC3C %long   0x00000000
data.set 0xA011FC40 %long   0x00000000
data.set 0xA011FC44 %long   0x00000000
data.set 0xA011FC48 %long   0x00000000
data.set 0xA011FC4C %long   0x00000000
data.set 0xA011FC50 %long   0x00000000
data.set 0xA011FC54 %long   0x00000000
data.set 0xA011FC58 %long   0x00000000
data.set 0xA011FC5C %long   0x00000000
data.set 0xA011FC60 %long   0x00000000
data.set 0xA011FC64 %long   0x00000000
data.set 0xA011FC68 %long   0x00000000
data.set 0xA011FC6C %long   0x00000000
data.set 0xA011FC70 %long   0x00000000
data.set 0xA011FC74 %long   0x00000000
data.set 0xA011FC78 %long   0x00000000
data.set 0xA011FC7C %long   0x00000000
data.set 0xA011FC80 %long   0x00000000
data.set 0xA011FC84 %long   0x00000000
data.set 0xA011FC88 %long   0x00000000
data.set 0xA011FC8C %long   0x00000000
data.set 0xA011FC90 %long   0x00000000
data.set 0xA011FC94 %long   0x00000000
data.set 0xA011FC98 %long   0x00000000
data.set 0xA011FC9C %long   0x00000000
data.set 0xA011FCA0 %long   0x00000000
data.set 0xA011FCA4 %long   0x00000000
data.set 0xA011FCA8 %long   0x00000000
data.set 0xA011FCAC %long   0x00000000
data.set 0xA011FCB0 %long   0x00000000
data.set 0xA011FCB4 %long   0x00000000
data.set 0xA011FCB8 %long   0x00000000
data.set 0xA011FCBC %long   0x00000000
data.set 0xA011FCC0 %long   0x00000000
data.set 0xA011FCC4 %long   0x00000000
data.set 0xA011FCC8 %long   0x00000000
data.set 0xA011FCCC %long   0x00000000
data.set 0xA011FCD0 %long   0x00000000
data.set 0xA011FCD4 %long   0x00000000
data.set 0xA011FCD8 %long   0x00000000
data.set 0xA011FCDC %long   0x00000000
data.set 0xA011FCE0 %long   0x00000000
data.set 0xA011FCE4 %long   0x00000000
data.set 0xA011FCE8 %long   0x00000000
data.set 0xA011FCEC %long   0x00000000
data.set 0xA011FCF0 %long   0x00000000
data.set 0xA011FCF4 %long   0x00000000
data.set 0xA011FCF8 %long   0x00000000
data.set 0xA011FCFC %long   0x00000000
data.set 0xA011FD00 %long   0x00000000
data.set 0xA011FD04 %long   0x00000000
data.set 0xA011FD08 %long   0x00000000
data.set 0xA011FD0C %long   0x00000000
data.set 0xA011FD10 %long   0x00000000
data.set 0xA011FD14 %long   0x00000000
data.set 0xA011FD18 %long   0x00000000
data.set 0xA011FD1C %long   0x00000000
data.set 0xA011FD20 %long   0x00000000
data.set 0xA011FD24 %long   0x00000000
data.set 0xA011FD28 %long   0x00000000
data.set 0xA011FD2C %long   0x00000000
data.set 0xA011FD30 %long   0x00000000
data.set 0xA011FD34 %long   0x00000000
data.set 0xA011FD38 %long   0x00000000
data.set 0xA011FD3C %long   0x00000000
data.set 0xA011FD40 %long   0x00000000
data.set 0xA011FD44 %long   0x00000000
data.set 0xA011FD48 %long   0x00000000
data.set 0xA011FD4C %long   0x00000000
data.set 0xA011FD50 %long   0x00000000
data.set 0xA011FD54 %long   0x00000000
data.set 0xA011FD58 %long   0x00000000
data.set 0xA011FD5C %long   0x00000000
data.set 0xA011FD60 %long   0x00000000
data.set 0xA011FD64 %long   0x00000000
data.set 0xA011FD68 %long   0x00000000
data.set 0xA011FD6C %long   0x00000000
data.set 0xA011FD70 %long   0x00000000
data.set 0xA011FD74 %long   0x00000000
data.set 0xA011FD78 %long   0x00000000
data.set 0xA011FD7C %long   0x00000000
data.set 0xA011FD80 %long   0x00000000
data.set 0xA011FD84 %long   0x00000000
data.set 0xA011FD88 %long   0x00000000
data.set 0xA011FD8C %long   0x00000000
data.set 0xA011FD90 %long   0x00000000
data.set 0xA011FD94 %long   0x00000000
data.set 0xA011FD98 %long   0x00000000
data.set 0xA011FD9C %long   0x00000000
data.set 0xA011FDA0 %long   0x00000000
data.set 0xA011FDA4 %long   0x00000000
data.set 0xA011FDA8 %long   0x00000000
data.set 0xA011FDAC %long   0x00000000
data.set 0xA011FDB0 %long   0x00000000
data.set 0xA011FDB4 %long   0x00000000
data.set 0xA011FDB8 %long   0x00000000
data.set 0xA011FDBC %long   0x00000000
data.set 0xA011FDC0 %long   0x00000000
data.set 0xA011FDC4 %long   0x00000000
data.set 0xA011FDC8 %long   0x00000000
data.set 0xA011FDCC %long   0x00000000
data.set 0xA011FDD0 %long   0x00000000
data.set 0xA011FDD4 %long   0x00000000
data.set 0xA011FDD8 %long   0x00000000
data.set 0xA011FDDC %long   0x00000000
data.set 0xA011FDE0 %long   0x00000000
data.set 0xA011FDE4 %long   0x00000000
data.set 0xA011FDE8 %long   0x00000000
data.set 0xA011FDEC %long   0x00000000
data.set 0xA011FDF0 %long   0x00000000
data.set 0xA011FDF4 %long   0x00000000
data.set 0xA011FDF8 %long   0x00000000
data.set 0xA011FDFC %long   0x00000000
data.set 0xA011FE00 %long   0x00000000
data.set 0xA011FE04 %long   0x00000000
data.set 0xA011FE08 %long   0x00000000
data.set 0xA011FE0C %long   0x00000000
data.set 0xA011FE10 %long   0x00000000
data.set 0xA011FE14 %long   0x00000000
data.set 0xA011FE18 %long   0x00000000
data.set 0xA011FE1C %long   0x00000000
data.set 0xA011FE20 %long   0x00000000
data.set 0xA011FE24 %long   0x00000000
data.set 0xA011FE28 %long   0x00000000
data.set 0xA011FE2C %long   0x00000000
data.set 0xA011FE30 %long   0x00000000
data.set 0xA011FE34 %long   0x00000000
data.set 0xA011FE38 %long   0x00000000
data.set 0xA011FE3C %long   0x00000000
data.set 0xA011FE40 %long   0x00000000
data.set 0xA011FE44 %long   0x00000000
data.set 0xA011FE48 %long   0x00000000
data.set 0xA011FE4C %long   0x00000000
data.set 0xA011FE50 %long   0x00000000
data.set 0xA011FE54 %long   0x00000000
data.set 0xA011FE58 %long   0x00000000
data.set 0xA011FE5C %long   0x00000000
data.set 0xA011FE60 %long   0x00000000
data.set 0xA011FE64 %long   0x00000000
data.set 0xA011FE68 %long   0x00000000
data.set 0xA011FE6C %long   0x00000000
data.set 0xA011FE70 %long   0x00000000
data.set 0xA011FE74 %long   0x00000000
data.set 0xA011FE78 %long   0x00000000
data.set 0xA011FE7C %long   0x00000000
data.set 0xA011FE80 %long   0x00000000
data.set 0xA011FE84 %long   0x00000000
data.set 0xA011FE88 %long   0x00000000
data.set 0xA011FE8C %long   0x00000000
data.set 0xA011FE90 %long   0x00000000
data.set 0xA011FE94 %long   0x00000000
data.set 0xA011FE98 %long   0x00000000
data.set 0xA011FE9C %long   0x00000000
data.set 0xA011FEA0 %long   0x00000000
data.set 0xA011FEA4 %long   0x00000000
data.set 0xA011FEA8 %long   0x00000000
data.set 0xA011FEAC %long   0x00000000
data.set 0xA011FEB0 %long   0x00000000
data.set 0xA011FEB4 %long   0x00000000
data.set 0xA011FEB8 %long   0x00000000
data.set 0xA011FEBC %long   0x00000000
data.set 0xA011FEC0 %long   0x00000000
data.set 0xA011FEC4 %long   0x00000000
data.set 0xA011FEC8 %long   0x00000000
data.set 0xA011FECC %long   0x00000000
data.set 0xA011FED0 %long   0x00000000
data.set 0xA011FED4 %long   0x00000000
data.set 0xA011FED8 %long   0x00000000
data.set 0xA011FEDC %long   0x00000000
data.set 0xA011FEE0 %long   0x00000000
data.set 0xA011FEE4 %long   0x00000000
data.set 0xA011FEE8 %long   0x00000000
data.set 0xA011FEEC %long   0x00000000
data.set 0xA011FEF0 %long   0x00000000
data.set 0xA011FEF4 %long   0x00000000
data.set 0xA011FEF8 %long   0x00000000
data.set 0xA011FEFC %long   0x00000000
data.set 0xA011FF00 %long   0x00000000
data.set 0xA011FF04 %long   0x00000000
data.set 0xA011FF08 %long   0x00000000
data.set 0xA011FF0C %long   0x00000000
data.set 0xA011FF10 %long   0x00000000
data.set 0xA011FF14 %long   0x00000000
data.set 0xA011FF18 %long   0x00000000
data.set 0xA011FF1C %long   0x00000000
data.set 0xA011FF20 %long   0x00000000
data.set 0xA011FF24 %long   0x00000000
data.set 0xA011FF28 %long   0x00000000
data.set 0xA011FF2C %long   0x00000000
data.set 0xA011FF30 %long   0x00000000
data.set 0xA011FF34 %long   0x00000000
data.set 0xA011FF38 %long   0x00000000
data.set 0xA011FF3C %long   0x00000000
data.set 0xA011FF40 %long   0x00000000
data.set 0xA011FF44 %long   0x00000000
data.set 0xA011FF48 %long   0x00000000
data.set 0xA011FF4C %long   0x00000000
data.set 0xA011FF50 %long   0x00000000
data.set 0xA011FF54 %long   0x00000000
data.set 0xA011FF58 %long   0x00000000
data.set 0xA011FF5C %long   0x00000000
data.set 0xA011FF60 %long   0x00000000
data.set 0xA011FF64 %long   0x00000000
data.set 0xA011FF68 %long   0x00000000
data.set 0xA011FF6C %long   0x00000000
data.set 0xA011FF70 %long   0x00000000
data.set 0xA011FF74 %long   0x00000000
data.set 0xA011FF78 %long   0x00000000
data.set 0xA011FF7C %long   0x00000000
data.set 0xA011FF80 %long   0x00000000
data.set 0xA011FF84 %long   0x00000000
data.set 0xA011FF88 %long   0x00000000
data.set 0xA011FF8C %long   0x00000000
data.set 0xA011FF90 %long   0x00000000
data.set 0xA011FF94 %long   0x00000000
data.set 0xA011FF98 %long   0x00000000
data.set 0xA011FF9C %long   0x00000000
data.set 0xA011FFA0 %long   0x00000000
data.set 0xA011FFA4 %long   0x00000000
data.set 0xA011FFA8 %long   0x00000000
data.set 0xA011FFAC %long   0x00000000
data.set 0xA011FFB0 %long   0x00000000
data.set 0xA011FFB4 %long   0x00000000
data.set 0xA011FFB8 %long   0x00000000
data.set 0xA011FFBC %long   0x00000000
data.set 0xA011FFC0 %long   0x00000000
data.set 0xA011FFC4 %long   0x00000000
data.set 0xA011FFC8 %long   0x00000000
data.set 0xA011FFCC %long   0x00000000
data.set 0xA011FFD0 %long   0x00000000
data.set 0xA011FFD4 %long   0x00000000
data.set 0xA011FFD8 %long   0x00000000
data.set 0xA011FFDC %long   0x00000000
data.set 0xA011FFE0 %long   0x00000000
data.set 0xA011FFE4 %long   0x00000000
data.set 0xA011FFE8 %long   0x00000000
data.set 0xA011FFEC %long   0x00000000
data.set 0xA011FFF0 %long   0x00000000
data.set 0xA011FFF4 %long   0x00000000
data.set 0xA011FFF8 %long   0x00000000
data.set 0xA011FFFC %long   0x00000000

print "Upload GPHY firmware...Done"
wait 1s


;load U-Boot
print "Load binary or ELF file..."
wait 1s		
;data.load.binary u-boot.bin 0xa0400000
data.load.auto u-boot

print "Load binary or ELF file...Done"
wait 1s		

wait 1s		
;set the program counter (ELF doesn't need this)
;r.s pc 0xa0400000

print "Ready to GO"
;go

